/*@!Encoding:1252*/

variables
{
  msTimer tDiag;
  diagRequest BasicDiagnosticsEcu.* req;
  int request_time_ms = 100;          // Request cycle time
  int read_done = 0;                  // 0 = not read yet, 1 = finished

  const int SW_RELEASE_LEN = 16;      // MUST match SysVal::SW_Release length
}

// ---------------------------------------------------------
// Initialize diagnostic request and send once
// ---------------------------------------------------------
on start
{
  // UDS request: ReadDataByIdentifier (0x22) + DID A900
  byte did_req[3];

  did_req[0] = 0x22; // SID
  did_req[1] = 0xA9; // DID high
  did_req[2] = 0x00; // DID low

  diagResize(req, 3);
  diagSetPrimitiveData(req, did_req, 3);

  // Send first request
  diagSendRequest(req);

  // Start retry timer until first response arrives
  setTimer(tDiag, request_time_ms);
}

// ---------------------------------------------------------
// Retry request until first response is processed
// ---------------------------------------------------------
on timer tDiag
{
  if (read_done == 1)
  {
    cancelTimer(tDiag);
    return;
  }

  diagSendRequest(req);
  setTimer(tDiag, request_time_ms);
}

// ---------------------------------------------------------
// Handle first diagnostic response
// ---------------------------------------------------------
on diagResponse BasicDiagnosticsEcu.*
{
  byte buf[32];
  long size;
  int i;
  int maxDataBytes;

  // Ignore further responses once done
  if (read_done == 1)
    return;

  size = diagGetPrimitiveSize(this);
  diagGetPrimitiveData(this, buf, 32);

  if (size < 5)   // not enough to contain data
    return;

  // Number of data bytes in response (after PCI, SID, DID high/low)
  maxDataBytes = size - 4;
  if (maxDataBytes > SW_RELEASE_LEN)
  {
    maxDataBytes = SW_RELEASE_LEN;    // do not exceed SysVar array length
  }

  // Copy data bytes into system variable array
  for (i = 0; i < maxDataBytes; i++)
  {
    @anSWer_SysVal::SW_Release[i] = buf[4 + i];
  }

  // Zero-fill remaining positions in SysVar array
  for (; i < SW_RELEASE_LEN; i++)
  {
    @anSWer_SysVal::SW_Release[i] = 0;
  }

  // Mark as completed and stop timer
  read_done = 1;
  cancelTimer(tDiag);
}
