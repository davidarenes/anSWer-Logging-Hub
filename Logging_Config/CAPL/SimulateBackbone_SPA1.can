/*@!Encoding:1252*/
/*@!Encoding:1252*/
/*@!Encoding:1252*/

includes
{
   //include "..\CAPL\FaDC.cin"
   //include "..\CAPL\ADS_E2E.cin"
   //include "..\CAPL\ADS_E2E_V2.cin"
}



variables
{
  msTimer T1,T2,T3;
  int Cfg_count=0;
  int Cfg_byte=0;
  
  int temp_SteerWhlSnsrCntr;
  int temp_SteerWhlSnsrChks;
  int temp_EscStCntr;
  int temp_EscStChks;
  int temp_VehMtnStCntr;
  int temp_VehMtnStChks;
  int temp_VehSpdLgtCntr;
  int temp_VehSpdLgtChks;
  int temp_DrvrSteerActvCntr;
  int temp_DrvrSteerActvChks;
  int temp_AgDataRawSafeCntr;
  int temp_AgDataRawSafeChks;
  int temp_PinionSteerAgGroupChks;
  int temp_PinionSteerAgGroupCntr;
  int temp_AccrPedlRatChks;
  int temp_AccrPedlRatCntr;
  int temp_EyeOnRoadEyesOnRoadChks;
  int temp_EyeOnRoadEyesOnRoadCntr;
  int temp_SwtIndcrIndcrTypExtReqChks;
  int temp_FrntSideRdrLeStsRdrStsCntr;
  int temp_ALgtStdFromWhlSpdChks_Control;
  int temp_ALgtStdFromWhlSpdCntr_Control;
  int temp_VehSpdLgtChks_Control;
  int temp_VehSpdLgtCntr_Control;
  int temp_DrvrACCFctDeactvnReqChks_Control;
  int temp_DrvrACCFctDeactvnReqCntr_Control;
  int temp_SftySigGroupFromHmiSafe1SftySigGroupFromHmiSafeChks_Control;
  int temp_SftySigGroupFromHmiSafe1SftySigGroupFromHmiSafeCntr_Control;
  int temp_DrvrSteerActvChks_Control;
  int temp_DrvrSteerActvCntr_Control;
  int temp_SteerWhlSnsrChks_Control;
  int temp_SteerWhlSnsrCntr_Control;
  int temp_EscStChks_Control;
  int temp_EscStCntr_Control;
  int temp_AbsCtrlActvChks_Control;
  int temp_AbsCtrlActvCntr_Control;
  int temp_VehModMngtGlbSafe1Chks_Control;
  int temp_VehModMngtGlbSafe1Cntr_Control;
  int temp_VehMtnStChks_Control;
  int temp_VehMtnStCntr_Control;
  int temp_AgDataRawSafeChks_Control;
  int temp_AgDataRawSafeCntr_Control;
  int temp_AsyDataWithCmpSafeChks_Control;
  int temp_AsyDataWithCmpSafeCntr_Control;
  int temp_ADataRawSafeChks_Control;
  int temp_ADataRawSafeCntr_Control;
  int temp_PinionSteerAgGroupChks_Control;
  int temp_PinionSteerAgGroupCntr_Control;
  int temp_DrvrDecelReqChks_Control;
  int temp_DrvrDecelReqCntr_Control;
  int temp_AccrPedlRatChks_Control;
  int temp_AccrPedlRatCntr_Control;
  int temp_AccrPedlPsdChks_Control;
  int temp_AccrPedlPsdCntr_Control;
  int temp_BrkPedlPsdChks_Control;
  int temp_BrkPedlPsdCntr_Control;
  
  int temp_TurnIndcrMonostableChks_Control;
  int temp_TurnIndcrMonostableCntr_Control;
  int temp_FrntSideRdrLeStsRdrStsChks_Control;
  int temp_FrntSideRdrLeStsRdrStsCntr_Control;
  int temp_SwtIndcrIndcrTypExtReqChks_Control;
  int temp_SwtIndcrIndcrTypExtReqCntr_Control;
  int temp_ADataRawSafeALgtChks_Control;
  int temp_ADataRawSafeALgtCntr_Control;
  
  //20250408_fanjunjie_add
  int chksValues[4] = {167, 186, 157, 128};
  int cntrValues[4] = {0,   1,   2,  3};
  int currentIndex = 0;
  int sendCount = 0;
  msTimer cyclicTimer;
  

 

  
  
  int Vin_count=8;
  int VIN_V446K[3][8]=  {
							           {1,76,89,86,87,70,71,49},{2,68,56,84,76,48,48,48},{3,48,53,54,0,0,0,0}
						            };

  
  
  byte Carparameter_V446K[72][8]=
                        {
//                          {1,233,1,1,2,141,1,1},{2,1,139,2,2,2,3,2},{3,1,2,16,110,6,1,0},{4,4,4,2,255,0,0,1}, //{1,233,1,1,2,141,1,1}
//                          {5,4,140,128,10,1,1,1},{6,1,2,3,129,2,1,2},{7,18,1,7,1,1,1,0},{8,3,1,2,2,2,2,2},//{8,3,1,2,2,2,129,2}
//                          {9,3,1,1,128,2,255,255},{10,3,1,1,1,1,1,1},{11,1,3,2,2,2,2,2},{12,10,1,4,3,129,2,1},
//                          {13,1,1,2,2,1,3,1},{14,2,1,128,2,2,2,128},{15,1,1,0,0,0,1,130},{16,1,128,3,4,1,1,1},
//                          {17,1,2,1,3,1,129,1},{18,1,1,1,2,2,1,4},{19,1,4,1,2,1,1,1},{20,2,2,1,1,3,2,2},
//                          {21,1,128,2,1,1,4,1},{22,1,41,2,1,4,2,3},{23,128,3,2,3,3,4,1},{24,30,3,10,1,1,4,1},
//                          {25,2,1,2,1,3,130,5},{26,128,5,1,2,2,1,4},{27,128,3,1,1,1,1,1},{28,2,5,2,131,2,2,3},//{28,2,5,2,131,2,0,3}
//                          {29,2,2,3,4,2,2,2},{30,1,1,1,3,0,1,1},{31,1,1,1,1,1,1,1},{32,128,3,10,1,1,4,4},
//                          {33,5,5,4,4,6,6,9},{34,9,0,0,3,0,0,2},{35,1,2,1,1,1,2,128},{36,3,3,1,2,0,0,0},
//                          {37,2,2,2,2,2,2,2},{38,0,1,1,1,0,0,0},{39,1,1,0,0,1,0,0},{40,1,0,0,0,0,0,0},
//                          {41,0,0,0,0,0,0,0},{42,0,5,1,0,0,0,0},{43,0,0,0,0,0,0,1},{44,0,1,1,0,0,1,0},//{41,0,0,0,0,0,0,0},{42,0,0,1,0,0,0,0}
//                          {45,0,0,2,0,0,0,2},{46,2,2,1,3,0,0,0},{47,0,1,1,0,0,0,0},{48,0,0,0,0,0,2,2},//{45,0,0,2,0,0,0,0},{46,136,2,1,3,0,0,0}
//                          {49,128,1,2,1,1,1,2},{50,1,2,1,3,2,1,128},{51,1,128,2,2,2,1,1},{52,2,1,5,3,128,2,6},
//                          {53,1,2,1,1,0,0,2},{54,3,1,0,0,0,0,0},{55,0,0,0,0,0,0,0},{56,0,0,0,0,0,0,0},
//                          {57,0,0,0,0,0,0,0},{58,0,3,0,0,0,0,0},{59,1,1,2,1,0,0,0},{60,0,129,0,0,0,0,0},
//                          {61,0,0,0,0,0,0,0},{62,0,0,0,0,0,0,0},{63,0,0,0,0,0,0,1},{64,6,1,0,0,0,0,0},
//                          {65,133,4,1,2,2,2,1},{66,2,2,4,4,3,1,2},{67,2,1,2,128,2,2,2},{68,1,2,2,1,1,1,1},
//                          {69,1,2,2,3,1,1,1},{70,2,1,1,2,1,3,0},{71,254,0,1,133,2,2,1},{72,1,2,2,1,2,2,1}
                          
                          
                          {1,1,1,1,1,1,1,1},{2,1,1,1,1,1,1,1},{3,1,1,1,28,1,1,1},{4,1,4,1,1,1,1,1}, 
                          {5,1,1,1,1,1,1,1},{6,1,1,1,1,1,1,1},{7,1,1,1,1,1,1,1},{8,1,1,1,1,1,2,1},
                          {9,1,1,1,1,1,1,1},{10,1,1,1,1,1,1,1},{11,1,1,1,1,1,1,1},{12,1,1,1,1,1,1,1},
                          {13,1,1,1,1,1,1,1},{14,1,1,1,1,1,1,1},{15,1,1,1,1,1,1,1},{16,1,1,1,1,1,1,1},
                          {17,1,1,1,1,1,1,1},{18,1,1,1,1,1,1,1},{19,1,1,1,1,1,1,1},{20,1,1,1,1,1,1,1},
                          {21,1,1,1,1,3,1,1},{22,3,1,3,1,1,1,1},{23,1,1,1,1,1,1,1},{24,1,1,1,1,1,1,1},
                          {25,1,1,1,1,1,1,1},{26,1,1,1,1,1,1,1},{27,1,1,1,1,1,1,1},{28,1,1,1,1,1,1,1},
                          {29,1,1,1,1,1,1,1},{30,1,1,1,1,1,1,1},{31,1,1,1,1,1,1,1},{32,1,1,1,1,1,1,1},
                          {33,1,1,1,1,1,1,1},{34,1,1,1,1,1,1,1},{35,1,1,1,1,1,1,1},{36,1,1,1,1,1,1,1},
                          {37,1,1,1,1,1,1,1},{38,1,1,1,1,1,2,1},{39,1,1,1,1,1,1,1},{40,1,1,1,1,1,3,1},
                          {41,1,1,1,1,1,1,1},{42,1,5,1,1,1,1,1},{43,1,1,1,1,1,1,1},{44,1,1,1,1,1,1,1},
                          {45,1,1,1,3,1,1,2},{46,2,1,1,1,1,1,1},{47,1,1,1,1,1,1,1},{48,1,1,1,1,1,1,1},
                          {49,1,1,1,1,1,1,1},{50,1,1,1,1,1,1,1},{51,1,1,1,1,1,1,1},{52,1,1,1,1,1,1,1},
                          {53,1,1,1,1,1,1,1},{54,1,1,1,1,1,1,1},{55,1,1,1,1,1,1,1},{56,1,1,1,1,1,1,1},
                          {57,1,1,1,1,1,1,1},{58,1,1,1,1,1,1,1},{59,1,1,1,1,1,1,1},{60,1,1,1,1,1,1,1},
                          {61,1,1,1,1,1,1,1},{62,1,1,1,1,1,1,1},{63,1,1,1,1,1,1,1},{64,1,1,1,1,1,1,1},
                          {65,1,1,1,1,1,1,1},{66,1,1,1,1,1,1,1},{67,1,1,1,1,1,1,1},{68,1,1,1,1,1,1,1},
                          {69,1,1,1,1,1,1,1},{70,1,1,1,1,1,1,1},{71,1,1,1,4,1,1,1},{72,1,1,1,1,1,1,1}
                          
                        };
                        
   //add_20241203_fanjunjie               
   byte Carparameter_V446K_Ext[72][8]=
                        {
                          {1,2,2,1,2,2,1,2},{2,1,1,2,1,1,2,1},{3,0,1,3,1,2,1,1},{4,5,1,254,254,4,1,1},
                          {5,1,1,3,1,1,4,1},{6,1,1,1,1,1,1,2},{7,1,1,1,2,1,1,1},{8,0,0,0,0,0,0,1},
                          {9,2,3,1,1,2,24,2},{10,5,1,1,2,1,2,1},{11,1,2,3,2,1,4,1},{12,1,1,1,1,1,1,3},
                          {13,1,1,1,0,1,1,2},{14,1,1,2,2,1,1,1},{15,1,2,1,1,1,1,1},{16,2,1,1,1,1,1,1},
                          {17,1,1,1,1,1,4,2},{18,1,1,1,1,3,7,1},{19,1,1,1,3,4,2,41},{20,1,7,2,1,1,1,2},
                          {21,4,2,1,1,1,1,5},{22,1,1,1,1,1,4,1},{23,1,1,1,1,1,1,1},{24,1,1,1,1,1,1,1},
                          {25,1,1,1,1,1,1,1},{26,1,1,1,3,1,1,2},{27,1,9,1,0,1,1,1},{28,1,3,1,1,1,1,1},
                          {29,1,1,3,1,1,1,4},{30,1,1,3,3,3,1,2},{31,0,0,1,1,1,1,0},{32,0,0,0,1,1,0,0},
                          {33,0,1,0,0,0,0,1},{34,1,1,1,1,2,0,14},{35,0,0,0,16,1,1,1},{36,1,1,1,1,1,0,0},
                          {37,2,1,1,1,1,255,1},{38,0,1,1,1,0,0,0},{39,0,0,0,1,0,0,1},{40,0,0,0,0,0,0,0},
                          {41,0,0,0,0,0,0,0},{42,0,0,0,0,0,0,0},{43,0,0,0,0,0,0,0},{44,0,0,0,0,0,0,0},
                          {45,0,0,0,0,0,0,0},{46,0,0,0,0,0,0,0},{47,0,0,0,0,0,0,0},{48,0,0,0,0,0,0,0},
                          {49,0,0,0,0,0,0,0},{50,0,0,0,0,0,0,0},{51,0,0,0,0,0,0,0},{52,0,0,0,0,0,0,0},
                          {53,0,0,0,0,0,0,0},{54,0,0,0,0,0,0,0},{55,0,0,0,0,0,0,0},{56,0,0,0,0,0,0,0},
                          {57,0,0,0,0,0,0,0},{58,0,0,0,0,0,0,0},{59,0,0,0,0,0,0,0},{60,0,0,0,0,0,0,0},
                          {61,0,0,0,0,0,0,0},{62,0,0,0,0,0,0,0},{63,0,0,0,0,0,0,0},{64,0,0,0,0,0,0,0},
                          {65,0,0,0,0,0,0,0},{66,0,0,0,0,0,0,0},{67,0,0,0,0,0,0,0},{68,0,0,0,0,0,0,0},
                          {69,0,0,0,0,0,0,0},{70,0,0,0,0,0,0,0},{71,0,0,0,0,0,0,0},{72,0,0,0,0,0,0,0}
                        };
                        
}

on start
  {
    setTimer(T1,2000);
    setTimer(T2,3000);
    setTimer(T3,4000);
    @Carmaker2FC::CarmakerVehKeyState=0;
    @Panel::CarmakerRunState = 0;
//    @P1_DBG_DATA::P1_DBG_Signal.COMMON_check=0;
//    @P1_DBG_DATA::P1_DBG_Signal.COMMON_file_version=0;
//    @P1_DBG_DATA::P1_DBG_Signal.COMMON_u8_P1_Version=0;
    ///Initial wheel rot counter
    $Backbone::VCU1::VDDMBackBoneSignalIPdu02::WhlRotToothCntrFrntLe=1;
    $Backbone::VCU1::VDDMBackBoneSignalIPdu02::WhlRotToothCntrFrntRi=1;
    $Backbone::VCU1::VDDMBackBoneSignalIPdu02::WhlRotToothCntrReLe=1;
    $Backbone::VCU1::VDDMBackBoneSignalIPdu02::WhlRotToothCntrReRi=1;
    
//    $ChassisCAN1::BBM::VddmChas1Fr46::WhlRotToothCntrFrntLe=1;     //20241204
//    $ChassisCAN1::BBM::VddmChas1Fr46::WhlRotToothCntrFrntRi=1;    //20241204
//    $ChassisCAN1::BBM::VddmChas1Fr46::WhlRotToothCntrReLe=1;    //20241204
//    $ChassisCAN1::BBM::VddmChas1Fr46::WhlRotToothCntrReRi=1;    //20241204
//    $FrntRdrStsRdrStsFaulty=0;
//    $CrsCtrlTiGapAdjReq_UB = 1;
    $VehSpdIndcd_UB = 1;
//    $DrvrACCrsSetSpdReq_UB = 1;
//    $SftySigGroupFromHmiSafe1_UB = 1;
//    $Backbone::VDDM::VDDMBackBoneSignalIPdu16::EngSt1WdSts1_UB = 1.0;
    $Backbone::VCU1::VDDMBackBoneSignalIPdu01::BrkPedlPsdQf = 3.0;
    $Backbone::VCU1::VDDMBackBoneSignalIPdu01::BrkPedlPsdSafeGroup_UB = 1.0;
    $Backbone::VCU1::VDDMBackBoneSignalIPdu02::PinionSteerAg1Qf = 3.0;
//    $ChassisCAN1::PSCM1::PscmChas1Fr07::PinionSteerAgGroupPinionSteerAg1Qf=3.0;
    $PinionSteerAgSpd1Qf = 3.0;
//    $ChassisCAN1::PSCM1::PscmChas1Fr07::PinionSteerAgGroupPinionSteerAgSpd1Qf=3.0;
    $SteerWhlTqQf = 3.0;
//    $ChassisCAN1::PSCM1::PscmChas1Fr07::PinionSteerAgGroupSteerWhlTqQf=3.0;
    $Backbone::VCU1::VDDMBackBoneSignalIPdu01::SteerWhlSnsrQf = 3.0;
//    $ChassisCAN1::SAS::SasChas1Fr01::SteerWhlSnsrQf=3.0;
    $DrvModReq_UB = 1.0;
    $StandStillMgrStsForHld_UB = 1.0;
    $SteerServoSts_UB = 1.0;
    $SteerWhlTqAddl_UB = 1.0;
//    $TqAssAddl_UB = 1.0;
//    $Backbone::VDDM::VDDMBackBoneSignalIPdu02::PinionSteerAgGroupPinionSteerAg1Qf = 3.0;
//    $Backbone::VDDM::VDDMBackBoneSignalIPdu02::PinionSteerAgGroupPinionSteerAgSpd1Qf = 3.0;
//    $Backbone::VDDM::VDDMBackBoneSignalIPdu02::PinionSteerAgGroupSteerWhlTqQf = 3.0;

//    $Backbone::BBM::BcmVddmBackBoneSignalIPdu03::BrkSysCylPMstActQf = 3;
    $CllsnThreat_UB = 1.0;
    $DoorDrvrSts_UB = 1.0;
    $DoorPassReSts_UB = 1.0;
    $DoorPassSts_UB = 1.0;
    $DoorDrvrReSts_UB = 1.0;
//    $Backbone::VGM::CEMBackBoneSignalIpdu03::DoorDrvrLockSts_UB = 1.0;
//    $Backbone::VGM::CEMBackBoneSignalIpdu03::DoorLeReLockSts_UB = 1.0;
//    $Backbone::VGM::CEMBackBoneSignalIpdu03::DoorPassLockSts_UB = 1.0;
//    $Backbone::VGM::CEMBackBoneSignalIpdu03::DoorRiReLockSts_UB = 1.0;
//    $Backbone::VGM::CemBackBoneSignalIPdu25::TrSts_UB = 1.0;
//    $Backbone::VGM::CEMBackBoneSignalIpdu06::HoodSts_UB = 1.0;
    $Backbone::VCU1::VDDMBackBoneSignalIPdu02::GearLvrIndcn_UB = 1.0;
    $EscCtrlIndcn_UB = 1.0;
    $Backbone::CEM::CEMBackBoneSignalIpdu05::TrlrPrsnt_UB = 1.0;
    $DrvrPrsntQf = 3.0;
//    $Backbone::BBM::BcmVddmBackBoneSignalIPdu08::MsgReqByHillDwnCtrl_UB = 1.0;
//    $SafetyCANFD4::PAS::PASSafetyCANFD4Fr20::PrkgEmgyBrkSysSts_UB = 1.0;
//    $SafetyCANFD4::PAS::PASSafetyCANFD4Fr01::PrkgEmgyBrkEpbApplyReq_UB = 1.0;
//    $SafetyCANFD4::PAS::PASSafetyCANFD4Fr01::PrkgEmgyBrkEmgyBrkReq_UB = 1.0;
//    $Backbone::VGM::CemBackBoneSignalIPdu25::SwtIndcrIndcrTypExtReqToUpdQf = 3.0;
//    $SafetyCANFD4::PAS::PASSafetyCANFD4Fr20::DrvrAsscSysSts_UB = 1.0;
//    $PrkgAsscSysEcuTyp_UB = 1.0;
    $DrvrCrsCtrlFctActvReq_UB = 1.0;
//    $HmiDrvrSodReqChg_UB=1.0;
    
    $AsyActrActvForLgtCtrl_UB = 1.0;
//    $AsyAutDrvCtrlTypDIMReq_UB = 0.0;
    $CrsCtrlOvrdn_UB = 1.0;  
//    $CrsCtrlTiGapAdjReq = 3.0;
//    $CrsCtrlTiGapAdjReq_UB = 1.0;  
//    $DrvrACCFctDeactvnReq_UB=1;
    $LampReqByVehHld = 0.0;
    $LampReqByVehHld_UB = 1.0;  
    $VehSpdIndcdQly_UB = 1.0;  
    $VehSpdIndcdQly=1.0;///20241206 Fixed dTC
//    $BSDSwOnOffandWarnType_UB = 1.0;  
    $LcmaLedStsDrvrSide_UB = 1.0;
    $LcmaLedStsPassSide_UB = 1.0;
    $AsySftyStandStillReq_UB = 1.0; 
//    $CllsnMtgtnActvSeldSts_UB = 0.0;
    $RcwmLiActvd_UB = 0.0;  
    $Backbone::SRS::SRSBackBoneSignalIPdu04::ALat1Qf1 = 3.0;
    $Backbone::SRS::SRSBackBoneSignalIPdu04::ALgt1Qf1 = 3.0;
    
    
//    $Backbone::ASDM::ASDMBackBoneSignalIPdu03::PrkgEmgyBrkEmgyBrkReq=0;
//    $Backbone::ASDM::ASDMBackBoneSignalIPdu03::PrkgAssiSysRemPrkgSts =0;


    $AsySftyDecelEnadByVehDyn = 1.0;
    $AsySftyDecelEnadByVehDyn_UB = 1.0;  
    $HznSplyElectcSts = 0.0;///change value from 3 to 0,fix DTC 20241206
//    $ADataRawSafeALgt1Qf = 3.0;
    $ALgtStdFromWhlSpdSafeQf = 3.0;
    $Backbone::SRS::SRSBackBoneSignalIPdu04::RollRate1Qf1 = 3.0;
    $Backbone::SRS::SRSBackBoneSignalIPdu04::YawRate1Qf1 = 3.0;
    $Backbone::SRS::SRSBackBoneSignalIPdu04::ALat1Qf2 = 3.0;
    $Backbone::SRS::SRSBackBoneSignalIPdu04::YawRate1Qf2 = 3.0;
//    $BrkPedlrRatQf = 3.0;
//    $Backbone::BBM::BcmVddmBackBoneSignalIPdu03::BrkSysCylPMstActQf = 3.0;
//    $Backbone::BBM::BcmVddmBackBoneSignalIPdu03::BrkSysCylPMstVirtQf = 3.0;
//    $Backbone::VGM::CEMBackBoneSignalIpdu06::CmptmtTFrntQf = 3.0;
//    $Backbone::VDDM::VDDMBackBoneSignalIPdu18::SuspPosnVertLe1FrntQf = 3.0;
//    $Backbone::VDDM::VDDMBackBoneSignalIPdu18::SuspPosnVertLe1ReQf = 3.0;
//    $Backbone::VDDM::VDDMBackBoneSignalIPdu11::SuspPosnVertRi1SuspPosnVertRiFrntQf = 3.0;
//    $Backbone::VDDM::VDDMBackBoneSignalIPdu11::SuspPosnVertRi1SuspPosnVertRiReQf = 3.0;
//    $Backbone::VGM::CemBackBoneSignalIPdu25::SwtIndcrIndcrTypExtReqToUpdQf = 3.0;
//    $Backbone::VGM::CemBackBoneSignalIPdu25::TwliBriRawQf = 3.0;
//    $Backbone::VGM::CEMBackBoneSignalIpdu06::VehBattUSysUQf = 3.0;
    $Backbone::VCU1::VDDMBackBoneSignalIPdu01::VehSpdLgtSafeQf = 3.0;
//    $VehVLatQf = 3.0;
////////////////////////////    $WhlSpdCircumlFrntLeQf = 3.0;
    $WhlSpdCircumlFrntRiQf = 3.0;
    $WhlSpdCircumlReLeQf = 3.0;
    $WhlSpdCircumlReRiQf = 3.0;
//    $ALgtStdFromWhlSpdAndSteerAgALgtStdFromWhlSpdAndSteerAg=0;
//    $SafetyCANFD4::PAS::PASSafetyCANFD4Fr20::DrvrAsscSysSts=0;
//    $SafetyCANFD4::PAS::PASSafetyCANFD4Fr21::TBASysSts=0;
    
    //20250408_fanjunjie_add
//    $Backbone::VGM::CemBackBoneSignalIPdu25::SwtIndcrIndcrTypExtReqChks = 167;
//    $Backbone::VGM::CemBackBoneSignalIPdu25::SwtIndcrIndcrTypExtReqCntr = 0;
    setTimerCyclic(cyclicTimer, 20);
        
    $IndcrTypExtReq = 0;
    $IndcrTypExtReqToUpdQf = 3;
    
    $IndcrTurnSts1WdSts = 0;

    $DirctnIndcrStlkPos = 0;
    $Backbone::CEM::CEMBackBoneSignalIpdu27::DirctnIndcrStsDirctnIndcrSts = 0;
    $SteerAutDrvActvReq = 0;
    $SteerAutDrvDeactvnReq = 0;
    $DrvrCrsCtrlFctDeactvnReq = 0;
    $AsyLaneChgActvSts = 0;
    $EscActvCtrlIndcdToDrvr = 0;
    $AccStbOk = 1;
    $LaneKeepAidActvSts=0;
    $IntvAndWarnModForLaneKeepAidSts=0;
    
    $VehSpdIndcdUnit = 0;
    $VehSpdIndcdVal = 0;
  }
  
  
  



  
  
  
  
//on timer T1
//{
//  ////Turn on Battery, Turn on keys/// 
//  @IL::Ignition=1;
//  @IL::Power=1; 
////          $Backbone::CEM::CEMBackBoneSignalIpdu04::VehCfgPrm_UB=1;
//}
//
//on timer T2
//{
//  ////Turn on Battery, Turn on keys/// 
//  @IL::Ignition=0;
//  @IL::Power=0; 
//}
//
//on timer T3
//{
//  ////Turn on Battery, Turn on keys/// 
//  @IL::Ignition=1;
//  @IL::Power=1; 
//}



////20250408_fanjunjie_add
//on timer cyclicTimer
//{
//  $Backbone::VGM::CemBackBoneSignalIPdu25::SwtIndcrIndcrTypExtReqChks = chksValues[currentIndex];
//  $Backbone::VGM::CemBackBoneSignalIPdu25::SwtIndcrIndcrTypExtReqCntr = cntrValues[currentIndex];
//  sendCount++;
//  if(sendCount >= 6) 
//  {
//    sendCount = 0;
//    currentIndex++;
//    
//   if(currentIndex >= elcount(chksValues))
//    {
//      currentIndex = 0;
//    }
//    
//  }
//}


////20250408_fanjunjie_add
//on timer cyclicTimer
//{
//  if(@FaDC::SwtIndcrIndcrTypExtReqChks_Control==0)
//    {
//      $Backbone::VGM::CemBackBoneSignalIPdu25::SwtIndcrIndcrTypExtReqChks = 128;
//    }
//    else
//    {
//      $Backbone::VGM::CemBackBoneSignalIPdu25::SwtIndcrIndcrTypExtReqChks = chksValues[currentIndex];
////      $Backbone::VGM::CemBackBoneSignalIPdu25::SwtIndcrIndcrTypExtReqCntr = cntrValues[currentIndex];
//      sendCount++;
//      if(sendCount >= 6) 
//      {
//        sendCount = 0;
//        currentIndex++;
//        
//       if(currentIndex >= elcount(chksValues))
//        {
//          currentIndex = 0;
//        }
//      }
//      
//    }
//      if(@FaDC::SwtIndcrIndcrTypExtReqCntr_Control==0)
//    {
//      $Backbone::VGM::CemBackBoneSignalIPdu25::SwtIndcrIndcrTypExtReqCntr = 0;
//    }
//    else
//    {
//    @IL_FR1::NODES::N_VGM::PDUS::CemBackBoneSignalIPdu25::SIGGRPS::SwtIndcrIndcrTypExtReq::CNTR::Disturb=0;
////      $Backbone::VGM::CemBackBoneSignalIPdu25::SwtIndcrIndcrTypExtReqChks = chksValues[currentIndex];
//      $Backbone::VGM::CemBackBoneSignalIPdu25::SwtIndcrIndcrTypExtReqCntr = cntrValues[currentIndex];
//      sendCount++;
//      if(sendCount >= 6) 
//      {
//        sendCount = 0;
//        currentIndex++;
//        
//       if(currentIndex >= elcount(chksValues))
//        {
//          currentIndex = 0;
//        }
//      }
//      
//    }
//   
//}
  

  
  
/////////////EXPLEO//////////////    
  
on signal_update  Backbone::VCU1::VDDMBackBoneSignalIPdu01::VehSpdLgtSafeQf
{
    $Backbone::VCU1::VDDMBackBoneSignalIPdu01::VehSpdLgtSafeQf=@Carmaker2FC::VehSpdLgtA;
}    
  
on signal_update  Backbone::SRS::SRSBackBoneSignalIPdu04::ALgt1
{
    $Backbone::SRS::SRSBackBoneSignalIPdu04::ALgt1=@Carmaker2FC::ALgt1;
}    

on signal_update  Backbone::CEM::CEMBackBoneSignalIpdu02::BrkPedlValBrkPedlVal
{
    $Backbone::CEM::CEMBackBoneSignalIpdu02::BrkPedlValBrkPedlVal=@Carmaker2FC::BrkPedlValBrkPedlVal;
}  
  

on signal_update  Backbone::VCU1::VDDMBackBoneSignalIPdu04::VehVVehVLatQf
{
    $Backbone::VCU1::VDDMBackBoneSignalIPdu04::VehVVehVLatQf=@Carmaker2FC::VehVVehVLatQf;
} 
  
on signal_update  Backbone::DIM::DIMBackBoneSignalIPdu04::SetSpdForCrsCtrlFct
{
    $Backbone::DIM::DIMBackBoneSignalIPdu04::SetSpdForCrsCtrlFct=@Carmaker2FC::SetSpdForCrsCtrlFct;
}

on signal_update  Backbone::DIM::DIMBackBoneSignalIPdu04::SetSpdForDispToDrvrUnit
{
    $Backbone::DIM::DIMBackBoneSignalIPdu04::SetSpdForDispToDrvrUnit=@Carmaker2FC::SetSpdForDispToDrvrUnit;
}

on signal_update  Backbone::DIM::DIMBackBoneSignalIPdu04::SetSpdForDispToDrvrVal
{
    $Backbone::DIM::DIMBackBoneSignalIPdu04::SetSpdForDispToDrvrVal=@Carmaker2FC::SetSpdForDispToDrvrVal;
}

on signal_update  Backbone::ASDM::ASDMBackBoneSignalIPdu05::AsySftyEnaDecel
{
    $Backbone::ASDM::ASDMBackBoneSignalIPdu05::AsySftyEnaDecel=@Carmaker2FC::AsySftyEnaDecel;
}
  
on signal_update  Backbone::VCU1::VDDMBackBoneSignalIPdu02::DrvrDesDir
{
    $Backbone::VCU1::VDDMBackBoneSignalIPdu02::DrvrDesDir=@Carmaker2FC::DrvrDesDir;
 }

on signal_update  Backbone::CEM::CEMBackBoneSignalIpdu27::DirIndcrFltSts
{
    $Backbone::CEM::CEMBackBoneSignalIpdu27::DirIndcrFltSts=@Carmaker2FC::DirIndcrFltSts;
 }
//on signal_update  Backbone::VCU1::VDDMBackBoneSignalIPdu01::SteerWhlTq
//{
//    $Backbone::VCU1::VDDMBackBoneSignalIPdu01::SteerWhlTq=@Carmaker2FC::SteerWhlTq;
//}

on signal_update  Backbone::VCU1::VDDMBackBoneSignalIpdu06::VehDynCtrlStsForStandStillMgrForPark
{
    $Backbone::VCU1::VDDMBackBoneSignalIpdu06::VehDynCtrlStsForStandStillMgrForPark=@Carmaker2FC::VehDynCtrlStsForStandStillMgrForPark;
}

on signal_update  Backbone::VCU1::VDDMBackBoneSignalIpdu06::VehDynCtrlStsNotEna
{
    $Backbone::VCU1::VDDMBackBoneSignalIpdu06::VehDynCtrlStsNotEna=@Carmaker2FC::VehDynCtrlStsNotEna;
}

on signal_update  Backbone::SRS::SRSBackboneSignalIPdu01::BltLockStAtDrvrForBltLockSt1
{
    $Backbone::SRS::SRSBackboneSignalIPdu01::BltLockStAtDrvrForBltLockSt1=@Carmaker2FC::BltLockStAtDrvrForBltLockSt1;
}

on signal_update  Backbone::VCU1::VDDMBackBoneSignalIPdu02::PrpsnStsForAcc
{
    $Backbone::VCU1::VDDMBackBoneSignalIPdu02::PrpsnStsForAcc=@Carmaker2FC::PrpsnStsForAcc;
}

//on signal_update  Backbone::VCU1::VDDMBackBoneSignalIPdu01::VehMtnStSafe
//{
//    $Backbone::VCU1::VDDMBackBoneSignalIPdu01::VehMtnStSafe=@Carmaker2FC::VehMtnStSafe;
//}

//on signal_update  Backbone::DIM::DIMBackBoneSignalIPdu01::VehSpdIndcdVal{
//  if ($Backbone::DIM::DIMBackBoneSignalIPdu01::VehSpdIndcdUnit == 0){
//    //KM/h 
//    $Backbone::DIM::DIMBackBoneSignalIPdu01::VehSpdIndcdVal = @Carmaker2FC::VehSpdIndcdVal * 3.6;
//  }
//  else if ($Backbone::DIM::DIMBackBoneSignalIPdu01::VehSpdIndcdUnit == 1){
//    //mph 
//    $Backbone::DIM::DIMBackBoneSignalIPdu01::VehSpdIndcdVal = @Carmaker2FC::VehSpdIndcdVal*2.23693629;
//  }
//  else $Backbone::DIM::DIMBackBoneSignalIPdu01::VehSpdIndcdVal = @Carmaker2FC::VehSpdIndcdVal * 3.6;
//}

on signal_update  Backbone::DIM::DIMBackBoneSignalIPdu01::VehSpdIndcdUnit{
  $Backbone::DIM::DIMBackBoneSignalIPdu01::VehSpdIndcdUnit=@Carmaker2FC::VehSpdIndcdUnit;
}

on signal_update  Backbone::IHU::IHUBackBoneSignalIPdu02::UndrtkPrvntSttng{
  $Backbone::IHU::IHUBackBoneSignalIPdu02::UndrtkPrvntSttng=@Carmaker2FC::UndrtkPrvntSttng;
}

on signal_update  Backbone::DIM::DIMBackBoneSignalIPdu04::TiGapSts{
  $Backbone::DIM::DIMBackBoneSignalIPdu04::TiGapSts=@Carmaker2FC::TiGapsts;
}
  

on signal_update  Backbone::VCU1::VDDMBackBoneSignalIPdu04::WhlSpdCircumlFrntWhlSpdCircumlFrntCntr//10ms
{
  
  //VDDM_PDU1


    
    $OvrdDecelByDrvrOvrdDecelByDrvr = @Carmaker2FC::OvrdDecelByDrvrOvrdDecelByDrvr;
    
        if(@Panel::SW == 1)
    {    
      $Backbone::VCU1::VDDMBackBoneSignalIPdu01::PinionSteerAgSpd1 = @Panel::PinionSteerAgGroupPinionSteerAgSpd1;
    }
    else
    {

      $Backbone::VCU1::VDDMBackBoneSignalIPdu01::PinionSteerAgSpd1 = BypassSwitch_float(@Carmaker2FC::SteerWhlSnsrAgSpd,@Carmaker2FC::PinionSteerAgGroupPinionSteerAgSpd1*0.1);
    }
    
    $Backbone::VCU1::VDDMBackBoneSignalIPdu01::PinionSteerAgSpd1Qf=@FaDC::PinionSteerAgGroupPinionSteerAgSpd1Qf;    
 
      $Backbone::VCU1::VDDMBackBoneSignalIPdu01::SteerWhlTq = @Carmaker2FC::PinionSteerAgGroupSteerWhlTq;
      $Backbone::VCU1::VDDMBackBoneSignalIPdu01::SteerWhlTqQf=@FaDC::PinionSteerAgGroupSteerWhlTqQf;  
    
    
      $Backbone::VCU1::VDDMBackBoneSignalIPdu01::WhlDirRotlReLe = @Carmaker2FC::WhlDirRotlReLe;
      $Backbone::VCU1::VDDMBackBoneSignalIPdu01::WhlDirRotlReRi = @Carmaker2FC::WhlDirRotlReRi;
    
    
      $Backbone::VCU1::VDDMBackBoneSignalIPdu01::EpbStsEpbSts = @Carmaker2FC::EpbStsEpbSts;
      $Backbone::VCU1::VDDMBackBoneSignalIPdu01::AbsCtrlActv = @Carmaker2FC::AbsCtrlActvCtrlSts1; 
    
      $Backbone::VCU1::VDDMBackBoneSignalIPdu01::BrkPedlPsdQf=@FaDC::BrkPedlPsdQf;
      $Backbone::VCU1::VDDMBackBoneSignalIPdu01::BrkPedlPsd = @Carmaker2FC::BrkPedlPsdBrkPedlPsd;
    
      
    
      $AccStbOk = @Carmaker2FC::AccStbOk;
    //      //@FC2Carmaker_MyCarOutReturn::WhlDirRotlFrntLe=$Backbone::BBM::VddmBackBoneSignalIPdu40::WhlDirRotlFrntLe;
//      //@FC2Carmaker_MyCarOutReturn::WhlDirRotlFrntRi=$Backbone::BBM::VddmBackBoneSignalIPdu40::WhlDirRotlFrntRi;
//      //@FC2Carmaker_MyCarOutReturn::WhlDirRotlReLe=$Backbone::BBM::VddmBackBoneSignalIPdu40::WhlDirRotlReLe;
//      //@FC2Carmaker_MyCarOutReturn::WhlDirRotlReRi=$Backbone::BBM::VddmBackBoneSignalIPdu40::WhlDirRotlReRi;
    
        if(@Panel::SW == 1)
    {

      $Backbone::VCU1::VDDMBackBoneSignalIPdu01::EscCtrlIndcn = @Panel::EscCtrlIndcn;

    }
    else
    {

      $Backbone::VCU1::VDDMBackBoneSignalIPdu01::EscCtrlIndcn = @Carmaker2FC::EscCtrlIndcn;

    }
    
  $Backbone::VCU1::VDDMBackBoneSignalIPdu01::VehSpdLgtSafeQf=@FaDC::VehSpdLgtQf;    
        if(@Carmaker2FC::speed_swt==0) 
  {
    if(abs(@Carmaker2FC::VehSpdIndcdVehSpdIndcd)>0.04) 
      {
//      $Backbone::VCU1::VDDMBackBoneSignalIPdu01::VehSpdLgtSafe = abs(@Carmaker2FC::VehSpdIndcdVehSpdIndcd);
        $Backbone::VCU1::VDDMBackBoneSignalIPdu01::VehSpdLgtSafe = abs(@Carmaker2FC::VehSpdLgtA);
//     $ChassisCAN1::BBM::VddmChas1Fr05::VehSpdLgtA= abs(@Carmaker2FC::VehSpdIndcdVehSpdIndcd);    //20241204
      }
     else
    {
    $Backbone::VCU1::VDDMBackBoneSignalIPdu01::VehSpdLgtSafe = 0; 
//   $ChassisCAN1::BBM::VddmChas1Fr05::VehSpdLgtA= 0;    //20241204
     }
      
  }
    
   else
  {  
  $Backbone::VCU1::VDDMBackBoneSignalIPdu01::VehSpdLgtSafe=(@Carmaker2FC::speed)/3.6;
//  $ChassisCAN1::BBM::VddmChas1Fr05::VehSpdLgtA= (@Carmaker2FC::speed)/3.6;    //20241204
   }  
  
  //VDDM_PDU1
  
  
    //VDDM_PDU4
  
      if(@Panel::SW == 1)
    {
       $Backbone::VCU1::VDDMBackBoneSignalIPdu04::SteerWhlTqAddl = @Panel::SteerWhlTqAddl;
    }
    else
    {
       $Backbone::VCU1::VDDMBackBoneSignalIPdu04::SteerWhlTqAddl = @Carmaker2FC::SteerWhlTqAddl;
//      $ChassisCAN1::PSCM1::PscmChas1Fr02::SteerWhlTqAddl= @Carmaker2FC::SteerWhlTqAddl;
    }
  
//      $Backbone::VCU1::VDDMBackBoneSignalIPdu04::WhlSpdCircumlFrntLe = abs(@Carmaker2FC::VehSpdLgtA);
//      $Backbone::VCU1::VDDMBackBoneSignalIPdu04::WhlSpdCircumlFrntWhlSpdCircumlFrntRi = abs(@Carmaker2FC::VehSpdLgtA);
//      $Backbone::VCU1::VDDMBackBoneSignalIPdu04::WhlSpdCircumlReLe = abs(@Carmaker2FC::VehSpdLgtA);
//      $Backbone::VCU1::VDDMBackBoneSignalIPdu04::WhlSpdCircumlReRi = abs(@Carmaker2FC::VehSpdLgtA);
    
      $Backbone::VCU1::VDDMBackBoneSignalIPdu04::WhlSpdCircumlFrntLe = abs(@Carmaker2FC::WhlSpdCircumlFrntLe);
      $Backbone::VCU1::VDDMBackBoneSignalIPdu04::WhlSpdCircumlFrntWhlSpdCircumlFrntRi = abs(@Carmaker2FC::WhlSpdCircumlFrntWhlSpdCircumlFrntRi);
      $Backbone::VCU1::VDDMBackBoneSignalIPdu04::WhlSpdCircumlReLe = abs(@Carmaker2FC::WhlSpdCircumlReLe);
      $Backbone::VCU1::VDDMBackBoneSignalIPdu04::WhlSpdCircumlReRi = abs(@Carmaker2FC::WhlSpdCircumlReRi);
    

   ///calculate wheel speed ////
//      $Backbone::VCU1::VDDMBackBoneSignalIPdu04::WhlSpdCircumlFrntLeQf = @FaDC::WhlSpdCircumlFrntLeQf;
      $Backbone::VCU1::VDDMBackBoneSignalIPdu04::WhlSpdCircumlFrntRiQf = @FaDC::WhlSpdCircumlFrntRiQf;

      $Backbone::VCU1::VDDMBackBoneSignalIPdu04::WhlSpdCircumlReLeQf = @FaDC::WhlSpdCircumlReLeQf;
      $Backbone::VCU1::VDDMBackBoneSignalIPdu04::WhlSpdCircumlReRiQf = @FaDC::WhlSpdCircumlReRiQf;
  
  
    //VDDM_PDU4
  
  //SRS_PDU4
  
      $Backbone::SRS::SRSBackBoneSignalIPdu04::RollRate1Qf1=@FaDC::AgDataRawSafeRollRateQf;
    $Backbone::SRS::SRSBackBoneSignalIPdu04::ALat1Qf2=@FaDC::AsyDataWithCmpSafeALat1Qf;
    //20250325_fanjunjie_add
    $Backbone::SRS::SRSBackBoneSignalIPdu04::YawRate1Qf1=@FaDC::AgDataRawSafeYawRateQf;
    $Backbone::SRS::SRSBackBoneSignalIPdu04::YawRate1Qf2=@FaDC::AsyDataWithCmpSafeYawRateQf;  
    
    $Backbone::SRS::SRSBackBoneSignalIPdu04::YawRate1 = BypassSwitch_float(@Carmaker2FC::AgDataRawSafeYawRate_Set,@Carmaker2FC::AgDataRawSafeYawRate);
    
    
//    $Backbone::SRS::SRSBackBoneSignalIPdu04::ALatWithCmp = @Carmaker2FC::AsyDataWithCmpSafeALatWithCmp;
    $Backbone::SRS::SRSBackBoneSignalIPdu04::ALatWithCmp = @Carmaker2FC::ADataRawSafeALat;
    $Backbone::SRS::SRSBackBoneSignalIPdu04::RollRate1 = @Carmaker2FC::AgDataRawSafeRollRate;
//    $Backbone::SRS::SRSBackBoneSignalIPdu04::AsyDataWithCmpSafeGrdtOfALgt = @Carmaker2FC::AsyDataWithCmpSafeGrdtOfALgt;
//    $Backbone::SRS::SRSBackBoneSignalIPdu04::YawRateWithCmp = @Carmaker2FC::AsyDataWithCmpSafeYawRateWithCmp;          //channel modify,
    $Backbone::SRS::SRSBackBoneSignalIPdu04::YawRateWithCmp = BypassSwitch_float(@Carmaker2FC::AgDataRawSafeYawRate_Set,@Carmaker2FC::AgDataRawSafeYawRate);
    
    $Backbone::SRS::SRSBackBoneSignalIPdu04::ALat1 = BypassSwitch_float(@Carmaker2FC::ADataRawSafeALat_Set,@Carmaker2FC::ADataRawSafeALat);  
    $Backbone::SRS::SRSBackBoneSignalIPdu04::ALat1Qf1 = @FaDC::ADataRawSafeALat1Qf;
    $Backbone::SRS::SRSBackBoneSignalIPdu04::ALgt1 = BypassSwitch_float(@Carmaker2FC::ADataRawSafeALgt_Set,@Carmaker2FC::ADataRawSafeALgt);
    $Backbone::SRS::SRSBackBoneSignalIPdu04::ALgt1Qf1 =  @FaDC::ADataRawSafeALgt1Qf;
    $Backbone::SRS::SRSBackBoneSignalIPdu04::ALgt1Qf2 = 3; 
  //SRS_PDU4
  
//   $AccStbOk = @Carmaker2FC::AccStbOk;
   //  Mapping VC.key to control cannoe
    if(@Carmaker2FC::CarmakerVehKeyState == 3)
    {
      @Panel::CarmakerRunState = 1;
    }
    if(@Panel::CarmakerRunState == 1&&@Carmaker2FC::CarmakerVehKeyState ==0)
    {
      stop();
    }
    
    //// 20241207_fanjunjie comment out
  //VehMtnStVehMtnSt simulate///
//  if(@Carmaker2FC::StandStillMgrStsForHld1==0)
//      {   
//        if($Backbone::VDDM::BcmVddmBackBoneSignalIPdu06::VehSpdLgtA<0.04 )
//          {
//            $Backbone::BBM::BcmVddmBackBoneSignalIPdu06::StandStillMgrStsForHld1 = 3;
//            $Backbone::BBM::BcmVddmBackBoneSignalIPdu00::VehMtnStVehMtnSt = 1;
//          }
//        else
//        {
//          if(@Carmaker2FC::VehMtnStVehMtnSt!=5)
//          {
//            $Backbone::BBM::BcmVddmBackBoneSignalIPdu00::VehMtnStVehMtnSt = @Carmaker2FC::VehMtnStVehMtnSt;
//          }
//          else
//          {
//            $Backbone::BBM::BcmVddmBackBoneSignalIPdu00::VehMtnStVehMtnSt =5;
//          }
//          $Backbone::BBM::BcmVddmBackBoneSignalIPdu06::StandStillMgrStsForHld1 = 0;
//        }
//      }
//  else
//  {
//    $Backbone::BBM::BcmVddmBackBoneSignalIPdu06::StandStillMgrStsForHld1 = @Carmaker2FC::StandStillMgrStsForHld1;
//  }

    
    // 20241207_fanjunjie add
    if(@Carmaker2FC::VehMtnStVehMtnSt == 5 &&  @Carmaker2FC::StandStillMgrStsForHld1==0 && $Backbone::VCU1::VDDMBackBoneSignalIPdu01::VehSpdLgtSafe<0.04)
  {
    $Backbone::VCU1::VDDMBackBoneSignalIPdu15::StandStillMgrStsForHld = 3;
    $Backbone::VCU1::VDDMBackBoneSignalIPdu01::VehMtnStSafe = 1;
  }
  else if(@Carmaker2FC::VehMtnStVehMtnSt != 5)
  {
    $Backbone::VCU1::VDDMBackBoneSignalIPdu01::VehMtnStSafe= @Carmaker2FC::VehMtnStVehMtnSt;
    $Backbone::VCU1::VDDMBackBoneSignalIPdu15::StandStillMgrStsForHld = @Carmaker2FC::StandStillMgrStsForHld1;
  }
  else
  {
    $Backbone::VCU1::VDDMBackBoneSignalIPdu15::StandStillMgrStsForHld = 0;
    $Backbone::VCU1::VDDMBackBoneSignalIPdu01::VehMtnStSafe=5;
  }
  
  
//d_CSA_hmi_curve_flag
//d_ACC_Planning_Strategy
//d_SLA_current_SL
//d_SLA_unit_SL
//d_CSA_curve_goal_speed
//d_ACC_Enabled_State
//d_ACC_Target_Detected
//d_ACC_undrtk_prevn_override_active
//d_LCA_State
//
//
//d_SLA_inhibit_failure_flag
//d_SLA_ongoing_spd_adapt_flag
//d_SLA_is_curr_SL_valid
//d_SLA_prev_SL
//d_SLA_upcoming_SL_to_display
//d_SLA_is_upcoming_SL_valid
//o_LCA_Function_Status
//o_LKA_Detection_Status
//o_LDW_Function_Status
//o_LKA_Intervention_Side
//o_LKA_Function_Status
//o_SA_Function_Activation_Status
//o_Host_Lane_Width
//o_Vehicle_Position_in_Host_Lane
//d_LKA_Internal_State
//d_LDW_Internal_State
//d_LKA_Active_Function
  
  
//   //Radar Parameter///
//  $CANFD2::FLR5::FLRSafetyCANFD2Frame00::FrntRdrStsRdrStsTiStampStsGlbTiBas=1;
//  $FrntSideRdrRiStsRdrStsTiStampStsGlbTiBas=1;
//  $ReSideRdrLeStsRdrStsTiStampStsGlbTiBas=1;
//  $ReSideRdrRiStsRdrStsTiStampStsGlbTiBas=1;
//  $FrntSideRdrLeStsRdrStsTiStampStsGlbTiBas=1;
////  $Sensor_Position_ID_FLR= 4;
////  $Sensor_Position_ID_RR= 3;
////  $Sensor_Position_ID_RL =2;
////  $Sensor_Position_ID_FR= 1;
////  $Sensor_Position_ID_FL= 0;
//   $FrntSideRdrLeStsRdrNrDetn =($numNonInfraDetected_FL+$numInfrastructureDetected_FL+$numFreespaceDetections_FL);
//  $FrntSideRdrRiStsRdrNrDetn =($numNonInfraDetected_FR+$numInfrastructureDetected_FR+$numFreespaceDetections_FR);
//  $FrntRdrStsRdrNrDetn =($numNonInfraDetected_MFR+$numInfrastructureDetected_MFR+$numFreespaceDetections_MFR);
//  $ReSideRdrLeStsRdrNrDetn =($numNonInfraDetected_RL+$numInfrastructureDetected_RL+$numFreespaceDetections_RL);
//  $ReSideRdrRiStsRdrNrDetn =($numNonInfraDetected_RR+$numInfrastructureDetected_RR+$numFreespaceDetections_RR);
//  $ReSideRdrLeStsRdrStsEna = 1;
//  $ReSideRdrRiStsRdrStsEna = 1;
//  $FrntSideRdrLeStsRdrStsEna = 1;
//  $FrntSideRdrRiStsRdrStsEna = 1;
//  $CANFD2::FLR5::FLRSafetyCANFD2Frame00::FrntRdrStsRdrStsEna = 1;
//
//  $ReSideRdrLeStsForDim_UB = 1;
//  $ReSideRdrRiStsForDim_UB = 1;
//  $FrntSideRdrLeStsForDim_UB = 1;
//  $FrntSideRdrRiStsForDim_UB = 1;
//  $FrntRdrStsForDim_UB = 1;
//  $ReSideRdrLeSts0_UB = 1;
//  $ReSideRdrRiSts0_UB = 1;
//  $ReSideRdrLeSts_UB = 1;
//  $ReSideRdrRiSts_UB = 1;
//  $FrntSideRdrLeSts_UB = 1;
//  $FrntSideRdrRiSts_UB = 1;
//  $DoorDrvrStsWithFacQlyFacQly=@FaDC::DoorDrvrStsWithFacQlyFacQly;
//  //kangrui ??fadc??
//  $ReSideRdrRiStsRdrStsFaulty=@sysvar::FaDC::ReSideRdrRiStsRdrStsFaulty;
//  $ReSideRdrLeStsRdrStsFaulty=@sysvar::FaDC::ReSideRdrLeStsRdrStsFaulty;
//  $FrntSideRdrLeStsRdrStsFaulty=@sysvar::FaDC::FrntSideRdrLeStsRdrStsFaulty;
//  $FrntSideRdrRiStsRdrStsFaulty=@sysvar::FaDC::FrntSideRdrRiStsRdrStsFaulty;
//  $CANFD2::FLR5::FLRSafetyCANFD2Frame00::FrntRdrSts_UB = 1;
//  $ReSideRdrRiStsRdrStsLatency = 3;
//  $ReSideRdrLeStsRdrStsLatency = 3;
//  $FrntSideRdrRiStsRdrStsLatency = 3;
//  $FrntSideRdrLeStsRdrStsLatency = 3;
//  $FrntRdrStsRdrStsLatency = 3;
//  $ReSideRdrLeStsRdrStsTiStamp = ($TimeStamp_RL/1000000);
//  $ReSideRdrRiStsRdrStsTiStamp = ($TimeStamp_RR/1000000);
////  20240117_fanjunjie_commentout
//  $CANFD2::FLR5::FLRSafetyCANFD2Frame00::FrntRdrStsRdrStsTiStamp = ($TimeStamp_MFR/1000000);
//  $FrntSideRdrRiStsRdrStsTiStamp = ($TimeStamp_FR/1000000);
//  $FrntSideRdrLeStsRdrStsTiStamp = ($TimeStamp_FL/1000000);
////  $Active_Mode_FL=1;
////  $Active_Mode_FR=1;
//  $Active_Mode_RL=1;
//  $Active_Mode_RR=1; 
//  $Active_Mode_FLR=1; 
////  $Alignment_update_cycle_FL=0;
//  $Alignment_update_cycle_FLR=0; 
//  $Alignment_update_cycle_FR=0;
//  $Alignment_update_cycle_RL=39; 
//  $Alignment_update_cycle_RR=28; 
////  $Velocity_Correction_FL=0;
//  $Velocity_Correction_FLR=0;
//  $Velocity_Correction_FR=0;
//  $Velocity_Correction_RL=0.0113;
//  $Velocity_Correction_RR=0.0113;
//  
//  $Sensor_Pos_X_FLR=3.7573;
//  $Sensor_Pos_Y_FLR=-0.00747;
//  $Sensor_Pos_Z_FLR=0.38683;
//  $Sensor_Orientation_Angle_FLR=0;
//  $Orientation_Angle_FLR=0; 
//  $Sensor_FoV_Min_FLR=30;
//  $Sensor_FoV_Max_FLR=150;
//  
////  $Sensor_Pos_X_FL=3.4787;
////  $Sensor_Pos_Y_FL=0.81384;
////  $Sensor_Pos_Z_FL=0.40426;
////  $Sensor_Orientation_Angle_FL=0;
////  $Orientation_Angle_FL=50;
////  $Sensor_FoV_Min_FL=15;
////  $Sensor_FoV_Max_FL=165;
//  
//  $Sensor_Pos_X_FR=3.4787;
//  $Sensor_Pos_Y_FR=-0.81384;
//  $Sensor_Pos_Z_FR=0.40492;
//  $Sensor_Orientation_Angle_FR=-0;
//  $Orientation_Angle_FR=-50;
//  $Sensor_FoV_Min_FR=15;
//  $Sensor_FoV_Max_FR=165;
//  
//  $Sensor_Pos_X_RL=-0.7924;
//  $Sensor_Pos_Y_RL=0.74937;
//  $Sensor_Pos_Z_RL=0.66912;
//  $Sensor_Orientation_Angle_RL=0;
//  $Orientation_Angle_RL=135;
//  $Sensor_FoV_Min_RL=15;
//  $Sensor_FoV_Max_RL=165;
//
//  $Sensor_Pos_X_RR=-0.7924;
//  $Sensor_Pos_Y_RR=-0.74937;
//  $Sensor_Pos_Z_RR=0.66846;
//  $Sensor_Orientation_Angle_RR=0;
//  $Orientation_Angle_RR=-135;
//  $Sensor_FoV_Min_RR=15;  
//  $Sensor_FoV_Max_RR=165;
  
//  $TEMP_RX0_SENS_FL=45;
//  $TEMP_RX1_SENS_FL=45; 
//  $TEMP_RX2_SENS_FL=45;
//  $TEMP_RX3_SENS_FL=45; 
//  $TEMP_TX0_SENS_FL=45;
//  $TEMP_TX1_SENS_FL=45; 
//  $TEMP_TX2_SENS_FL=45;
//  $TSENSE0_FL=45;
//  $TSENSE1_FL=45;
//  $TSENSE2_FL=45;
//  $TEMP_PM_SENS_FL=45;
//  $TEMP_RX0_SENS_FR=45;
//  $TEMP_RX1_SENS_FR=45; 
//  $TEMP_RX2_SENS_FR=45;
//  $TEMP_RX3_SENS_FR=45; 
//  $TEMP_TX0_SENS_FR=45;
//  $TEMP_TX1_SENS_FR=45; 
//  $TEMP_TX2_SENS_FR=45;
//  $TSENSE0_FR=45;
//  $TSENSE1_FR=45;
//  $TSENSE2_FR=45;
//  $TEMP_PM_SENS_FR=45;
//  $TEMP_RX0_SENS_FLR=45;
//  $TEMP_RX1_SENS_FLR=45; 
//  $TEMP_RX2_SENS_FLR=45;
//  $TEMP_RX3_SENS_FLR=45; 
//  $TEMP_TX0_SENS_FLR=45;
//  $TEMP_TX1_SENS_FLR=45; 
//  $TEMP_TX2_SENS_FLR=45;
//  $TSENSE0_FLR=45;
//  $TSENSE1_FLR=45;
//  $TSENSE2_FLR=45;
//  $TEMP_PM_SENS_FLR=45;
//  $TEMP_RX0_SENS_RL=45;
//  $TEMP_RX1_SENS_RL=45; 
//  $TEMP_RX2_SENS_RL=45;
//  $TEMP_RX3_SENS_RL=45; 
//  $TEMP_TX0_SENS_RL=45;
//  $TEMP_TX1_SENS_RL=45; 
//  $TEMP_TX2_SENS_RL=45;
//  $TSENSE0_RL=45;
//  $TSENSE1_RL=45;
//  $TSENSE2_RL=45;
//  $TEMP_PM_SENS_RL=45;
//  $TEMP_RX0_SENS_RR=45;
//  $TEMP_RX1_SENS_RR=45; 
//  $TEMP_RX2_SENS_RR=45;
//  $TEMP_RX3_SENS_RR=45; 
//  $TEMP_TX0_SENS_RR=45;
//  $TEMP_TX1_SENS_RR=45; 
//  $TEMP_TX2_SENS_RR=45;
//  $TSENSE0_RR=45;
//  $TSENSE1_RR=45;
//  $TSENSE2_RR=45;
//  $TEMP_PM_SENS_RR=45;
  
  //versions




  
//  $ReSideRdrRiStsRdrStsSftyFlt=0;
   //Radar Parameter///
  
}


  
on preStop
{
    $Backbone::SRS::SRSBackBoneSignalIPdu04::ALat1Qf2 = 0;
    $Backbone::SRS::SRSBackBoneSignalIPdu04::YawRate1Qf1 = 0;
  
    $Backbone::SRS::SRSBackBoneSignalIPdu04::YawRate1Qf2 = 0;
//    $Backbone::SRS::SRSBackBoneSignalIPdu04::AgDataRawSafeYawRateQf = 0;
}
  
//// ******Message transmit through Flexray Channel ******///
//// ******My Carin Variant******///
//  on frPDU AdcuBackBoneSignalIPdu02
//  {
//      @FC2Carmaker::AsyLatOffstSts = $Backbone::ASDM::AdcuBackBoneSignalIPdu02::AsyLatOffstSts;
//      @FC2Carmaker::AsyInformForDrvr = $Backbone::ASDM::AdcuBackBoneSignalIPdu02::AsyInformForDrvr;
//  }  
//  
//  on frPDU AdcuBackBoneSignalIPdu04
//  {
//      if(@sysvarMember::P1_DBG_DATA::P1_DBG_Signal.adsp_in_obj_vel_rel_x_cmps_0==0)
//  {
//    @sysvar::FC2Carmaker::TTC_Self = 100;
//  }
//  else
//  {
//    @sysvar::FC2Carmaker::TTC_Self =((abs(@sysvarMember::P1_DBG_DATA::P1_DBG_Signal.adsp_in_obj_box_pos_x_cm_0*1.0000)-428)/@sysvarMember::P1_DBG_DATA::P1_DBG_Signal.adsp_in_obj_vel_rel_x_cmps_0);
//  }
//      @FC2Carmaker::AsyLanChgColorDsp = $Backbone::ASDM::AdcuBackBoneSignalIPdu04::AsyLanChgColorDsp;
//      @FC2Carmaker::AsyLanChgMesg = $Backbone::ASDM::AdcuBackBoneSignalIPdu04::AsyLanChgMesg;
//      @FC2Carmaker::AsyLatDegSts = $Backbone::ASDM::AdcuBackBoneSignalIPdu04::AsyLatDegSts;
//      @FC2Carmaker::AsySodPilotCfirm = $Backbone::ASDM::AdcuBackBoneSignalIPdu04::AsySodPilotCfirm;
//      @FC2Carmaker::HmiMovgObj1ColorOfHmiMovgObj = $Backbone::ASDM::AdcuBackBoneSignalIPdu04::HmiMovgObj1ColorOfHmiMovgObj;
//      @FC2Carmaker::HmiMovgObj1DstLatOfMovgObj = $Backbone::ASDM::AdcuBackBoneSignalIPdu04::HmiMovgObj1DstLatOfMovgObj;
//      @FC2Carmaker::HmiMovgObj1DstLgtOfMovgObj = $Backbone::ASDM::AdcuBackBoneSignalIPdu04::HmiMovgObj1DstLgtOfMovgObj;
//      @FC2Carmaker::HmiMovgObj1HdDirOfMovgObj = $Backbone::ASDM::AdcuBackBoneSignalIPdu04::HmiMovgObj1HdDirOfMovgObj;
//      @FC2Carmaker::HmiMovgObj1HmiMovgObjTyp = $Backbone::ASDM::AdcuBackBoneSignalIPdu04::HmiMovgObj1HmiMovgObjTyp;
//      @FC2Carmaker::HmiMovgObj2ColorOfHmiMovgObj = $Backbone::ASDM::AdcuBackBoneSignalIPdu04::HmiMovgObj2ColorOfHmiMovgObj;
//      @FC2Carmaker::HmiMovgObj2DstLatOfMovgObj = $Backbone::ASDM::AdcuBackBoneSignalIPdu04::HmiMovgObj2DstLatOfMovgObj;
//      @FC2Carmaker::HmiMovgObj2DstLgtOfMovgObj = $Backbone::ASDM::AdcuBackBoneSignalIPdu04::HmiMovgObj2DstLgtOfMovgObj;
//      @FC2Carmaker::HmiMovgObj2HdDirOfMovgObj = $Backbone::ASDM::AdcuBackBoneSignalIPdu04::HmiMovgObj2HdDirOfMovgObj;
//      @FC2Carmaker::HmiMovgObj2HmiMovgObjTyp = $Backbone::ASDM::AdcuBackBoneSignalIPdu04::HmiMovgObj2HmiMovgObjTyp;
//      @FC2Carmaker::HmiMovgObj3ColorOfHmiMovgObj = $Backbone::ASDM::AdcuBackBoneSignalIPdu04::HmiMovgObj3ColorOfHmiMovgObj;
//      @FC2Carmaker::HmiMovgObj3DstLatOfMovgObj = $Backbone::ASDM::AdcuBackBoneSignalIPdu04::HmiMovgObj3DstLatOfMovgObj;
//      @FC2Carmaker::HmiMovgObj3DstLgtOfMovgObj = $Backbone::ASDM::AdcuBackBoneSignalIPdu04::HmiMovgObj3DstLgtOfMovgObj;
//      @FC2Carmaker::HmiMovgObj3HdDirOfMovgObj = $Backbone::ASDM::AdcuBackBoneSignalIPdu04::HmiMovgObj3HdDirOfMovgObj;
//      @FC2Carmaker::HmiMovgObj3HmiMovgObjTyp = $Backbone::ASDM::AdcuBackBoneSignalIPdu04::HmiMovgObj3HmiMovgObjTyp;
//      @FC2Carmaker::HmiMovgObj4ColorOfHmiMovgObj = $Backbone::ASDM::AdcuBackBoneSignalIPdu04::HmiMovgObj4ColorOfHmiMovgObj;
//      @FC2Carmaker::HmiMovgObj4DstLatOfMovgObj = $Backbone::ASDM::AdcuBackBoneSignalIPdu04::HmiMovgObj4DstLatOfMovgObj;
//      @FC2Carmaker::HmiMovgObj4DstLgtOfMovgObj = $Backbone::ASDM::AdcuBackBoneSignalIPdu04::HmiMovgObj4DstLgtOfMovgObj;
//      @FC2Carmaker::HmiMovgObj4HdDirOfMovgObj = $Backbone::ASDM::AdcuBackBoneSignalIPdu04::HmiMovgObj4HdDirOfMovgObj;
//      @FC2Carmaker::HmiMovgObj4HmiMovgObjTyp = $Backbone::ASDM::AdcuBackBoneSignalIPdu04::HmiMovgObj4HmiMovgObjTyp;
//      @FC2Carmaker::HmiMovgObj5ColorOfHmiMovgObj = $Backbone::ASDM::AdcuBackBoneSignalIPdu04::HmiMovgObj5ColorOfHmiMovgObj;
//      @FC2Carmaker::HmiMovgObj5DstLatOfMovgObj = $Backbone::ASDM::AdcuBackBoneSignalIPdu04::HmiMovgObj5DstLatOfMovgObj;
//      @FC2Carmaker::HmiMovgObj5DstLgtOfMovgObj = $Backbone::ASDM::AdcuBackBoneSignalIPdu04::HmiMovgObj5DstLgtOfMovgObj;
//      @FC2Carmaker::HmiMovgObj5HdDirOfMovgObj = $Backbone::ASDM::AdcuBackBoneSignalIPdu04::HmiMovgObj5HdDirOfMovgObj;
//      @FC2Carmaker::HmiMovgObj5HmiMovgObjTyp = $Backbone::ASDM::AdcuBackBoneSignalIPdu04::HmiMovgObj5HmiMovgObjTyp;
//      @FC2Carmaker::HmiMovgObj6ColorOfHmiMovgObj = $Backbone::ASDM::AdcuBackBoneSignalIPdu04::HmiMovgObj6ColorOfHmiMovgObj;
//      @FC2Carmaker::HmiMovgObj6DstLatOfMovgObj = $Backbone::ASDM::AdcuBackBoneSignalIPdu04::HmiMovgObj6DstLatOfMovgObj;
//      @FC2Carmaker::HmiMovgObj6DstLgtOfMovgObj = $Backbone::ASDM::AdcuBackBoneSignalIPdu04::HmiMovgObj6DstLgtOfMovgObj;
//      @FC2Carmaker::HmiMovgObj6HdDirOfMovgObj = $Backbone::ASDM::AdcuBackBoneSignalIPdu04::HmiMovgObj6HdDirOfMovgObj;
//      @FC2Carmaker::HmiMovgObj6HmiMovgObjTyp = $Backbone::ASDM::AdcuBackBoneSignalIPdu04::HmiMovgObj6HmiMovgObjTyp;
//  }  

//  on frPDU AdcuBackBoneSignalIPdu05
//  {
//      @FC2Carmaker::AutLaneChgSts=$Backbone::ASDM::AdcuBackBoneSignalIPdu05::AutLaneChgSts;
//      @FC2Carmaker::AsyLaneChgFailType = $Backbone::ASDM::AdcuBackBoneSignalIPdu05::AsyLaneChgFailType;
////      @FC2Carmaker::HmiMovgObj7ColorOfHmiMovgObj = $Backbone::ASDM::AdcuBackBoneSignalIPdu05::HmiMovgObj7ColorOfHmiMovgObj;
////      @FC2Carmaker::HmiMovgObj7DstLatOfMovgObj = $Backbone::ASDM::AdcuBackBoneSignalIPdu05::HmiMovgObj7DstLatOfMovgObj;
////      @FC2Carmaker::HmiMovgObj7DstLgtOfMovgObj = $Backbone::ASDM::AdcuBackBoneSignalIPdu05::HmiMovgObj7DstLgtOfMovgObj;
////      @FC2Carmaker::HmiMovgObj7HdDirOfMovgObj = $Backbone::ASDM::AdcuBackBoneSignalIPdu05::HmiMovgObj7HdDirOfMovgObj;
////      @FC2Carmaker::HmiMovgObj7HmiMovgObjTyp = $Backbone::ASDM::AdcuBackBoneSignalIPdu05::HmiMovgObj7HmiMovgObjTyp;
////      @FC2Carmaker::HmiMovgObj8ColorOfHmiMovgObj = $Backbone::ASDM::AdcuBackBoneSignalIPdu05::HmiMovgObj8ColorOfHmiMovgObj;
////      @FC2Carmaker::HmiMovgObj8DstLatOfMovgObj = $Backbone::ASDM::AdcuBackBoneSignalIPdu05::HmiMovgObj8DstLatOfMovgObj;
////      @FC2Carmaker::HmiMovgObj8DstLgtOfMovgObj = $Backbone::ASDM::AdcuBackBoneSignalIPdu05::HmiMovgObj8DstLgtOfMovgObj;
////      @FC2Carmaker::HmiMovgObj8HdDirOfMovgObj = $Backbone::ASDM::AdcuBackBoneSignalIPdu05::HmiMovgObj8HdDirOfMovgObj;
////      @FC2Carmaker::HmiMovgObj8HmiMovgObjTyp = $Backbone::ASDM::AdcuBackBoneSignalIPdu05::HmiMovgObj8HmiMovgObjTyp;
////      @FC2Carmaker::HmiMovgObj9ColorOfHmiMovgObj = $Backbone::ASDM::AdcuBackBoneSignalIPdu05::HmiMovgObj9ColorOfHmiMovgObj;
////      @FC2Carmaker::HmiMovgObj9DstLatOfMovgObj = $Backbone::ASDM::AdcuBackBoneSignalIPdu05::HmiMovgObj9DstLatOfMovgObj;
////      @FC2Carmaker::HmiMovgObj9DstLgtOfMovgObj = $Backbone::ASDM::AdcuBackBoneSignalIPdu05::HmiMovgObj9DstLgtOfMovgObj;
////      @FC2Carmaker::HmiMovgObj9HdDirOfMovgObj = $Backbone::ASDM::AdcuBackBoneSignalIPdu05::HmiMovgObj9HdDirOfMovgObj;
////      @FC2Carmaker::HmiMovgObj9HmiMovgObjTyp = $Backbone::ASDM::AdcuBackBoneSignalIPdu05::HmiMovgObj9HmiMovgObjTyp;
////      @FC2Carmaker::HmiMovgObj10ColorOfHmiMovgObj = $Backbone::ASDM::AdcuBackBoneSignalIPdu05::HmiMovgObj10ColorOfHmiMovgObj;
////      @FC2Carmaker::HmiMovgObj10DstLatOfMovgObj = $Backbone::ASDM::AdcuBackBoneSignalIPdu05::HmiMovgObj10DstLatOfMovgObj;
////      @FC2Carmaker::HmiMovgObj10DstLgtOfMovgObj = $Backbone::ASDM::AdcuBackBoneSignalIPdu05::HmiMovgObj10DstLgtOfMovgObj;
////      @FC2Carmaker::HmiMovgObj10HdDirOfMovgObj = $Backbone::ASDM::AdcuBackBoneSignalIPdu05::HmiMovgObj10HdDirOfMovgObj;
////      @FC2Carmaker::HmiMovgObj10HmiMovgObjTyp = $Backbone::ASDM::AdcuBackBoneSignalIPdu05::HmiMovgObj10HmiMovgObjTyp;
////      @FC2Carmaker::HmiMovgObj11ColorOfHmiMovgObj = $Backbone::ASDM::AdcuBackBoneSignalIPdu05::HmiMovgObj11ColorOfHmiMovgObj;
////      @FC2Carmaker::HmiMovgObj11DstLatOfMovgObj = $Backbone::ASDM::AdcuBackBoneSignalIPdu05::HmiMovgObj11DstLatOfMovgObj;
////      @FC2Carmaker::HmiMovgObj11DstLgtOfMovgObj = $Backbone::ASDM::AdcuBackBoneSignalIPdu05::HmiMovgObj11DstLgtOfMovgObj;
////      @FC2Carmaker::HmiMovgObj11HdDirOfMovgObj = $Backbone::ASDM::AdcuBackBoneSignalIPdu05::HmiMovgObj11HdDirOfMovgObj;
////      @FC2Carmaker::HmiMovgObj11HmiMovgObjTyp = $Backbone::ASDM::AdcuBackBoneSignalIPdu05::HmiMovgObj11HmiMovgObjTyp;
//    
//      $Backbone::ASDM::AdcuBackBoneSignalIPdu05::TBASysSts=@Carmaker2FC::TBASysSts;
//    
//  } 

  
  
//  20250418_fanjunjie_add
//  int PanelTypeColor(int lineType, int lineColor)
//  {
//    if (lineType==0)
//    {
//      return 0;   //no line
//    }
//    else if(lineType==1)    //solid line
//    {
//      if(lineColor==0)
//        return 1;   //grey solid line
//      else if(lineColor==1)
//        return 2;   //white solid line
//      else if(lineColor==2)
//        return 3;   //blue solid line
//      else if(lineColor==3)
//        return 4;   //red solid line
//      else if(lineColor==4)
//        return 5;   //yellow solid line
//    }
//    else if(lineType==2)    //dash line
//    {
//      if(lineColor==0)
//        return 6;   //grey dash line
//      else if(lineColor==1)
//        return 7;   //white dash line
//      else if(lineColor==2)
//        return 8;   //blue dash line
//      else if(lineColor==3)
//        return 9;   //red dash line
//      else if(lineColor==4)
//        return 10;   //yellow dash line 
//      
//    }
//  }
//  
//  
//  on signal AsyLineLeTyp
//  {
//    updateLeImage();
//  }
//    on signal AsyLineLeColor
//  {
//    updateLeImage();
//  }
//    on signal AsyLineRiTyp
//  {
//    updateRiImage();
//  }
//    on signal AsyLineRiColor
//  {
//    updateRiImage();
//  }
//  
//
//  void updateLeImage()
//  {
//    if ($AsyLineLeTyp == 1 && $AsyLineLeColor==1)
//    {
//      
//    }
//  }
//    void updateRiImage()
//  {
//
//  }
  
  
  
  
  
  
//  on frPDU AdcuBackBoneSignalIPdu06
//  {
//
//  }  

//  on frPDU AdcuBackBoneSignalIPdu07
//  {
//      @FC2Carmaker::AsyFirstTiActvn = $Backbone::ASDM::AdcuBackBoneSignalIPdu07::AsyFirstTiActvn;
//      @FC2Carmaker::AsyNoaActvSuggestSound = $Backbone::ASDM::AdcuBackBoneSignalIPdu07::AsyNoaActvSuggestSound;
//  } 
//
//  on frPDU AdcuBackBoneSignalIPdu10
//  {
//      @FC2Carmaker::AsyNoaRemindMesg = $Backbone::ASDM::AdcuBackBoneSignalIPdu10::AsyNoaRemindMesg;
//      @FC2Carmaker::AsyLanChgSod = $Backbone::ASDM::AdcuBackBoneSignalIPdu10::AsyLanChgSod;
//      @FC2Carmaker::OvrdWrnForFstActv = $Backbone::ASDM::AdcuBackBoneSignalIPdu10::OvrdWrnForFstActv;
//      @FC2Carmaker::AsyInformForDrvrSound = $Backbone::ASDM::AdcuBackBoneSignalIPdu10::AsyInformForDrvrSound;
//  }  

//  on frPDU AdcuBackBoneSignalIPdu11
//  {
//      @FC2Carmaker::HmiStaticObj1DstLatOfStaticObj = $Backbone::ASDM::AdcuBackBoneSignalIPdu11::HmiStaticObj1DstLatOfStaticObj;
//      @FC2Carmaker::HmiStaticObj1DstLgtOfStaticObj = $Backbone::ASDM::AdcuBackBoneSignalIPdu11::HmiStaticObj1DstLgtOfStaticObj;
//      @FC2Carmaker::HmiStaticObj1HmiStaticObjTyp = $Backbone::ASDM::AdcuBackBoneSignalIPdu11::HmiStaticObj1HmiStaticObjTyp;
//      @FC2Carmaker::HmiStaticObj2DstLatOfStaticObj = $Backbone::ASDM::AdcuBackBoneSignalIPdu11::HmiStaticObj2DstLatOfStaticObj;
//      @FC2Carmaker::HmiStaticObj2DstLgtOfStaticObj = $Backbone::ASDM::AdcuBackBoneSignalIPdu11::HmiStaticObj2DstLgtOfStaticObj;
//      @FC2Carmaker::HmiStaticObj2HmiStaticObjTyp = $Backbone::ASDM::AdcuBackBoneSignalIPdu11::HmiStaticObj2HmiStaticObjTyp;
//      @FC2Carmaker::HmiStaticObj3DstLatOfStaticObj = $Backbone::ASDM::AdcuBackBoneSignalIPdu11::HmiStaticObj3DstLatOfStaticObj;
//      @FC2Carmaker::HmiStaticObj3DstLgtOfStaticObj = $Backbone::ASDM::AdcuBackBoneSignalIPdu11::HmiStaticObj3DstLgtOfStaticObj;
//      @FC2Carmaker::HmiStaticObj3HmiStaticObjTyp = $Backbone::ASDM::AdcuBackBoneSignalIPdu11::HmiStaticObj3HmiStaticObjTyp;
//      @FC2Carmaker::HmiStaticObj4DstLatOfStaticObj = $Backbone::ASDM::AdcuBackBoneSignalIPdu11::HmiStaticObj4DstLatOfStaticObj;
//      @FC2Carmaker::HmiStaticObj4DstLgtOfStaticObj = $Backbone::ASDM::AdcuBackBoneSignalIPdu11::HmiStaticObj4DstLgtOfStaticObj;
//      @FC2Carmaker::HmiStaticObj4HmiStaticObjTyp = $Backbone::ASDM::AdcuBackBoneSignalIPdu11::HmiStaticObj4HmiStaticObjTyp;
//      @FC2Carmaker::HmiStaticObj5DstLatOfStaticObj = $Backbone::ASDM::AdcuBackBoneSignalIPdu11::HmiStaticObj5DstLatOfStaticObj;
//      @FC2Carmaker::HmiStaticObj5DstLgtOfStaticObj = $Backbone::ASDM::AdcuBackBoneSignalIPdu11::HmiStaticObj5DstLgtOfStaticObj;
//      @FC2Carmaker::HmiStaticObj5HmiStaticObjTyp = $Backbone::ASDM::AdcuBackBoneSignalIPdu11::HmiStaticObj5HmiStaticObjTyp;
//      @FC2Carmaker::HmiStaticObj6DstLatOfStaticObj = $Backbone::ASDM::AdcuBackBoneSignalIPdu11::HmiStaticObj6DstLatOfStaticObj;
//      @FC2Carmaker::HmiStaticObj6DstLgtOfStaticObj = $Backbone::ASDM::AdcuBackBoneSignalIPdu11::HmiStaticObj6DstLgtOfStaticObj;
//      @FC2Carmaker::HmiStaticObj6HmiStaticObjTyp = $Backbone::ASDM::AdcuBackBoneSignalIPdu11::HmiStaticObj6HmiStaticObjTyp;
//      @FC2Carmaker::HmiStaticObj7DstLatOfStaticObj = $Backbone::ASDM::AdcuBackBoneSignalIPdu11::HmiStaticObj7DstLatOfStaticObj;
//      @FC2Carmaker::HmiStaticObj7DstLgtOfStaticObj = $Backbone::ASDM::AdcuBackBoneSignalIPdu11::HmiStaticObj7DstLgtOfStaticObj;
//      @FC2Carmaker::HmiStaticObj7HmiStaticObjTyp = $Backbone::ASDM::AdcuBackBoneSignalIPdu11::HmiStaticObj7HmiStaticObjTyp;
//      @FC2Carmaker::HmiStaticObj8DstLatOfStaticObj = $Backbone::ASDM::AdcuBackBoneSignalIPdu11::HmiStaticObj8DstLatOfStaticObj;
//      @FC2Carmaker::HmiStaticObj8DstLgtOfStaticObj = $Backbone::ASDM::AdcuBackBoneSignalIPdu11::HmiStaticObj8DstLgtOfStaticObj;
//      @FC2Carmaker::HmiStaticObj8HmiStaticObjTyp = $Backbone::ASDM::AdcuBackBoneSignalIPdu11::HmiStaticObj8HmiStaticObjTyp;
//
//  }  

//  on frPDU AdmcBackBoneSignalIPdu02
//  {
//    @FC2Carmaker::AsyLanChgSodSec=$Backbone::ASDM::AdmcBackBoneSignalIPdu02::AsyLanChgSodSec;
//  }
//  
//  
//  on frPDU AdcuBackBoneSignalIPdu20
//  {
//      @FC2Carmaker::AsyLaneChgAssistSts = $Backbone::ASDM::AdcuBackBoneSignalIPdu20::AsyLaneChgAssistSts;
//  }  
// 


  
  
  on frPDU ASDMBackBoneSignalIPdu01
  {
      @FC2Carmaker::CllsnWarnIndcnRi = $Backbone::ASDM::ASDMBackBoneSignalIPdu01::CllsnWarnIndcnRi;
      @FC2Carmaker::CllsnWarnIndcnLe = $Backbone::ASDM::ASDMBackBoneSignalIPdu01::CllsnWarnIndcnLe;
    
//    @FC2Carmaker::AgCtrlTqLowrLim = $Backbone::ASDM::ASDMBackBoneSignalIPdu22::AgCtrlTqLowrLim;
//    @FC2Carmaker::AgCtrlTqUpprLim = $Backbone::ASDM::ASDMBackBoneSignalIPdu22::AgCtrlTqUpprLim;
    @FC2Carmaker::AsyPinionAgReqSafeAsyPinionAgReq = $AsyPinionAgReq;
    @FC2Carmaker::CnclReqForCrsCtrl = $CnclReqForCrsCtrl;
    @FC2Carmaker::CtraOn1 = $CtraOn1;
    
    @FC2Carmaker::RcwmBrkReq = $RcwmBrkReq;
    @FC2Carmaker::RcwmBrkMsg = $RcwmBrkMsg;
    
    @FC2Carmaker::CnclWarnLatForAutDrv = $CnclWarnLatForAutDrv;
    
    // Added for Valeo Camera Valid R300
    @FC2Carmaker::AsyLatCtrlModReq = $Backbone::ASDM::ASDMBackBoneSignalIPdu01::AsyLatCtrlModReq;
    @FC2Carmaker::SteerStsForAutDrv = $Backbone::ASDM::ASDMBackBoneSignalIPdu01::SteerStsForAutDrv;
  } 
  on frPDU ASDMBackBoneSignalIPdu02
  {
//    @FC2Carmaker::BrkPrecActv = $Backbone::ASDM::ASDMBackBoneSignalIPdu02::BrkPrecActv;
//    @FC2Carmaker::FrntVehInfFrntVehDis = $Backbone::ASDM::ASDMBackBoneSignalIPdu02::FrntVehInfFrntVehDis;
//    @FC2Carmaker::FrntVehInfFrntVehSpd = $Backbone::ASDM::ASDMBackBoneSignalIPdu02::FrntVehInfFrntVehSpd;
//    @FC2Carmaker::RctaBrkReqRctaBrkReq = $Backbone::ASDM::ASDMBackBoneSignalIPdu02::RctaBrkReqRctaBrkReq;
//    
//    @FC2Carmaker::CllsnThreat = $CllsnThreat;
  @FC2Carmaker::CtraIndcnLe = $Backbone::ASDM::ASDMBackBoneSignalIPdu02::CtraIndcnLe;
  @FC2Carmaker::CtraIndcnRi = $Backbone::ASDM::ASDMBackBoneSignalIPdu02::CtraIndcnRi;
  @FC2Carmaker::CllsnThreat = $Backbone::ASDM::ASDMBackBoneSignalIPdu02::CllsnThreat; 
  @FC2Carmaker::IntvSide = $Backbone::ASDM::ASDMBackBoneSignalIPdu02::IntvSide;
    
  @FC2Carmaker::LcmaIndcnRi = $Backbone::ASDM::ASDMBackBoneSignalIPdu02::LcmaIndcnRi;
  @FC2Carmaker::LcmaIndcnLe = $Backbone::ASDM::ASDMBackBoneSignalIPdu02::LcmaIndcnLe;
    
  @FC2Carmaker::LatMovmtWarn = $Backbone::ASDM::ASDMBackBoneSignalIPdu02::LatMovmtWarn;
  @FC2Carmaker::RcwmLiReq = $Backbone::ASDM::ASDMBackBoneSignalIPdu02::RcwmLiReq;
  @FC2Carmaker::AsySteerApplyRqrd = $Backbone::ASDM::ASDMBackBoneSignalIPdu02::AsySteerApplyRqrd;
  @FC2Carmaker::SpdOfTarForAsyCmft = $Backbone::ASDM::ASDMBackBoneSignalIPdu02::SpdOfTarForAsyCmft;
  } 

  on frPDU ASDMBackBoneSignalIPdu03
  {
  //zhoumeiyao 20250413
      @FC2Carmaker::AsyRoadCrvt = $Backbone::ASDM::ASDMBackBoneSignalIPdu03::AsyRoadCrvt;
//    $Backbone::ASDM::ASDMBackBoneSignalIPdu03::PrkgEmgyBrkEmgyBrkReq=@Carmaker2FC::PrkgEmgyBrkEmgyBrkReq;
    
//    if ($Backbone::ASDM::ASDMBackBoneSignalIPdu03::AsyLatCtrlModReqGroupAsyLatCtrlModReq !=0 )
//
//      {
//        $Backbone::VDDM::VDDMBackBoneSignalIPdu14::LatCtrlModCfmdLatCtrlMod = $Backbone::ASDM::ASDMBackBoneSignalIPdu03::AsyLatCtrlModReqGroupAsyLatCtrlModReq; 
//        $Backbone::BBM::AsyLatCtrlModReqGroupCfmdLatCtrlMod = $Backbone::ASDM::ASDMBackBoneSignalIPdu03::AsyLatCtrlModReqGroupAsyLatCtrlModReq; 
//        $ChassisCAN1::PSCM1::PscmChas1Fr02::LatCtrlModCfmdLatCtrlMod=$Backbone::ASDM::ASDMBackBoneSignalIPdu03::AsyLatCtrlModReqGroupAsyLatCtrlModReq; 
//      }
//    else
//      {
//        
//        $ChassisCAN1::PSCM1::PscmChas1Fr02::LatCtrlModCfmdLatCtrlMod=@Carmaker2FC::LatCtrlModCfmdLatCtrlMod;  
//        $Backbone::VDDM::VDDMBackBoneSignalIPdu14::LatCtrlModCfmdLatCtrlMod = @Carmaker2FC::LatCtrlModCfmdLatCtrlMod;
//        $Backbone::BBM::BcmVddmBackBoneSignalIPdu00::AsyLatCtrlModReqGroupCfmdLatCtrlMod = @Carmaker2FC::AsyLatCtrlModReqGroupCfmdLatCtrlMod;   //channel modify      
//      }
 
      
       //lat mod
 if (@Carmaker2FC::LatCtrlModCfmdLatCtrlMod ==1 )
 {
  $Backbone::VCU1::VDDMBackBoneSignalIPdu02::LatCtrlModCfmdLatCtrlMod = $Backbone::ASDM::ASDMBackBoneSignalIPdu01::AsyLatCtrlModReq; 
//  $Backbone::BBM::AsyLatCtrlModReqGroupCfmdLatCtrlMod = $Backbone::ASDM::ASDMBackBoneSignalIPdu03::AsyLatCtrlModReqGroupAsyLatCtrlModReq; 
//  $ChassisCAN1::PSCM1::PscmChas1Fr02::LatCtrlModCfmdLatCtrlMod=$Backbone::ASDM::ASDMBackBoneSignalIPdu03::AsyLatCtrlModReqGroupAsyLatCtrlModReq; 
 }
 else
 {
//  $ChassisCAN1::PSCM1::PscmChas1Fr02::LatCtrlModCfmdLatCtrlMod=@Carmaker2FC::LatCtrlModCfmdLatCtrlMod;  
  $Backbone::VCU1::VDDMBackBoneSignalIPdu02::LatCtrlModCfmdLatCtrlMod = @Carmaker2FC::LatCtrlModCfmdLatCtrlMod;
//  $Backbone::BBM::BcmVddmBackBoneSignalIPdu00::AsyLatCtrlModReqGroupCfmdLatCtrlMod = @Carmaker2FC::AsyLatCtrlModReqGroupCfmdLatCtrlMod;   //channel modify   
 }
  
      
      
      
      
//    @FC2Carmaker::SpdLimFirst =$Backbone::ASDM::ASDMBackBoneSignalIPdu03::SpdLimFirst;
//    @FC2Carmaker::AsyAutDrvgAvl = $Backbone::ASDM::ASDMBackBoneSignalIPdu03::AsyAutDrvgAvl;
//    @FC2Carmaker::AsyEmgyLaneKeepAidSts = $Backbone::ASDM::ASDMBackBoneSignalIPdu03::AsyEmgyLaneKeepAidSts;
    @FC2Carmaker::AsyLaneKeepAidSts = $Backbone::ASDM::ASDMBackBoneSignalIPdu07::LaneKeepAidSts;
//    @FC2Carmaker::AsyLatCtrlModReqGroupAsyLatCtrlModReq = $Backbone::ASDM::ASDMBackBoneSignalIPdu03::AsyLatCtrlModReqGroupAsyLatCtrlModReq;
//    @FC2Carmaker::AsySteerApplyRqrd = $Backbone::ASDM::ASDMBackBoneSignalIPdu03::AsySteerApplyRqrd;
//    @FC2Carmaker::BrkHptcWarnReqForAutDrvBrkHptcWarnReqForAutDrv = $Backbone::ASDM::ASDMBackBoneSignalIPdu03::BrkHptcWarnReqForAutDrvBrkHptcWarnReqForAutDrv;          //channel modify,
//
//    @FC2Carmaker::IntvAndWarnModInfoSts = $Backbone::ASDM::ASDMBackBoneSignalIPdu03::IntvAndWarnModInfoSts;
//    @FC2Carmaker::LaneChgAutInfoForAsyHiWay = $Backbone::ASDM::ASDMBackBoneSignalIPdu03::LaneChgAutInfoForAsyHiWay;
//    @FC2Carmaker::LaneChgAutStsForAsyHiWay = $Backbone::ASDM::ASDMBackBoneSignalIPdu03::LaneChgAutStsForAsyHiWay;
//    @FC2Carmaker::LaneChgWarnSts = $Backbone::ASDM::ASDMBackBoneSignalIPdu03::LaneChgWarnSts;
//    @FC2Carmaker::LaneKeepAidInfoSts = $Backbone::ASDM::ASDMBackBoneSignalIPdu03::LaneKeepAidInfoSts;
//    @FC2Carmaker::LcmaAudWarn = $Backbone::ASDM::ASDMBackBoneSignalIPdu03::LcmaAudWarn;
//    @FC2Carmaker::LcmaIndcnLe = $Backbone::ASDM::ASDMBackBoneSignalIPdu03::LcmaIndcnLe;
//    @FC2Carmaker::LcmaIndcnRi = $Backbone::ASDM::ASDMBackBoneSignalIPdu03::LcmaIndcnRi;
//    @FC2Carmaker::RctaIndcnLe = $Backbone::ASDM::ASDMBackBoneSignalIPdu03::RctaIndcnLe;
//    @FC2Carmaker::RctaIndcnRi = $Backbone::ASDM::ASDMBackBoneSignalIPdu03::RctaIndcnRi;
//    @FC2Carmaker::RcwmBrkReqRcwmBrkReq = $Backbone::ASDM::ASDMBackBoneSignalIPdu03::RcwmBrkReqRcwmBrkReq;
//    @FC2Carmaker::SelfLaneColor = $Backbone::ASDM::ASDMBackBoneSignalIPdu03::SelfLaneColor;
//
//    @FC2Carmaker::TiGapSetForLgtCtrl = $Backbone::ASDM::ASDMBackBoneSignalIPdu03::TiGapSetForLgtCtrl;
//    @FC2Carmaker::WarnForAsyEmgyLaneKeepAid = $Backbone::ASDM::ASDMBackBoneSignalIPdu03::WarnForAsyEmgyLaneKeepAid;
  } 

  on frPDU ASDMBackBoneSignalIPdu04
  {
   @FC2Carmaker::AsyALgtReqForCmft  = $AsyALgtReqForCmft;
   @FC2Carmaker::AsyALgtReqForCmftAsyCmftLgtNegLimForJerk = $AsyCmftLgtNegLimForJerk;
   @FC2Carmaker::AsyALgtReqForCmftAsyCmftLgtPosLimForJerk = $AsyCmftLgtPosLimForJerk;

    
    
    
    
//    @FC2Carmaker::AsyALgtCtrlMod1 = $Backbone::ASDM::ASDMBackBoneSignalIPdu04::AsyALgtCtrlMod1;         
//    @FC2Carmaker::AsySftyEnaDecelByDBSAsySftyEnaDecelByDBS = $Backbone::ASDM::ASDMBackBoneSignalIPdu04::AsySftyEnaDecelByDBSAsySftyEnaDecelByDBS;
//    @FC2Carmaker::DoorOpenwarnLeIndcn = $Backbone::ASDM::ASDMBackBoneSignalIPdu04::DoorOpenwarnLeIndcn;
//    @FC2Carmaker::DoorOpenwarnRiIndcn = $Backbone::ASDM::ASDMBackBoneSignalIPdu04::DoorOpenwarnRiIndcn;
//    @FC2Carmaker::StopReqOfLgtCtrlForPrpsn = $Backbone::ASDM::ASDMBackBoneSignalIPdu04::StopReqOfLgtCtrlForPrpsn;
//    @FC2Carmaker::StrtReqOfLgtCtrlForPrpsn = $Backbone::ASDM::ASDMBackBoneSignalIPdu04::StrtReqOfLgtCtrlForPrpsn;
//    @FC2Carmaker::RoadSgnInfoSts = $Backbone::ASDM::ASDMBackBoneSignalIPdu04::RoadSgnInfoSts;
  } 

    on frPDU ASDMBackBoneSignalIPdu05
  {
    @FC2Carmaker::SftyDecelGroupSafeAsySftyDecelReq = $AsySftyDecelReq;
    @FC2Carmaker::SftyDecelGroupSafeAsySftyEnaDecel = $AsySftyEnaDecel;
    @FC2Carmaker::SteerIntvStsForSftyLaneKeepAid = $SteerIntvStsForSftyLaneKeepAid;
  } 
  
  on frPDU ASDMBackBoneSignalIPdu06
  {
//    @FC2Carmaker::AsyNoaActvSuggest = $Backbone::ASDM::ASDMBackBoneSignalIPdu06::AsyNoaActvSuggest;
    @FC2Carmaker::SpdLimAdpvSts = $Backbone::ASDM::ASDMBackBoneSignalIPdu06::SpdLimAdpvSts;
    @FC2Carmaker::SteerWarnReqForLaneKeepAid = $Backbone::ASDM::ASDMBackBoneSignalIPdu06::SteerWarnReqForLaneKeepAid;
    @FC2Carmaker::LaneDetnStsForLaneKeepAid = $Backbone::ASDM::ASDMBackBoneSignalIPdu06::LaneDetnStsForLaneKeepAid;
    
    @FC2Carmaker::SteerIntvSts = $Backbone::ASDM::ASDMBackBoneSignalIPdu06::SteerIntvSts;
    
    @FC2Carmaker::AsySftyStandStillReq = $Backbone::ASDM::ASDMBackBoneSignalIPdu06::AsySftyStandStillReq;
    
    @FC2Carmaker::SteerAutDrvActvnOk = $Backbone::ASDM::ASDMBackBoneSignalIPdu06::SteerAutDrvActvnOk;
    @FC2Carmaker::SteerWarnSts = $Backbone::ASDM::ASDMBackBoneSignalIPdu06::SteerWarnSts;
    @FC2Carmaker::AsySteerWhlHptcWarnReq = $Backbone::ASDM::ASDMBackBoneSignalIPdu06::AsySteerWhlHptcWarnReq;
    @FC2Carmaker::CllsnAidPostEve = $Backbone::ASDM::ASDMBackBoneSignalIPdu06::CllsnAidPostEve;
    @FC2Carmaker::CrvtSpdAdpvSts = $Backbone::ASDM::ASDMBackBoneSignalIPdu06::CrvtSpdAdpvSts;
    @FC2Carmaker::SpdTarForDisp = $Backbone::ASDM::ASDMBackBoneSignalIPdu06::SpdTarForDisp;
    @FC2Carmaker::DirOfCrvtSpdCtrlForAutDrv = $Backbone::ASDM::ASDMBackBoneSignalIPdu06::DirOfCrvtSpdCtrlForAutDrv;
    @FC2Carmaker::SetSpdSelnForAutDrv = $Backbone::ASDM::ASDMBackBoneSignalIPdu06::SetSpdSelnForAutDrv;
    @FC2Carmaker::CnclWarnLgtForAutDrv = $Backbone::ASDM::ASDMBackBoneSignalIPdu06::CnclWarnLgtForAutDrv;
  }
    
  on frPDU ASDMBackBoneSignalIPdu07
  {
    @FC2Carmaker::EscalatedEmgyStopVisWarnReq = $Backbone::ASDM::ASDMBackBoneSignalIPdu07::EscalatedEmgyStopVisWarnReq;
    @FC2Carmaker::SpdLimUnit = $Backbone::ASDM::ASDMBackBoneSignalIPdu07::SpdLimUnit;
    @FC2Carmaker::SpdLimSec = $Backbone::ASDM::ASDMBackBoneSignalIPdu07::SpdLimSec;
    @FC2Carmaker::RsdsSysStsLeCtraSts1 = $Backbone::ASDM::ASDMBackBoneSignalIPdu07::RsdsSysStsLeCtraSts1;
    @FC2Carmaker::RsdsSysStsLeCtraSts = $Backbone::ASDM::ASDMBackBoneSignalIPdu07::RsdsSysStsLeCtraSts;
    @FC2Carmaker::RsdsSysStsRiCtraSts1 = $Backbone::ASDM::ASDMBackBoneSignalIPdu07::RsdsSysStsRiCtraSts1;
    @FC2Carmaker::RsdsSysStsRiCtraSts = $Backbone::ASDM::ASDMBackBoneSignalIPdu07::RsdsSysStsRiCtraSts;
    
    @FC2Carmaker::LcmaOn1 = $Backbone::ASDM::ASDMBackBoneSignalIPdu07::LcmaOn1;
    @FC2Carmaker::RsdsSysStsRiLcmaSts1 = $Backbone::ASDM::ASDMBackBoneSignalIPdu07::RsdsSysStsRiLcmaSts1;
    @FC2Carmaker::RsdsSysStsLeLcmaSts = $Backbone::ASDM::ASDMBackBoneSignalIPdu07::RsdsSysStsLeLcmaSts;
    @FC2Carmaker::VehTarDetd = $Backbone::ASDM::ASDMBackBoneSignalIPdu07::VehTarDetd;
    @FC2Carmaker::AvlStsForLatAutDrv = $Backbone::ASDM::ASDMBackBoneSignalIPdu07::AvlStsForLatAutDrv;
    @FC2Carmaker::AvlStsForLongAutDrv = $Backbone::ASDM::ASDMBackBoneSignalIPdu07::AvlStsForLongAutDrv;
    @FC2Carmaker::UndrtknPrevnWarnReq = $Backbone::ASDM::ASDMBackBoneSignalIPdu07::UndrtknPrevnWarnReq;
    @FC2Carmaker::RngOfTar = $Backbone::ASDM::ASDMBackBoneSignalIPdu07::RngOfTar;
    @FC2Carmaker::LaneKeepAidSts = $Backbone::ASDM::ASDMBackBoneSignalIPdu07::LaneKeepAidSts;
    @FC2Carmaker::LaneChgWarnSts = $Backbone::ASDM::ASDMBackBoneSignalIPdu07::LaneChgWarnSts;
    @FC2Carmaker::SpdLimFirst = $Backbone::ASDM::ASDMBackBoneSignalIPdu07::SpdLimFirst;
    
  }   
  
    on frPDU ASDMBackBoneSignalIPdu08
  {  
  @FC2Carmaker::AsyHostLanePptyVehPosnInLane = $Backbone::ASDM::ASDMBackBoneSignalIPdu08::AsyHostLanePptyVehPosnInLane;
  @FC2Carmaker::AsyHostLanePptyLaneWidth = $Backbone::ASDM::ASDMBackBoneSignalIPdu08::AsyHostLanePptyLaneWidth;
  @FC2Carmaker::AsyLaneChgTyp = $Backbone::ASDM::ASDMBackBoneSignalIPdu08::AsyLaneChgTyp;
  @FC2Carmaker::AsyLaneChgSts = $Backbone::ASDM::ASDMBackBoneSignalIPdu08::AsyLaneChgSts;
  @FC2Carmaker::AsyLaneChgPsbl = $Backbone::ASDM::ASDMBackBoneSignalIPdu08::AsyLaneChgPsbl;
  @FC2Carmaker::SteerAsscCtrlActv = $Backbone::ASDM::ASDMBackBoneSignalIPdu08::SteerAsscCtrlActv;
  } 
  
    on frPDU ASDMBackBoneSignalIPdu09
  {  
   @FC2Carmaker::SftyCchLaneKeepAidStsActv = $Backbone::ASDM::ASDMBackBoneSignalIPdu09::SftyCchLaneKeepAidStsActv;
   @FC2Carmaker::DoorOpenWarnRi = $Backbone::ASDM::ASDMBackBoneSignalIPdu09::DoorOpenWarnRi;
   @FC2Carmaker::DoorOpenWarnLe = $Backbone::ASDM::ASDMBackBoneSignalIPdu09::DoorOpenWarnLe;
   @FC2Carmaker::DriveAwayInfoWarnReqVisWarnReq = $Backbone::ASDM::ASDMBackBoneSignalIPdu09::DriveAwayInfoWarnReqVisWarnReq;
   @FC2Carmaker::DriveAwayInfoWarnReqAudWarnReq = $Backbone::ASDM::ASDMBackBoneSignalIPdu09::DriveAwayInfoWarnReqAudWarnReq;
   @FC2Carmaker::AsyALgtReqRngForCmftMax = $AsyALgtReqRngForCmftMax;
   @FC2Carmaker::AsyALgtReqRngForCmftMin = $AsyALgtReqRngForCmftMin;
   @FC2Carmaker::AEBFctSts = $Backbone::ASDM::ASDMBackBoneSignalIPdu09::AEBFctSts;
  } 

  
  on frPDU ASDMBackBoneSignalIPdu10
  {
    @FC2Carmaker::SpdAdjmtEveForAutDrv = $Backbone::ASDM::ASDMBackBoneSignalIPdu10::SpdAdjmtEveForAutDrv;
    @FC2Carmaker::CtaFnSts = $Backbone::ASDM::ASDMBackBoneSignalIPdu10::CtaFnSts;
    @FC2Carmaker::CtaBrkFnSts = $Backbone::ASDM::ASDMBackBoneSignalIPdu10::CtaBrkFnSts;
    @FC2Carmaker::SpdLimAdpvActv = $Backbone::ASDM::ASDMBackBoneSignalIPdu10::SpdLimAdpvActv;
//  @FC2Carmaker::AsyALgtStsAsyALgtSts = $Backbone::ASDM::ASDMBackBoneSignalIPdu10::AsyALgtStsAsyALgtSts;
//  @FC2Carmaker::AsyLgtCtrlTakeOverReq = $Backbone::ASDM::ASDMBackBoneSignalIPdu10::AsyLgtCtrlTakeOverReq;
//  @FC2Carmaker::CllsnFwdWarn = $Backbone::ASDM::ASDMBackBoneSignalIPdu10::CllsnFwdWarn;
//  @FC2Carmaker::DoorOpenwarnOn1 = $Backbone::ASDM::ASDMBackBoneSignalIPdu10::DoorOpenwarnOn1;
//  @FC2Carmaker::HWALeadingPointCenterX = $Backbone::ASDM::ASDMBackBoneSignalIPdu10::HWALeadingPointCenterX;
//  @FC2Carmaker::HWALeadingPointCenterY = $Backbone::ASDM::ASDMBackBoneSignalIPdu10::HWALeadingPointCenterY;
//  @FC2Carmaker::HWALeadingPointValid = $Backbone::ASDM::ASDMBackBoneSignalIPdu10::HWALeadingPointValid;
//  @FC2Carmaker::RsdsSysSts = $Backbone::ASDM::ASDMBackBoneSignalIPdu10::RsdsSysSts;
//  @FC2Carmaker::SteerTqAddlForEmaSteerTqAddlForEma = $Backbone::ASDM::ASDMBackBoneSignalIPdu10::SteerTqAddlForEmaSteerTqAddlForEma;
  } 

  
  
  on frPDU ASDMBackBoneSignalIPdu11
    {
//    @FC2Carmaker::AsyALatIndcr = $Backbone::ASDM::ASDMBackBoneSignalIPdu11::AsyALatIndcr;
//    @FC2Carmaker::AsyALgtIndcr = $Backbone::ASDM::ASDMBackBoneSignalIPdu11::AsyALgtIndcr;

//    @FC2Carmaker::AsyEmgyManoeuvreAidSts = $Backbone::ASDM::ASDMBackBoneSignalIPdu11::AsyEmgyManoeuvreAidSts;
//    @FC2Carmaker::AsySftyStandStillReq = $Backbone::ASDM::ASDMBackBoneSignalIPdu11::AsySftyStandStillReq;
//    @FC2Carmaker::AsyStandStillReqForCmft = $Backbone::ASDM::ASDMBackBoneSignalIPdu11::AsyStandStillReqForCmft;
//    @FC2Carmaker::AsySteerWhlHptcWarnReq = $Backbone::ASDM::ASDMBackBoneSignalIPdu11::AsySteerWhlHptcWarnReq;
//    @FC2Carmaker::AvlStsForLongAutDrv = $Backbone::ASDM::ASDMBackBoneSignalIPdu11::AvlStsForLongAutDrv;
//    @FC2Carmaker::CamStatus0 = $Backbone::ASDM::ASDMBackBoneSignalIPdu11::CamStatus0;
//    @FC2Carmaker::CllsnAidPost = $Backbone::ASDM::ASDMBackBoneSignalIPdu11::CllsnAidPost;
//    @FC2Carmaker::CllsnMtgtnFaultSts = $Backbone::ASDM::ASDMBackBoneSignalIPdu11::CllsnMtgtnFaultSts;
//    @FC2Carmaker::CllsnMtgtnOnoffSts = $Backbone::ASDM::ASDMBackBoneSignalIPdu11::CllsnMtgtnOnoffSts;
//    @FC2Carmaker::CllsnWarnReIndcn = $Backbone::ASDM::ASDMBackBoneSignalIPdu11::CllsnWarnReIndcn;
//    @FC2Carmaker::CnclWarnForAutDrv = $Backbone::ASDM::ASDMBackBoneSignalIPdu11::CnclWarnForAutDrv;
//    @FC2Carmaker::CnclWarnLgtForAutDrv = $Backbone::ASDM::ASDMBackBoneSignalIPdu11::CnclWarnLgtForAutDrv;
//    @FC2Carmaker::DrvOffReqForLgtCtrl = $Backbone::ASDM::ASDMBackBoneSignalIPdu11::DrvOffReqForLgtCtrl;
//    @FC2Carmaker::FctaIndcnLe = $Backbone::ASDM::ASDMBackBoneSignalIPdu11::FctaIndcnLe;
//    @FC2Carmaker::FctaIndcnRi = $Backbone::ASDM::ASDMBackBoneSignalIPdu11::FctaIndcnRi;
//    @FC2Carmaker::FrntRdrSts0 = $Backbone::ASDM::ASDMBackBoneSignalIPdu11::FrntRdrSts0;
//    @FC2Carmaker::FrntSideRdrLeSts0 = $Backbone::ASDM::ASDMBackBoneSignalIPdu11::FrntSideRdrLeSts0;
//    @FC2Carmaker::FrntSideRdrRiSts0 = $Backbone::ASDM::ASDMBackBoneSignalIPdu11::FrntSideRdrRiSts0;
//    @FC2Carmaker::IHUSetDispAD = $Backbone::ASDM::ASDMBackBoneSignalIPdu11::IHUSetDispAD;
//    @FC2Carmaker::ReSideRdrLeSts0 = $Backbone::ASDM::ASDMBackBoneSignalIPdu11::ReSideRdrLeSts0;
//    @FC2Carmaker::ReSideRdrRiSts0 = $Backbone::ASDM::ASDMBackBoneSignalIPdu11::ReSideRdrRiSts0;
//    @FC2Carmaker::ADDimLight = $Backbone::ASDM::ASDMBackBoneSignalIPdu11::ADDimLight;
//    @FC2Carmaker::AsyWarnForSteerCncl = $Backbone::ASDM::ASDMBackBoneSignalIPdu11::AsyWarnForSteerCncl;
//    
//      @FC2Carmaker::ADThemeDisp = $ADThemeDisp;
      
      @FC2Carmaker::DriveAwayInfoActvSts = $Backbone::ASDM::ASDMBackBoneSignalIPdu11::DriveAwayInfoActvSts;
    } 

  
  on frPDU ASDMBackBoneSignalIPdu12
  {  
  @FC2Carmaker::CtaIndcnRi = $Backbone::ASDM::ASDMBackBoneSignalIPdu12::CtaIndcnRi;
  @FC2Carmaker::CtaIndcnLe = $Backbone::ASDM::ASDMBackBoneSignalIPdu12::CtaIndcnLe;
  } 
  
//  on frPDU ASDMBackBoneSignalIPdu13
//  {
//    @FC2Carmaker::AsyEmgyLaneKeepAid = $Backbone::ASDM::ASDMBackBoneSignalIPdu13::AsyEmgyLaneKeepAid;
//    @FC2Carmaker::AsyFctnIhbtByTrlr = $Backbone::ASDM::ASDMBackBoneSignalIPdu13::AsyFctnIhbtByTrlr;
//    @FC2Carmaker::AsyLaneChgWarnMod = $Backbone::ASDM::ASDMBackBoneSignalIPdu13::AsyLaneChgWarnMod;
//    @FC2Carmaker::AsyObjType = $Backbone::ASDM::ASDMBackBoneSignalIPdu13::AsyObjType;
//    @FC2Carmaker::AsySftyHWLReq = $Backbone::ASDM::ASDMBackBoneSignalIPdu13::AsySftyHWLReq;
//    @FC2Carmaker::CllsnAidPostEMA = $Backbone::ASDM::ASDMBackBoneSignalIPdu13::CllsnAidPostEMA;
//    @FC2Carmaker::CllsnMtgtnFctSts = $Backbone::ASDM::ASDMBackBoneSignalIPdu13::CllsnMtgtnFctSts;
//    @FC2Carmaker::CllsnMtgtnWarnSts = $Backbone::ASDM::ASDMBackBoneSignalIPdu13::CllsnMtgtnWarnSts;
//    @FC2Carmaker::CllsnWarnReOn1 = $Backbone::ASDM::ASDMBackBoneSignalIPdu13::CllsnWarnReOn1;
//    @FC2Carmaker::CtraOn1 = $Backbone::ASDM::ASDMBackBoneSignalIPdu13::CtraOn1;
//    @FC2Carmaker::LaneChgAutActvSts = $Backbone::ASDM::ASDMBackBoneSignalIPdu13::LaneChgAutActvSts;
//    @FC2Carmaker::LcmaOn = $Backbone::ASDM::ASDMBackBoneSignalIPdu13::LcmaOn;
//    @FC2Carmaker::RcwmLiReq = $Backbone::ASDM::ASDMBackBoneSignalIPdu13::RcwmLiReq;
//    @FC2Carmaker::TurnIndicReqByALCA = $Backbone::ASDM::ASDMBackBoneSignalIPdu13::TurnIndicReqByALCA;
//
//    //20250219_fanjunjie_add
//    $Backbone::ASDM::ASDMBackBoneSignalIPdu13::VehHomePrkgSysSts = @Carmaker2FC::VehHomePrkgSysSts;
//  }
  
  on frPDU ASDMBackBoneSignalIPdu14
  {
//    @FC2Carmaker::NonTrvrsbleRoadEdgeOnLeft = $Backbone::ASDM::ASDMBackBoneSignalIPdu14::NonTrvrsbleRoadEdgeOnLeft;
//    @FC2Carmaker::NonTrvrsbleRoadEdgeOnRight = $Backbone::ASDM::ASDMBackBoneSignalIPdu14::NonTrvrsbleRoadEdgeOnRight;
//    @FC2Carmaker::ObjFrnt1ColorOfObjFrnt1 = $Backbone::ASDM::ASDMBackBoneSignalIPdu14::ObjFrnt1ColorOfObjFrnt1;
//    @FC2Carmaker::ObjFrnt1DstLatOfObjFrnt1 = $Backbone::ASDM::ASDMBackBoneSignalIPdu14::ObjFrnt1DstLatOfObjFrnt1;
//    @FC2Carmaker::ObjFrnt1DstLgtOfObjFrnt1 = $Backbone::ASDM::ASDMBackBoneSignalIPdu14::ObjFrnt1DstLgtOfObjFrnt1;
//    @FC2Carmaker::ObjFrnt1HdDirOfObjFrnt1 = $Backbone::ASDM::ASDMBackBoneSignalIPdu14::ObjFrnt1HdDirOfObjFrnt1;
//    @FC2Carmaker::ObjFrnt1TypOfObjFrnt1 = $Backbone::ASDM::ASDMBackBoneSignalIPdu14::ObjFrnt1TypOfObjFrnt1;
//    @FC2Carmaker::ObjFrnt2ColorOfObjFrnt2 = $Backbone::ASDM::ASDMBackBoneSignalIPdu14::ObjFrnt2ColorOfObjFrnt2;
//    @FC2Carmaker::ObjFrnt2DstLatOfObjFrnt2 = $Backbone::ASDM::ASDMBackBoneSignalIPdu14::ObjFrnt2DstLatOfObjFrnt2;
//    @FC2Carmaker::ObjFrnt2DstLgtOfObjFrnt2 = $Backbone::ASDM::ASDMBackBoneSignalIPdu14::ObjFrnt2DstLgtOfObjFrnt2;
//    @FC2Carmaker::ObjFrnt2HdDirOfObjFrnt2 = $Backbone::ASDM::ASDMBackBoneSignalIPdu14::ObjFrnt2HdDirOfObjFrnt2;
//    @FC2Carmaker::ObjFrnt2TypOfObjFrnt2 = $Backbone::ASDM::ASDMBackBoneSignalIPdu14::ObjFrnt2TypOfObjFrnt2;
//    @FC2Carmaker::ObjFrntLeColorOfObjFrntLe = $Backbone::ASDM::ASDMBackBoneSignalIPdu14::ObjFrntLeColorOfObjFrntLe;
//    @FC2Carmaker::ObjFrntLeDstLatOfObjFrntLe = $Backbone::ASDM::ASDMBackBoneSignalIPdu14::ObjFrntLeDstLatOfObjFrntLe;
//    @FC2Carmaker::ObjFrntLeDstLgtOfObjFrntLe = $Backbone::ASDM::ASDMBackBoneSignalIPdu14::ObjFrntLeDstLgtOfObjFrntLe;
//    @FC2Carmaker::ObjFrntLeHdDirOfObjFrntLe = $Backbone::ASDM::ASDMBackBoneSignalIPdu14::ObjFrntLeHdDirOfObjFrntLe;
//    @FC2Carmaker::ObjFrntLeTypOfObjFrntLe = $Backbone::ASDM::ASDMBackBoneSignalIPdu14::ObjFrntLeTypOfObjFrntLe;
//    @FC2Carmaker::ObjFrntRiColorOfObjFrntRi = $Backbone::ASDM::ASDMBackBoneSignalIPdu14::ObjFrntRiColorOfObjFrntRi;
//    @FC2Carmaker::ObjFrntRiDstLatOfObjFrntRi = $Backbone::ASDM::ASDMBackBoneSignalIPdu14::ObjFrntRiDstLatOfObjFrntRi;
//    @FC2Carmaker::ObjFrntRiDstLgtOfObjFrntRi = $Backbone::ASDM::ASDMBackBoneSignalIPdu14::ObjFrntRiDstLgtOfObjFrntRi;
//    @FC2Carmaker::ObjFrntRiHdDirOfObjFrntRi = $Backbone::ASDM::ASDMBackBoneSignalIPdu14::ObjFrntRiHdDirOfObjFrntRi;
//    @FC2Carmaker::ObjFrntRiTypOfObjFrntRi = $Backbone::ASDM::ASDMBackBoneSignalIPdu14::ObjFrntRiTypOfObjFrntRi;
  @FC2Carmaker::AdpLiReqHzrdLiActvnReq = $Backbone::ASDM::ASDMBackBoneSignalIPdu14::AdpLiReqHzrdLiActvnReq;
  @FC2Carmaker::AdpLiReqIncrLiRiReq = $Backbone::ASDM::ASDMBackBoneSignalIPdu14::AdpLiReqIncrLiRiReq;
  } 
 
  
  on frPDU ASDMBackBoneSignalIPdu17
  {  
  @FC2Carmaker::CtraBrkOn = $Backbone::ASDM::ASDMBackBoneSignalIPdu17::CtraBrkOn;
  }   
  
//  on frPDU ASDMBackBoneSignalIPdu20
//  {
//    @FC2Carmaker::AsyAutDrvCtrlTyp = $Backbone::ASDM::ASDMBackBoneSignalIPdu20::AsyAutDrvCtrlTyp;
//    $Backbone::ASDM::ASDMBackBoneSignalIPdu20::DrvrAsscSysSts= @Carmaker2FC::DrvrAsscSysSts;
//    
//  }
  
  //20250224_fanjunjie_add
//  on message PASSafetyCANFD4Fr21
//  {
//    $SafetyCANFD4::PAS::PASSafetyCANFD4Fr21::TBASysSts = @Carmaker2FC::TBASysSts;
//  }
//  



  //  on frPDU ASDMBackBoneSignalIPdu23
//  {
//    @FC2Carmaker::AsyObjForBigData0AbsLatSpd = $Backbone::ASDM::ASDMBackBoneSignalIPdu23::AsyObjForBigData0AbsLatSpd;
//    @FC2Carmaker::AsyObjForBigData0AbsLgtSpd = $Backbone::ASDM::ASDMBackBoneSignalIPdu23::AsyObjForBigData0AbsLgtSpd;
//    @FC2Carmaker::AsyObjForBigData0Confidence = $Backbone::ASDM::ASDMBackBoneSignalIPdu23::AsyObjForBigData0Confidence;
//    @FC2Carmaker::AsyObjForBigData0RlvtLatDst = $Backbone::ASDM::ASDMBackBoneSignalIPdu23::AsyObjForBigData0RlvtLatDst;
//    @FC2Carmaker::AsyObjForBigData0RlvtLgtDst = $Backbone::ASDM::ASDMBackBoneSignalIPdu23::AsyObjForBigData0RlvtLgtDst;
//    @FC2Carmaker::AsyObjForBigData0SnsrSrcOfAbsLatSpd = $Backbone::ASDM::ASDMBackBoneSignalIPdu23::AsyObjForBigData0SnsrSrcOfAbsLatSpd;
//    @FC2Carmaker::AsyObjForBigData0SnsrSrcOfAbsLgtSpd = $Backbone::ASDM::ASDMBackBoneSignalIPdu23::AsyObjForBigData0SnsrSrcOfAbsLgtSpd;
//    @FC2Carmaker::AsyObjForBigData0TTC = $Backbone::ASDM::ASDMBackBoneSignalIPdu23::AsyObjForBigData0TTC;
//    @FC2Carmaker::AsyObjForBigData0Type = $Backbone::ASDM::ASDMBackBoneSignalIPdu23::AsyObjForBigData0Type;
//    @FC2Carmaker::AsyObjForBigData1AbsLatSpd = $Backbone::ASDM::ASDMBackBoneSignalIPdu23::AsyObjForBigData1AbsLatSpd;
//    @FC2Carmaker::AsyObjForBigData1AbsLgtSpd = $Backbone::ASDM::ASDMBackBoneSignalIPdu23::AsyObjForBigData1AbsLgtSpd;
//    @FC2Carmaker::AsyObjForBigData1Confidence = $Backbone::ASDM::ASDMBackBoneSignalIPdu23::AsyObjForBigData1Confidence;
//    @FC2Carmaker::AsyObjForBigData1RlvtLatDst = $Backbone::ASDM::ASDMBackBoneSignalIPdu23::AsyObjForBigData1RlvtLatDst;
//    @FC2Carmaker::AsyObjForBigData1RlvtLgtDst = $Backbone::ASDM::ASDMBackBoneSignalIPdu23::AsyObjForBigData1RlvtLgtDst;
//    @FC2Carmaker::AsyObjForBigData1SnsrSrcOfAbsLatSpd = $Backbone::ASDM::ASDMBackBoneSignalIPdu23::AsyObjForBigData1SnsrSrcOfAbsLatSpd;
//    @FC2Carmaker::AsyObjForBigData1SnsrSrcOfAbsLgtSpd = $Backbone::ASDM::ASDMBackBoneSignalIPdu23::AsyObjForBigData1SnsrSrcOfAbsLgtSpd;
//    @FC2Carmaker::AsyObjForBigData1TTC = $Backbone::ASDM::ASDMBackBoneSignalIPdu23::AsyObjForBigData1TTC;
//    @FC2Carmaker::AsyObjForBigData1Type = $Backbone::ASDM::ASDMBackBoneSignalIPdu23::AsyObjForBigData1Type;
//    @FC2Carmaker::AsyObjForBigData2AbsLatSpd = $Backbone::ASDM::ASDMBackBoneSignalIPdu23::AsyObjForBigData2AbsLatSpd;
//    @FC2Carmaker::AsyObjForBigData2AbsLgtSpd = $Backbone::ASDM::ASDMBackBoneSignalIPdu23::AsyObjForBigData2AbsLgtSpd;
//    @FC2Carmaker::AsyObjForBigData2Confidence = $Backbone::ASDM::ASDMBackBoneSignalIPdu23::AsyObjForBigData2Confidence;
//    @FC2Carmaker::AsyObjForBigData2RlvtLatDst = $Backbone::ASDM::ASDMBackBoneSignalIPdu23::AsyObjForBigData2RlvtLatDst;
//    @FC2Carmaker::AsyObjForBigData2RlvtLgtDst = $Backbone::ASDM::ASDMBackBoneSignalIPdu23::AsyObjForBigData2RlvtLgtDst;
//    @FC2Carmaker::AsyObjForBigData2SnsrSrcOfAbsLatSpd = $Backbone::ASDM::ASDMBackBoneSignalIPdu23::AsyObjForBigData2SnsrSrcOfAbsLatSpd;
//    @FC2Carmaker::AsyObjForBigData2SnsrSrcOfAbsLgtSpd = $Backbone::ASDM::ASDMBackBoneSignalIPdu23::AsyObjForBigData2SnsrSrcOfAbsLgtSpd;
//    @FC2Carmaker::AsyObjForBigData2TTC = $Backbone::ASDM::ASDMBackBoneSignalIPdu23::AsyObjForBigData2TTC;
//    @FC2Carmaker::AsyObjForBigData2Type = $Backbone::ASDM::ASDMBackBoneSignalIPdu23::AsyObjForBigData2Type;
//  } 
  
//  //20250219_fanjunjie_add
//  on message PASSafetyCANFD4Fr15
//  {
//    $LoSpdAndTrkBckSysSts = @Carmaker2FC::LoSpdAndTrkBckSysSts;
//  }



  
       
//  on frPDU ASDMBackBoneSignalIPdu24
//    {
//      @FC2Carmaker::AccFusnTrfcSgn = $Backbone::ASDM::ASDMBackBoneSignalIPdu24::AccFusnTrfcSgn;
////      @FC2Carmaker::AsyLe2FirstStrt = $Backbone::ASDM::ASDMBackBoneSignalIPdu24::AsyLe2FirstStrt;
////      @FC2Carmaker::AsyLeFirstStrt = $Backbone::ASDM::ASDMBackBoneSignalIPdu24::AsyLeFirstStrt;
////      @FC2Carmaker::AsyLineDstLe = $Backbone::ASDM::ASDMBackBoneSignalIPdu24::AsyLineDstLe;
////      @FC2Carmaker::AsyLineDstRi = $Backbone::ASDM::ASDMBackBoneSignalIPdu24::AsyLineDstRi;
////      @FC2Carmaker::AsyLineLe2Color = $Backbone::ASDM::ASDMBackBoneSignalIPdu24::AsyLineLe2Color;
////      @FC2Carmaker::AsyLineLe2Typ = $Backbone::ASDM::ASDMBackBoneSignalIPdu24::AsyLineLe2Typ;
////      @FC2Carmaker::AsyLineLeColor = $Backbone::ASDM::ASDMBackBoneSignalIPdu24::AsyLineLeColor;
////      @FC2Carmaker::AsyLineLeTyp = $Backbone::ASDM::ASDMBackBoneSignalIPdu24::AsyLineLeTyp;
////      @FC2Carmaker::AsyLineRi2Color = $Backbone::ASDM::ASDMBackBoneSignalIPdu24::AsyLineRi2Color;
////      @FC2Carmaker::AsyLineRi2Typ = $Backbone::ASDM::ASDMBackBoneSignalIPdu24::AsyLineRi2Typ;
////      @FC2Carmaker::AsyLineRiColor = $Backbone::ASDM::ASDMBackBoneSignalIPdu24::AsyLineRiColor;
////      @FC2Carmaker::AsyLineRiTyp = $Backbone::ASDM::ASDMBackBoneSignalIPdu24::AsyLineRiTyp;
////      @FC2Carmaker::AsyRi2FirstStrt = $Backbone::ASDM::ASDMBackBoneSignalIPdu24::AsyRi2FirstStrt;
////      @FC2Carmaker::AsyRiFirstStrt = $Backbone::ASDM::ASDMBackBoneSignalIPdu24::AsyRiFirstStrt;
//      @FC2Carmaker::AsyRoadCrvt = $Backbone::ASDM::ASDMBackBoneSignalIPdu24::AsyRoadCrvt;
//      @FC2Carmaker::DispSpdSetForLgtCtrl = $Backbone::ASDM::ASDMBackBoneSignalIPdu24::DispSpdSetForLgtCtrl;
//      @FC2Carmaker::DispTSIInfoForLgtCtrl = $Backbone::ASDM::ASDMBackBoneSignalIPdu24::DispTSIInfoForLgtCtrl;
//      @FC2Carmaker::AsyAutDrvgAvlSound = $Backbone::ASDM::ASDMBackBoneSignalIPdu24::AsyAutDrvgAvlSound;
//      @FC2Carmaker::CnclWarnForAutDrvSound = $Backbone::ASDM::ASDMBackBoneSignalIPdu24::CnclWarnForAutDrvSound;
//      @FC2Carmaker::CnclWarnLgtForAutDrvSound = $Backbone::ASDM::ASDMBackBoneSignalIPdu24::CnclWarnLgtForAutDrvSound;
//      @FC2Carmaker::AvlStsForLongAutDrvSound = $Backbone::ASDM::ASDMBackBoneSignalIPdu24::AvlStsForLongAutDrvSound;
//      
//      @Panel::SetSpeed_kph=round(abs($DispSpdSetForLgtCtrl)*3.6);
//      @FC2Carmaker::SetSpeed_kph=round(abs($DispSpdSetForLgtCtrl)*3.6);
//    }
     
//  on frPDU ASDMBackBoneSignalIPdu25
//  {
//      @FC2Carmaker::AsyLeFirstEnd = $Backbone::ASDM::ASDMBackBoneSignalIPdu25::AsyLeFirstEnd;
//      @FC2Carmaker::AsyLeSecEnd = $Backbone::ASDM::ASDMBackBoneSignalIPdu25::AsyLeSecEnd;
//      @FC2Carmaker::AsyLeSecStrt = $Backbone::ASDM::ASDMBackBoneSignalIPdu25::AsyLeSecStrt;
//      @FC2Carmaker::AsyLineLePah2PrmA = $Backbone::ASDM::ASDMBackBoneSignalIPdu25::AsyLineLePah2PrmA;
//      @FC2Carmaker::AsyLineLePah2PrmB = $Backbone::ASDM::ASDMBackBoneSignalIPdu25::AsyLineLePah2PrmB;
//      @FC2Carmaker::AsyLineLePah2PrmC = $Backbone::ASDM::ASDMBackBoneSignalIPdu25::AsyLineLePah2PrmC;
//      @FC2Carmaker::AsyLineLePah2PrmD = $Backbone::ASDM::ASDMBackBoneSignalIPdu25::AsyLineLePah2PrmD;
//      @FC2Carmaker::AsyLineLePahPrmA = $Backbone::ASDM::ASDMBackBoneSignalIPdu25::AsyLineLePahPrmA;
//      @FC2Carmaker::AsyLineLePahPrmB = $Backbone::ASDM::ASDMBackBoneSignalIPdu25::AsyLineLePahPrmB;
//      @FC2Carmaker::AsyLineLePahPrmC = $Backbone::ASDM::ASDMBackBoneSignalIPdu25::AsyLineLePahPrmC;
//      @FC2Carmaker::AsyLineLePahPrmD = $Backbone::ASDM::ASDMBackBoneSignalIPdu25::AsyLineLePahPrmD;
//      @FC2Carmaker::AsyLineRiPah2PrmA = $Backbone::ASDM::ASDMBackBoneSignalIPdu25::AsyLineRiPah2PrmA;
//      @FC2Carmaker::AsyLineRiPah2PrmB = $Backbone::ASDM::ASDMBackBoneSignalIPdu25::AsyLineRiPah2PrmB;
//      @FC2Carmaker::AsyLineRiPah2PrmC = $Backbone::ASDM::ASDMBackBoneSignalIPdu25::AsyLineRiPah2PrmC;
//      @FC2Carmaker::AsyLineRiPah2PrmD = $Backbone::ASDM::ASDMBackBoneSignalIPdu25::AsyLineRiPah2PrmD;
//      @FC2Carmaker::AsyLineRiPahPrmA = $Backbone::ASDM::ASDMBackBoneSignalIPdu25::AsyLineRiPahPrmA;
//      @FC2Carmaker::AsyLineRiPahPrmB = $Backbone::ASDM::ASDMBackBoneSignalIPdu25::AsyLineRiPahPrmB;
//      @FC2Carmaker::AsyLineRiPahPrmC = $Backbone::ASDM::ASDMBackBoneSignalIPdu25::AsyLineRiPahPrmC;
//      @FC2Carmaker::AsyLineRiPahPrmD = $Backbone::ASDM::ASDMBackBoneSignalIPdu25::AsyLineRiPahPrmD;
//      @FC2Carmaker::AsyRiFirstEnd = $Backbone::ASDM::ASDMBackBoneSignalIPdu25::AsyRiFirstEnd;
//      @FC2Carmaker::AsyRiSecEnd = $Backbone::ASDM::ASDMBackBoneSignalIPdu25::AsyRiSecEnd;
//      @FC2Carmaker::AsyRiSecStrt = $Backbone::ASDM::ASDMBackBoneSignalIPdu25::AsyRiSecStrt;
//
//  }

//  on frPDU ASDMBackBoneSignalIPdu26
//  {
//      @FC2Carmaker::AsyLe2FirstEnd = $Backbone::ASDM::ASDMBackBoneSignalIPdu26::AsyLe2FirstEnd;
//      @FC2Carmaker::AsyLe2SecEnd = $Backbone::ASDM::ASDMBackBoneSignalIPdu26::AsyLe2SecEnd;
//      @FC2Carmaker::AsyLe2SecStrt = $Backbone::ASDM::ASDMBackBoneSignalIPdu26::AsyLe2SecStrt;
//      @FC2Carmaker::AsyLineLe2Pah2PrmA = $Backbone::ASDM::ASDMBackBoneSignalIPdu26::AsyLineLe2Pah2PrmA;
//      @FC2Carmaker::AsyLineLe2Pah2PrmB = $Backbone::ASDM::ASDMBackBoneSignalIPdu26::AsyLineLe2Pah2PrmB;
//      @FC2Carmaker::AsyLineLe2Pah2PrmC = $Backbone::ASDM::ASDMBackBoneSignalIPdu26::AsyLineLe2Pah2PrmC;
//      @FC2Carmaker::AsyLineLe2Pah2PrmD = $Backbone::ASDM::ASDMBackBoneSignalIPdu26::AsyLineLe2Pah2PrmD;
//      @FC2Carmaker::AsyLineLe2PahPrmA = $Backbone::ASDM::ASDMBackBoneSignalIPdu26::AsyLineLe2PahPrmA;
//      @FC2Carmaker::AsyLineLe2PahPrmB = $Backbone::ASDM::ASDMBackBoneSignalIPdu26::AsyLineLe2PahPrmB;
//      @FC2Carmaker::AsyLineLe2PahPrmC = $Backbone::ASDM::ASDMBackBoneSignalIPdu26::AsyLineLe2PahPrmC;
//      @FC2Carmaker::AsyLineLe2PahPrmD = $Backbone::ASDM::ASDMBackBoneSignalIPdu26::AsyLineLe2PahPrmD;
//      @FC2Carmaker::AsyLineRi2Pah2PrmA = $Backbone::ASDM::ASDMBackBoneSignalIPdu26::AsyLineRi2Pah2PrmA;
//      @FC2Carmaker::AsyLineRi2Pah2PrmB = $Backbone::ASDM::ASDMBackBoneSignalIPdu26::AsyLineRi2Pah2PrmB;
//      @FC2Carmaker::AsyLineRi2Pah2PrmC = $Backbone::ASDM::ASDMBackBoneSignalIPdu26::AsyLineRi2Pah2PrmC;
//      @FC2Carmaker::AsyLineRi2Pah2PrmD = $Backbone::ASDM::ASDMBackBoneSignalIPdu26::AsyLineRi2Pah2PrmD;
//      @FC2Carmaker::AsyLineRi2PahPrmA = $Backbone::ASDM::ASDMBackBoneSignalIPdu26::AsyLineRi2PahPrmA;
//      @FC2Carmaker::AsyLineRi2PahPrmB = $Backbone::ASDM::ASDMBackBoneSignalIPdu26::AsyLineRi2PahPrmB;
//      @FC2Carmaker::AsyLineRi2PahPrmC = $Backbone::ASDM::ASDMBackBoneSignalIPdu26::AsyLineRi2PahPrmC;
//      @FC2Carmaker::AsyLineRi2PahPrmD = $Backbone::ASDM::ASDMBackBoneSignalIPdu26::AsyLineRi2PahPrmD;
//      @FC2Carmaker::AsyRi2FirstEnd = $Backbone::ASDM::ASDMBackBoneSignalIPdu26::AsyRi2FirstEnd;
//      @FC2Carmaker::AsyRi2SecEnd = $Backbone::ASDM::ASDMBackBoneSignalIPdu26::AsyRi2SecEnd;
//      @FC2Carmaker::AsyRi2SecStrt = $Backbone::ASDM::ASDMBackBoneSignalIPdu26::AsyRi2SecStrt;
//  }

//  on frPDU AsdmBackBoneSignalIPdu30
//  {
//    @FC2Carmaker::AsyNoaSts=$Backbone::ASDM::AsdmBackBoneSignalIPdu30::AsyNoaSts;
//      @FC2Carmaker::AsySafeStopSts = $Backbone::ASDM::AsdmBackBoneSignalIPdu30::AsySafeStopSts;
//  }
//
//  on frPDU AsdmBackBoneSignalIPdu32
//  {
//      @FC2Carmaker::DrvOffWarn = $Backbone::ASDM::AsdmBackBoneSignalIPdu32::DrvOffWarn;
//
//  }
  
  //// ******My Carout Variant******///
//  on frPDU BcmVddmBackBoneSignalIPdu00
//  {
//    if(@FaDC::VehMtnSt_UB==1)
//    {
//    @IL_FR1::NODES::N_BBM::PDUS::BcmVddmBackBoneSignalIPdu00::SIGGRPS::VehMtnSt::UB::Disturb =0;
//    @IL_FR1::NODES::N_BBM::PDUS::BcmVddmBackBoneSignalIPdu00::SIGGRPS::VehMtnSt::UB::Mode=1;
//    @IL_FR1::NODES::N_BBM::PDUS::BcmVddmBackBoneSignalIPdu00::SIGGRPS::VehMtnSt::UB::NormalOperation=1;
//    } 
//    else
//    {
//    @IL_FR1::NODES::N_BBM::PDUS::BcmVddmBackBoneSignalIPdu00::SIGGRPS::VehMtnSt::UB::Disturb=1;
//    @IL_FR1::NODES::N_BBM::PDUS::BcmVddmBackBoneSignalIPdu00::SIGGRPS::VehMtnSt::UB::Mode=0;
//    @IL_FR1::NODES::N_BBM::PDUS::BcmVddmBackBoneSignalIPdu00::SIGGRPS::VehMtnSt::UB::NormalOperation=0;
//    }
    //FaDC_VehMtnSt_UB();
    
    
    
//    if(@FaDC::AbsCtrlActv_UB==1)
//    {
//    @IL_FR1::NODES::N_BBM::PDUS::BcmVddmBackBoneSignalIPdu00::SIGGRPS::AbsCtrlActv::UB::Disturb =0;
//    @IL_FR1::NODES::N_BBM::PDUS::BcmVddmBackBoneSignalIPdu00::SIGGRPS::AbsCtrlActv::UB::Mode=1;
//    @IL_FR1::NODES::N_BBM::PDUS::BcmVddmBackBoneSignalIPdu00::SIGGRPS::AbsCtrlActv::UB::NormalOperation=1;
//    } 
//    else
//    {
//    @IL_FR1::NODES::N_BBM::PDUS::BcmVddmBackBoneSignalIPdu00::SIGGRPS::AbsCtrlActv::UB::Disturb=1;
//    @IL_FR1::NODES::N_BBM::PDUS::BcmVddmBackBoneSignalIPdu00::SIGGRPS::AbsCtrlActv::UB::Mode=0;
//    @IL_FR1::NODES::N_BBM::PDUS::BcmVddmBackBoneSignalIPdu00::SIGGRPS::AbsCtrlActv::UB::NormalOperation=0;
//    }
    //FaDC_AbsCtrlActv_UB();
    
    

//    if(@FaDC::BrkPedlPsd_UB==1)
//    {
//    @IL_FR1::NODES::N_BBM::PDUS::BcmVddmBackBoneSignalIPdu00::SIGGRPS::BrkPedlPsd::UB::Disturb =0;
//    @IL_FR1::NODES::N_BBM::PDUS::BcmVddmBackBoneSignalIPdu00::SIGGRPS::BrkPedlPsd::UB::Mode=1;
//    @IL_FR1::NODES::N_BBM::PDUS::BcmVddmBackBoneSignalIPdu00::SIGGRPS::BrkPedlPsd::UB::NormalOperation=1;
//    } 
//    else
//    {
//    @IL_FR1::NODES::N_BBM::PDUS::BcmVddmBackBoneSignalIPdu00::SIGGRPS::BrkPedlPsd::UB::Disturb=1;
//    @IL_FR1::NODES::N_BBM::PDUS::BcmVddmBackBoneSignalIPdu00::SIGGRPS::BrkPedlPsd::UB::Mode=0;
//    @IL_FR1::NODES::N_BBM::PDUS::BcmVddmBackBoneSignalIPdu00::SIGGRPS::BrkPedlPsd::UB::NormalOperation=0;
//    }
    //FaDC_BrkPedlPsd_UB();
    
    
//    if(@FaDC::BrkPedlPsdChks_Control==0)
//    {
//    ILNodeDisturbChecksum("BcmVddmBackBoneSignalIPdu00","BrkPedlPsd",0,0,1000,0);
//    }
//    else
//    {
//    ILNodeDisturbChecksum("BcmVddmBackBoneSignalIPdu00","BrkPedlPsd",0,1,0,0);
//    }
//    if((@FaDC::BrkPedlPsdCntr_Control==0&&temp_BrkPedlPsdCntr_Control==1))
//    {
//    @IL_FR1::NODES::N_BBM::PDUS::BcmVddmBackBoneSignalIPdu00::SIGGRPS::BrkPedlPsd::CNTR::Disturb=1;
//    }
//    else
//    {
//    @IL_FR1::NODES::N_BBM::PDUS::BcmVddmBackBoneSignalIPdu00::SIGGRPS::BrkPedlPsd::CNTR::Disturb=0;
//    }
//    if((@FaDC::BrkPedlPsdCntr_Control==1&&temp_BrkPedlPsdCntr_Control==0))
//    { 
//    @IL_FR1::NODES::N_BBM::PDUS::BcmVddmBackBoneSignalIPdu00::SIGGRPS::BrkPedlPsd::CNTR::NormalOperation=1;
//    }
//    else
//    {
//    @IL_FR1::NODES::N_BBM::PDUS::BcmVddmBackBoneSignalIPdu00::SIGGRPS::BrkPedlPsd::CNTR::NormalOperation=0;
//    }
//    temp_BrkPedlPsdChks_Control=@FaDC::BrkPedlPsdChks_Control;
//    temp_BrkPedlPsdCntr_Control=@FaDC::BrkPedlPsdCntr_Control;
    //FaDC_BrkPedlPsd_E2E();
    
    
    //20250325_fanjunjie_add
//    if(@FaDC::AbsCtrlActvChks_Control==0)
//    {
//    ILNodeDisturbChecksum("BcmVddmBackBoneSignalIPdu00","AbsCtrlActv",0,0,1000,0);
//    }
//    else
//    {
//    ILNodeDisturbChecksum("BcmVddmBackBoneSignalIPdu00","AbsCtrlActv",0,1,0,0);
//    }
//    
//    if((@FaDC::AbsCtrlActvCntr_Control==0&&temp_AbsCtrlActvCntr_Control==1))
//    {
//    @IL_FR1::NODES::N_BBM::PDUS::BcmVddmBackBoneSignalIPdu00::SIGGRPS::AbsCtrlActv::CNTR::Disturb=1;
//    }
//    else
//    {
//    @IL_FR1::NODES::N_BBM::PDUS::BcmVddmBackBoneSignalIPdu00::SIGGRPS::AbsCtrlActv::CNTR::Disturb=0;
//    }
//    if((@FaDC::AbsCtrlActvCntr_Control==1&&temp_AbsCtrlActvCntr_Control==0))
//    {
//    @IL_FR1::NODES::N_BBM::PDUS::BcmVddmBackBoneSignalIPdu00::SIGGRPS::AbsCtrlActv::CNTR::NormalOperation=1;
//    }
//    else
//    {
//    @IL_FR1::NODES::N_BBM::PDUS::BcmVddmBackBoneSignalIPdu00::SIGGRPS::AbsCtrlActv::CNTR::NormalOperation=0;
//    }
//    temp_AbsCtrlActvChks_Control=@FaDC::AbsCtrlActvChks_Control;
//    temp_AbsCtrlActvCntr_Control=@FaDC::AbsCtrlActvCntr_Control;
    //FaDC_AbsCtrlActv_E2E();
    
    

//    if(@FaDC::VehMtnStChks_Control==0)
//    {
//    ILNodeDisturbChecksum("BcmVddmBackBoneSignalIPdu00","VehMtnSt",0,0,1000,0);
//    }
//    else
//    {
//    ILNodeDisturbChecksum("BcmVddmBackBoneSignalIPdu00","VehMtnSt",0,1,0,0);
//    }
//    if((@FaDC::VehMtnStCntr_Control==0&&temp_VehMtnStCntr_Control==1))
//    {
//    @IL_FR1::NODES::N_BBM::PDUS::BcmVddmBackBoneSignalIPdu00::SIGGRPS::VehMtnSt::CNTR::Disturb=1;
//    }
//    else
//    {
//    @IL_FR1::NODES::N_BBM::PDUS::BcmVddmBackBoneSignalIPdu00::SIGGRPS::VehMtnSt::CNTR::Disturb=0;
//    }
//    if((@FaDC::VehMtnStCntr_Control==1&&temp_VehMtnStCntr_Control==0))
//    { 
//    @IL_FR1::NODES::N_BBM::PDUS::BcmVddmBackBoneSignalIPdu00::SIGGRPS::VehMtnSt::CNTR::NormalOperation=1;
//    }
//    else
//    {
//    @IL_FR1::NODES::N_BBM::PDUS::BcmVddmBackBoneSignalIPdu00::SIGGRPS::VehMtnSt::CNTR::NormalOperation=0;
//    }
//    temp_VehMtnStChks_Control=@FaDC::VehMtnStChks_Control;
//    temp_VehMtnStCntr_Control=@FaDC::VehMtnStCntr_Control;
    //FaDC_VehMtnSt_E2E();
    
    
//    $Backbone::BBM::BcmVddmBackBoneSignalIPdu00::BrkPedlPsdQf=@FaDC::BrkPedlPsdQf;
//    $Backbone::BBM::BcmVddmBackBoneSignalIPdu00::AbsCtrlActvCtrlSts1 = @Carmaker2FC::AbsCtrlActvCtrlSts1;          //channel modify,
//    $Backbone::BBM::BcmVddmBackBoneSignalIPdu00::AsyLatCtrlModReqGroupCfmdLatCtrlMod = @Carmaker2FC::AsyLatCtrlModReqGroupCfmdLatCtrlMod;          //channel modify,
//    $Backbone::BBM::BcmVddmBackBoneSignalIPdu00::BrkPedlPsdBrkPedlPsd = @Carmaker2FC::BrkPedlPsdBrkPedlPsd;
//    $Backbone::BBM::BcmVddmBackBoneSignalIPdu00::EpbStsEpbSts = @Carmaker2FC::EpbStsEpbSts;
//    $Backbone::BBM::BcmVddmBackBoneSignalIPdu00::RoadInclnRoadIncln = @Carmaker2FC::RoadInclnRoadIncln;          //channel modify,
  
   // //@FC2Carmaker_MyCarOutReturn::AbsCtrlActvCtrlSts1=$Backbone::BBM::BcmVddmBackBoneSignalIPdu00::AbsCtrlActvCtrlSts1;
    //@FC2Carmaker_MyCarOutReturn::BrkPedlPsdQf=$Backbone::BBM::BcmVddmBackBoneSignalIPdu00::BrkPedlPsdQf;
    //@FC2Carmaker_MyCarOutReturn::AsyLatCtrlModReqGroupCfmdLatCtrlMod=$Backbone::BBM::BcmVddmBackBoneSignalIPdu00::AsyLatCtrlModReqGroupCfmdLatCtrlMod;
    //@FC2Carmaker_MyCarOutReturn::BrkPedlPsdBrkPedlPsd=$Backbone::BBM::BcmVddmBackBoneSignalIPdu00::BrkPedlPsdBrkPedlPsd;
    //@FC2Carmaker_MyCarOutReturn::EpbStsEpbSts=$Backbone::BBM::BcmVddmBackBoneSignalIPdu00::EpbStsEpbSts;
    //@FC2Carmaker_MyCarOutReturn::VehMtnStVehMtnSt=$Backbone::BBM::BcmVddmBackBoneSignalIPdu00::VehMtnStVehMtnSt;
    //@FC2Carmaker_MyCarOutReturn::RoadInclnRoadIncln=$Backbone::BBM::BcmVddmBackBoneSignalIPdu00::RoadInclnRoadIncln;
    
//  } 

//  on frPDU BcmVddmBackBoneSignalIPdu03
//  {
//    if(@FaDC::EscSt_UB==1)
//    {
//    @IL_FR1::NODES::N_BBM::PDUS::BcmVddmBackBoneSignalIPdu03::SIGGRPS::EscSt::UB::Disturb =0;
//    @IL_FR1::NODES::N_BBM::PDUS::BcmVddmBackBoneSignalIPdu03::SIGGRPS::EscSt::UB::Mode=1;
//    @IL_FR1::NODES::N_BBM::PDUS::BcmVddmBackBoneSignalIPdu03::SIGGRPS::EscSt::UB::NormalOperation=1;
//    } 
//    else
//    {
//    @IL_FR1::NODES::N_BBM::PDUS::BcmVddmBackBoneSignalIPdu03::SIGGRPS::EscSt::UB::Disturb=1;
//    @IL_FR1::NODES::N_BBM::PDUS::BcmVddmBackBoneSignalIPdu03::SIGGRPS::EscSt::UB::Mode=0;
//    @IL_FR1::NODES::N_BBM::PDUS::BcmVddmBackBoneSignalIPdu03::SIGGRPS::EscSt::UB::NormalOperation=0;
//    }
    //FaDC_EscSt_UB();
    
    
//    if(@FaDC::EscCtrlIndcn_UB==1)
//    {
//    @IL_FR1::NODES::N_BBM::PDUS::BcmVddmBackBoneSignalIPdu03::SIGNALS::EscCtrlIndcn_UB::UB::Disturb =0;
//    @IL_FR1::NODES::N_BBM::PDUS::BcmVddmBackBoneSignalIPdu03::SIGNALS::EscCtrlIndcn_UB::UB::Mode=1;
//    @IL_FR1::NODES::N_BBM::PDUS::BcmVddmBackBoneSignalIPdu03::SIGNALS::EscCtrlIndcn_UB::UB::NormalOperation=1;
//    } 
//    else
//    {
//    @IL_FR1::NODES::N_BBM::PDUS::BcmVddmBackBoneSignalIPdu03::SIGNALS::EscCtrlIndcn_UB::UB::Disturb=1;
//    @IL_FR1::NODES::N_BBM::PDUS::BcmVddmBackBoneSignalIPdu03::SIGNALS::EscCtrlIndcn_UB::UB::Mode=0;
//    @IL_FR1::NODES::N_BBM::PDUS::BcmVddmBackBoneSignalIPdu03::SIGNALS::EscCtrlIndcn_UB::UB::NormalOperation=0;
//    }
    //FaDC_EscCtrlIndcn_UB();
    
    
//    if(@FaDC::ALgtStdFromWhlSpd_UB==1)
//    {
//    @IL_FR1::NODES::N_BBM::PDUS::BcmVddmBackBoneSignalIPdu03::SIGGRPS::ALgtStdFromWhlSpd::UB::Disturb =0;
//    @IL_FR1::NODES::N_BBM::PDUS::BcmVddmBackBoneSignalIPdu03::SIGGRPS::ALgtStdFromWhlSpd::UB::Mode=1;
//    @IL_FR1::NODES::N_BBM::PDUS::BcmVddmBackBoneSignalIPdu03::SIGGRPS::ALgtStdFromWhlSpd::UB::NormalOperation=1;
//    } 
//    else
//    {
//    @IL_FR1::NODES::N_BBM::PDUS::BcmVddmBackBoneSignalIPdu03::SIGGRPS::ALgtStdFromWhlSpd::UB::Disturb=1;
//    @IL_FR1::NODES::N_BBM::PDUS::BcmVddmBackBoneSignalIPdu03::SIGGRPS::ALgtStdFromWhlSpd::UB::Mode=0;
//    @IL_FR1::NODES::N_BBM::PDUS::BcmVddmBackBoneSignalIPdu03::SIGGRPS::ALgtStdFromWhlSpd::UB::NormalOperation=0;
//    }
    //FaDC_ALgtStdFromWhlSpd_UB();
    
    
//    if(@FaDC::EscStChks_Control==0)
//    {
//    ILNodeDisturbChecksum("BcmVddmBackBoneSignalIPdu03","EscSt",0,0,1000,0);
//    }
//    else
//    {
//    ILNodeDisturbChecksum("BcmVddmBackBoneSignalIPdu03","EscSt",0,1,0,0);
//    }
//    if((@FaDC::EscStCntr_Control==0&&temp_EscStCntr_Control==1))
//    {
//    @IL_FR1::NODES::N_BBM::PDUS::BcmVddmBackBoneSignalIPdu03::SIGGRPS::EscSt::CNTR::Disturb=1;
//    }
//    else
//    {
//    @IL_FR1::NODES::N_BBM::PDUS::BcmVddmBackBoneSignalIPdu03::SIGGRPS::EscSt::CNTR::Disturb=0;
//    }
//    if((@FaDC::EscStCntr_Control==1&&temp_EscStCntr_Control==0))
//    {  
//    @IL_FR1::NODES::N_BBM::PDUS::BcmVddmBackBoneSignalIPdu03::SIGGRPS::EscSt::CNTR::NormalOperation=1;
//    }
//    else
//    {
//    @IL_FR1::NODES::N_BBM::PDUS::BcmVddmBackBoneSignalIPdu03::SIGGRPS::EscSt::CNTR::NormalOperation=0;
//    }
//    temp_EscStChks_Control=@FaDC::EscStChks_Control;
//    temp_EscStCntr_Control=@FaDC::EscStCntr_Control;
    //FaDC_EscSt_E2E();
    
    
    
    
//    $Backbone::BBM::BcmVddmBackBoneSignalIPdu03::BrkSysCylPMstActQf=@FaDC::BrkSysCylPMstActQf;
//    $Backbone::BBM::BcmVddmBackBoneSignalIPdu03::ALgtStdFromWhlSpdQf=@FaDC::ALgtStdFromWhlSpdQf;
//    $Backbone::BBM::BcmVddmBackBoneSignalIPdu03::BrkSysCylPMstVirtQf=@FaDC::BrkSysCylPMstVirtQf;
//    $Backbone::BBM::BcmVddmBackBoneSignalIPdu03::ALgtStdFromWhlSpdALgtStdFromWhlSpd = @Carmaker2FC::ALgtStdFromWhlSpdALgtStdFromWhlSpd;
//    $Backbone::BBM::BcmVddmBackBoneSignalIPdu03::BrkSysCylPMstAct = @Carmaker2FC::BrkSysCylPMstAct;          //channel modify,
////    $Backbone::BBM::BcmVddmBackBoneSignalIPdu03::EscCtrlIndcn = @Carmaker2FC::EscCtrlIndcn;
//    $Backbone::BBM::BcmVddmBackBoneSignalIPdu03::EscStEscSt = @Carmaker2FC::EscStEscSt;
 
    //@FC2Carmaker_MyCarOutReturn::BrkSysCylPMstActQf=$Backbone::BBM::BcmVddmBackBoneSignalIPdu03::BrkSysCylPMstActQf;
    //@FC2Carmaker_MyCarOutReturn::ALgtStdFromWhlSpdQf=$Backbone::BBM::BcmVddmBackBoneSignalIPdu03::ALgtStdFromWhlSpdQf;
    //@FC2Carmaker_MyCarOutReturn::ALgtStdFromWhlSpdALgtStdFromWhlSpd=$Backbone::BBM::BcmVddmBackBoneSignalIPdu03::ALgtStdFromWhlSpdALgtStdFromWhlSpd;
    //@FC2Carmaker_MyCarOutReturn::BrkSysCylPMstAct=$Backbone::BBM::BcmVddmBackBoneSignalIPdu03::BrkSysCylPMstAct;
    //@FC2Carmaker_MyCarOutReturn::EscCtrlIndcn=$Backbone::BBM::BcmVddmBackBoneSignalIPdu03::EscCtrlIndcn;
    //@FC2Carmaker_MyCarOutReturn::EscStEscSt=$Backbone::BBM::BcmVddmBackBoneSignalIPdu03::EscStEscSt;
    //@FC2Carmaker_MyCarOutReturn::BrkSysCylPMstVirtQf=$Backbone::BBM::BcmVddmBackBoneSignalIPdu03::BrkSysCylPMstVirtQf;
    
//    if(@FaDC::ALgtStdFromWhlSpdChks_Control==0)
//    {
//      ILNodeDisturbChecksum("BcmVddmBackBoneSignalIPdu03","ALgtStdFromWhlSpd",0,0,1000,0);
//    }
//    else
//    {
//      ILNodeDisturbChecksum("BcmVddmBackBoneSignalIPdu03","ALgtStdFromWhlSpd",0,1,0,0);
//    }
//    
//    if((@FaDC::ALgtStdFromWhlSpdCntr_Control==0&&temp_ALgtStdFromWhlSpdCntr_Control==1))
//    {
//      @IL_FR1::NODES::N_BBM::PDUS::BcmVddmBackBoneSignalIPdu03::SIGGRPS::ALgtStdFromWhlSpd::CNTR::Disturb=1;
//    }
//    else
//    {
//      @IL_FR1::NODES::N_BBM::PDUS::BcmVddmBackBoneSignalIPdu03::SIGGRPS::ALgtStdFromWhlSpd::CNTR::Disturb=0;
//    }
//    
//    if((@FaDC::ALgtStdFromWhlSpdCntr_Control==1&&temp_ALgtStdFromWhlSpdCntr_Control==0))
//    {
//      @IL_FR1::NODES::N_BBM::PDUS::BcmVddmBackBoneSignalIPdu03::SIGGRPS::ALgtStdFromWhlSpd::CNTR::NormalOperation=1;
//    }
//    else
//    {
//      @IL_FR1::NODES::N_BBM::PDUS::BcmVddmBackBoneSignalIPdu03::SIGGRPS::ALgtStdFromWhlSpd::CNTR::NormalOperation=0;
//    }
//    
//    temp_ALgtStdFromWhlSpdChks_Control=@FaDC::ALgtStdFromWhlSpdChks_Control;
//    temp_ALgtStdFromWhlSpdCntr_Control=@FaDC::ALgtStdFromWhlSpdCntr_Control;
    //FaDC_ALgtStdFromWhlSpd_E2E();
    
//  }
  
//  on message PASSafetyCANFD4Fr02
//  {
//    $SafetyCANFD4::PAS::PASSafetyCANFD4Fr02::VehHomePrkgSysSts = @Carmaker2FC::VehHomePrkgSysSts;
//  }
//  
//  on frPDU BcmVddmBackBoneSignalIPdu04
//  {
//  $Backbone::BBM::BcmVddmBackBoneSignalIPdu04::LampReqByVehHld = @Carmaker2FC::LampReqByVehHld;
// 
//  //@FC2Carmaker_MyCarOutReturn::LampReqByVehHld=$Backbone::BBM::BcmVddmBackBoneSignalIPdu04::LampReqByVehHld;
//  } 
  
//  on frPDU BcmVddmBackBoneSignalIPdu06
//  {
//  if(@FaDC::VehDynCtrlStsForALgtCmft_UB==1)
//  {
//  @IL_FR1::NODES::N_BBM::PDUS::BcmVddmBackBoneSignalIPdu06::SIGGRPS::VehDynCtrlStsForALgtCmft::UB::Disturb =0;
//  @IL_FR1::NODES::N_BBM::PDUS::BcmVddmBackBoneSignalIPdu06::SIGGRPS::VehDynCtrlStsForALgtCmft::UB::Mode=1;
//  @IL_FR1::NODES::N_BBM::PDUS::BcmVddmBackBoneSignalIPdu06::SIGGRPS::VehDynCtrlStsForALgtCmft::UB::NormalOperation=1;
//  } 
//  else
//  {
//  @IL_FR1::NODES::N_BBM::PDUS::BcmVddmBackBoneSignalIPdu06::SIGGRPS::VehDynCtrlStsForALgtCmft::UB::Disturb=1;
//  @IL_FR1::NODES::N_BBM::PDUS::BcmVddmBackBoneSignalIPdu06::SIGGRPS::VehDynCtrlStsForALgtCmft::UB::Mode=0;
//  @IL_FR1::NODES::N_BBM::PDUS::BcmVddmBackBoneSignalIPdu06::SIGGRPS::VehDynCtrlStsForALgtCmft::UB::NormalOperation=0;
//  }
  //FaDC_VehDynCtrlStsForALgtCmft_UB();
  
  
  
    
//  if(@FaDC::VehSpdLgt_UB==1)
//  {
//    @IL_FR1::NODES::N_BBM::PDUS::BcmVddmBackBoneSignalIPdu06::SIGGRPS::VehSpdLgt::UB::Disturb =0;
//    @IL_FR1::NODES::N_BBM::PDUS::BcmVddmBackBoneSignalIPdu06::SIGGRPS::VehSpdLgt::UB::Mode=1;
//    @IL_FR1::NODES::N_BBM::PDUS::BcmVddmBackBoneSignalIPdu06::SIGGRPS::VehSpdLgt::UB::NormalOperation=1;
//  } 
//  else
//  {
//    @IL_FR1::NODES::N_BBM::PDUS::BcmVddmBackBoneSignalIPdu06::SIGGRPS::VehSpdLgt::UB::Disturb=1;
//    @IL_FR1::NODES::N_BBM::PDUS::BcmVddmBackBoneSignalIPdu06::SIGGRPS::VehSpdLgt::UB::Mode=0;
//    @IL_FR1::NODES::N_BBM::PDUS::BcmVddmBackBoneSignalIPdu06::SIGGRPS::VehSpdLgt::UB::NormalOperation=0;
//  }
  //FaDC_VehSpdLgt_UB();
    
    
    
//  $Backbone::BBM::BcmVddmBackBoneSignalIPdu06::VehSpdLgtQf=@FaDC::VehSpdLgtQf;
//  $Backbone::BBM::BcmVddmBackBoneSignalIPdu06::StandStillMgrStsForHld1 = @Carmaker2FC::StandStillMgrStsForHld1;          //channel modify,
//  $Backbone::BBM::BcmVddmBackBoneSignalIPdu06::AsyALgtActvAftLim = @Carmaker2FC::AsyALgtActvAftLim;
//  $Backbone::BBM::BcmVddmBackBoneSignalIPdu06::VehVLat = @Carmaker2FC::VehVLat;
//
//  //20250325_fanjunjie_add
//  $Backbone::BBM::BcmVddmBackBoneSignalIPdu06::VehDynCtrlStsForALgtCmftVehDynCtrlStsDend=@FaDC::VehDynCtrlStsForALgtCmftVehDynCtrlStsDend;
  
  
//    if(@Carmaker2FC::speed_swt==0) 
//  {
//    if(abs(@Carmaker2FC::VehSpdIndcdVehSpdIndcd)>0.04) 
//      {
//      $Backbone::BBM::BcmVddmBackBoneSignalIPdu06::VehSpdLgtA = abs(@Carmaker2FC::VehSpdIndcdVehSpdIndcd);
//     $ChassisCAN1::BBM::VddmChas1Fr05::VehSpdLgtA= abs(@Carmaker2FC::VehSpdIndcdVehSpdIndcd);    //20241204
//      }
//     else
//    {
//    $Backbone::BBM::BcmVddmBackBoneSignalIPdu06::VehSpdLgtA = 0; 
//   $ChassisCAN1::BBM::VddmChas1Fr05::VehSpdLgtA= 0;    //20241204
//     }
//      
//  }
//    
//   else
//  {  
//  $Backbone::BBM::BcmVddmBackBoneSignalIPdu06::VehSpdLgtA=(@Carmaker2FC::speed)/3.6;
//  $ChassisCAN1::BBM::VddmChas1Fr05::VehSpdLgtA= (@Carmaker2FC::speed)/3.6;    //20241204
//   }   
//   @Panel::SetSpeed_kph=round($DispSpdSetForLgtCtrl*3.6);
//  waste 20241029 sunyou ///
//  if(@Carmaker2FC::VehSpdLgtA_Set >0 &&@Carmaker2FC::VehSpdIndcdVehSpdIndcd_Set==0) 
//  { 
//    $Backbone::IHU::DIMBackBoneSignalIPdu04::VehSpdIndcdVehSpdIndcd=abs( @Carmaker2FC::VehSpdLgtA_Set)*3.6;
//    $Backbone::BBM::BcmVddmBackBoneSignalIPdu06::VehSpdLgtA=abs(@Carmaker2FC::VehSpdLgtA_Set);
//  }
//    else
//  {
//    $Backbone::BBM::BcmVddmBackBoneSignalIPdu06::VehSpdLgtA = abs(@Carmaker2FC::VehSpdLgtA);
//  }
//  waste 20241029 sunyou /// 
//  if(@FaDC::VehSpdLgtChks_Control==0)
//    {
//    ILNodeDisturbChecksum("BcmVddmBackBoneSignalIPdu06","VehSpdLgt",0,0,1000,0);
//    }
//    else
//    {
//    ILNodeDisturbChecksum("BcmVddmBackBoneSignalIPdu06","VehSpdLgt",0,1,0,0);
//    }
//  //2025/02/05_kangrui_add  
//  if((@FaDC::VehSpdLgtCntr_Control==0&&temp_VehSpdLgtCntr_Control==1))
//  {
//  @IL_FR1::NODES::N_BBM::PDUS::BcmVddmBackBoneSignalIPdu06::SIGGRPS::VehSpdLgt::CNTR::Disturb=1;
//  }
//  else
//  {
//  @IL_FR1::NODES::N_BBM::PDUS::BcmVddmBackBoneSignalIPdu06::SIGGRPS::VehSpdLgt::CNTR::Disturb=0;
//  }
//  if((@FaDC::VehSpdLgtCntr_Control==1&&temp_VehSpdLgtCntr_Control==0))
//  {
//
//  @IL_FR1::NODES::N_BBM::PDUS::BcmVddmBackBoneSignalIPdu06::SIGGRPS::VehSpdLgt::CNTR::NormalOperation=1;
//  }
//  else
//  {
//  @IL_FR1::NODES::N_BBM::PDUS::BcmVddmBackBoneSignalIPdu06::SIGGRPS::VehSpdLgt::CNTR::NormalOperation=0;
//  }
//
//  temp_VehSpdLgtChks_Control=@FaDC::VehSpdLgtChks_Control;
//  temp_VehSpdLgtCntr_Control=@FaDC::VehSpdLgtCntr_Control;
  //FaDC_VehSpdLgt_E2E();
  
  
  
  
  //@FC2Carmaker_MyCarOutReturn::VehSpdLgtQf=$Backbone::BBM::BcmVddmBackBoneSignalIPdu06::VehSpdLgtQf;
  //@FC2Carmaker_MyCarOutReturn::StandStillMgrStsForHld1=$Backbone::BBM::BcmVddmBackBoneSignalIPdu06::StandStillMgrStsForHld1;
  //@FC2Carmaker_MyCarOutReturn::VehSpdLgtA=$Backbone::BBM::BcmVddmBackBoneSignalIPdu06::VehSpdLgtA;
  //@FC2Carmaker_MyCarOutReturn::AsyALgtActvAftLim=$Backbone::BBM::BcmVddmBackBoneSignalIPdu06::AsyALgtActvAftLim;
  //@FC2Carmaker_MyCarOutReturn::VehVLat=$Backbone::BBM::BcmVddmBackBoneSignalIPdu06::VehVLat;
//  }
  
//  on frPDU BcmVddmBackBoneSignalIPdu08
//  {
//  $Backbone::BBM::BcmVddmBackBoneSignalIPdu08::BrkPedlrRatQf=@FaDC::BrkPedlrRatQf;
//  $Backbone::BBM::BcmVddmBackBoneSignalIPdu08::BrkPedlrRatPerc = @Carmaker2FC::BrkPedlrRatPerc;
//  $Backbone::BBM::BcmVddmBackBoneSignalIPdu08::MsgReqByHillDwnCtrl = @Carmaker2FC::MsgReqByHillDwnCtrl;          //channel modify,
//  $Backbone::BBM::BcmVddmBackBoneSignalIPdu08::EscWarnIndcnReqEscWarnIndcnReq = @Carmaker2FC::EscWarnIndcnReqEscWarnIndcnReq;
//
//  //@FC2Carmaker_MyCarOutReturn::BrkPedlrRatPerc=$Backbone::BBM::BcmVddmBackBoneSignalIPdu08::BrkPedlrRatPerc;
//  //@FC2Carmaker_MyCarOutReturn::MsgReqByHillDwnCtrl=$Backbone::BBM::BcmVddmBackBoneSignalIPdu08::MsgReqByHillDwnCtrl;
//  //@FC2Carmaker_MyCarOutReturn::EscWarnIndcnReqEscWarnIndcnReq=$Backbone::BBM::BcmVddmBackBoneSignalIPdu08::EscWarnIndcnReqEscWarnIndcnReq;
//  //@FC2Carmaker_MyCarOutReturn::BrkPedlrRatQf=$Backbone::BBM::BcmVddmBackBoneSignalIPdu08::BrkPedlrRatQf;
//  }
  
//  on frPDU BcmVddmBackBoneSignalIPdu13
//  {
//    if(@FaDC::DrvrDecelReqChks_Control==0)
//    {
//    ILNodeDisturbChecksum("BcmVddmBackBoneSignalIPdu13","DrvrDecelReq",0,0,1000,0);
//    }
//    else
//    {
//    ILNodeDisturbChecksum("BcmVddmBackBoneSignalIPdu13","DrvrDecelReq",0,1,0,0);
//    }
//    
//    if((@FaDC::DrvrDecelReqCntr_Control==0&&temp_DrvrDecelReqCntr_Control==1))
//    {
//    @IL_FR1::NODES::N_BBM::PDUS::BcmVddmBackBoneSignalIPdu13::SIGGRPS::DrvrDecelReq::CNTR::Disturb=1;
//    }
//    else
//    {
//    @IL_FR1::NODES::N_BBM::PDUS::BcmVddmBackBoneSignalIPdu13::SIGGRPS::DrvrDecelReq::CNTR::Disturb=0;
//    }
//    if((@FaDC::DrvrDecelReqCntr_Control==1&&temp_DrvrDecelReqCntr_Control==0))
//    {  
//    @IL_FR1::NODES::N_BBM::PDUS::BcmVddmBackBoneSignalIPdu13::SIGGRPS::DrvrDecelReq::CNTR::NormalOperation=1;
//    }
//    else
//    {
//    @IL_FR1::NODES::N_BBM::PDUS::BcmVddmBackBoneSignalIPdu13::SIGGRPS::DrvrDecelReq::CNTR::NormalOperation=0;
//    }
//    temp_DrvrDecelReqChks_Control=@FaDC::DrvrDecelReqChks_Control;
//    temp_DrvrDecelReqCntr_Control=@FaDC::DrvrDecelReqCntr_Control;
    //FaDC_DrvrDecelReq_E2E();
    
    
//  $Backbone::BBM::BcmVddmBackBoneSignalIPdu13::DrvrDecelReqFloat8 = @Carmaker2FC::DrvrDecelReqFloat8;
    
  //@FC2Carmaker_MyCarOutReturn::DrvrDecelReqFloat8=$Backbone::BBM::BcmVddmBackBoneSignalIPdu13::DrvrDecelReqFloat8;
//  }

//  on frPDU BcmVddmBackBoneSignalIPdu16
//  {
////    if(@FaDC::AsySftyDecelEnadByVehDyn_UB==1)
////    {
////    @IL_FR1::NODES::N_BBM::PDUS::BcmVddmBackBoneSignalIPdu16::SIGNALS::AsySftyDecelEnadByVehDyn_UB::UB::Disturb =0;
////    @IL_FR1::NODES::N_BBM::PDUS::BcmVddmBackBoneSignalIPdu16::SIGNALS::AsySftyDecelEnadByVehDyn_UB::UB::Mode=1;
////    @IL_FR1::NODES::N_BBM::PDUS::BcmVddmBackBoneSignalIPdu16::SIGNALS::AsySftyDecelEnadByVehDyn_UB::UB::NormalOperation=1;
////    } 
////    else
////    {
////    @IL_FR1::NODES::N_BBM::PDUS::BcmVddmBackBoneSignalIPdu16::SIGNALS::AsySftyDecelEnadByVehDyn_UB::UB::Disturb=1;
////    @IL_FR1::NODES::N_BBM::PDUS::BcmVddmBackBoneSignalIPdu16::SIGNALS::AsySftyDecelEnadByVehDyn_UB::UB::Mode=0;
////    @IL_FR1::NODES::N_BBM::PDUS::BcmVddmBackBoneSignalIPdu16::SIGNALS::AsySftyDecelEnadByVehDyn_UB::UB::NormalOperation=0;
////    }
//    //FaDC_AsySftyDecelEnadByVehDyn_UB();
//    
//    
////    if(@FaDC::DrvrDecelReq_UB==1)
////    {
////    @IL_FR1::NODES::N_BBM::PDUS::BcmVddmBackBoneSignalIPdu13::SIGGRPS::DrvrDecelReq::UB::Disturb =0;
////    @IL_FR1::NODES::N_BBM::PDUS::BcmVddmBackBoneSignalIPdu13::SIGGRPS::DrvrDecelReq::UB::Mode=1;
////    @IL_FR1::NODES::N_BBM::PDUS::BcmVddmBackBoneSignalIPdu13::SIGGRPS::DrvrDecelReq::UB::NormalOperation=1;
////    } 
////    else
////    {
////    @IL_FR1::NODES::N_BBM::PDUS::BcmVddmBackBoneSignalIPdu13::SIGGRPS::DrvrDecelReq::UB::Disturb=1;
////    @IL_FR1::NODES::N_BBM::PDUS::BcmVddmBackBoneSignalIPdu13::SIGGRPS::DrvrDecelReq::UB::Mode=0;
////    @IL_FR1::NODES::N_BBM::PDUS::BcmVddmBackBoneSignalIPdu13::SIGGRPS::DrvrDecelReq::UB::NormalOperation=0;
////    }
//    //FaDC_DrvrDecelReq_UB();
//    
//    
//    $Backbone::BBM::BcmVddmBackBoneSignalIPdu16::AsySftyDecelEnadByVehDyn = @Carmaker2FC::AsySftyDecelEnadByVehDyn;
//    $Backbone::BBM::BcmVddmBackBoneSignalIPdu16::RctaBrkActvd = @Carmaker2FC::RctaBrkActvd;
//    $Backbone::BBM::BcmVddmBackBoneSignalIPdu16::RcwmBrkActvd = @Carmaker2FC::RcwmBrkActvd;
//    $Backbone::BBM::BcmVddmBackBoneSignalIPdu16::AsySftyEnaDecelAckd = @Carmaker2FC::AsySftyEnaDecelAckd;
//    
//    //@FC2Carmaker_MyCarOutReturn::AsySftyDecelEnadByVehDyn=$Backbone::BBM::BcmVddmBackBoneSignalIPdu16::AsySftyDecelEnadByVehDyn;
//    //@FC2Carmaker_MyCarOutReturn::RctaBrkActvd=$Backbone::BBM::BcmVddmBackBoneSignalIPdu16::RctaBrkActvd;
//    //@FC2Carmaker_MyCarOutReturn::RcwmBrkActvd=$Backbone::BBM::BcmVddmBackBoneSignalIPdu16::RcwmBrkActvd;
//    //@FC2Carmaker_MyCarOutReturn::AsySftyEnaDecelAckd=$Backbone::BBM::BcmVddmBackBoneSignalIPdu16::AsySftyEnaDecelAckd;
//  }
  
   on frPDU CEMBackBoneSignalIpdu01
  { 
        if(@Panel::SW == 1)
      {
          $Backbone::CEM::CEMBackBoneSignalIpdu01::CarModSts1 = @Panel::VehModMngtGlbSafe1CarModSts1;
          $Backbone::CEM::CEMBackBoneSignalIpdu01::UsgModSts = @Panel::VehModMngtGlbSafe1UsgModSts;
      }
      else{
          $Backbone::CEM::CEMBackBoneSignalIpdu01::CarModSts1 = @Carmaker2FC::VehModMngtGlbSafe1CarModSts1;
          $Backbone::CEM::CEMBackBoneSignalIpdu01::UsgModSts = @Carmaker2FC::VehModMngtGlbSafe1UsgModSts;
      }
      
          if(@Panel::SW == 1)
    {
//      $Backbone::VGM::CEMBackBoneSignalIpdu03::DoorDrvrLockSts = @Panel::DoorDrvrLockSts;;          //channel modify,
      $Backbone::CEM::CEMBackBoneSignalIpdu01::DoorDrvrSts = @Panel::DoorDrvrSts;          //channel modify,
//      $Backbone::VGM::CEMBackBoneSignalIpdu03::DoorLeReLockSts = @Panel::DoorLeReLockSts;          //channel modify,
//      $Backbone::CEM::CEMBackBoneSignalIpdu01::DoorDrvrReSts = @Panel::DoorLeReSts;          //channel modify,
//      $Backbone::VGM::CEMBackBoneSignalIpdu03::DoorPassLockSts = @Panel::DoorPassLockSts;          //channel modify,
      $Backbone::CEM::CEMBackBoneSignalIpdu01::DoorPassSts = @Panel::DoorPassSts;          //channel modify,
//      $Backbone::VGM::CEMBackBoneSignalIpdu03::DoorRiReLockSts = @Panel::DoorRiReLockSts;          //channel modify,
      $Backbone::CEM::CEMBackBoneSignalIpdu01::DoorPassReSts = @Panel::DoorRiReSts;  

    }
    else
    {
//      $Backbone::VGM::CEMBackBoneSignalIpdu03::DoorDrvrLockSts = @Carmaker2FC::DoorDrvrLockSts;          //channel modify,
      $Backbone::CEM::CEMBackBoneSignalIpdu01::DoorDrvrSts = @Carmaker2FC::DoorDrvrSts;          //channel modify,
//      $Backbone::VGM::CEMBackBoneSignalIpdu03::DoorLeReLockSts = @Carmaker2FC::DoorLeReLockSts;          //channel modify,
//      $Backbone::CEM::CEMBackBoneSignalIpdu01::DoorDrvrReSts = @Carmaker2FC::DoorLeReSts;          //channel modify,
//      $Backbone::VGM::CEMBackBoneSignalIpdu03::DoorPassLockSts = @Carmaker2FC::DoorPassLockSts;          //channel modify,
      $Backbone::CEM::CEMBackBoneSignalIpdu01::DoorPassSts = @Carmaker2FC::DoorPassSts;          //channel modify,
//      $Backbone::VGM::CEMBackBoneSignalIpdu03::DoorRiReLockSts = @Carmaker2FC::DoorRiReLockSts;          //channel modify,
      $Backbone::CEM::CEMBackBoneSignalIpdu01::DoorPassReSts = @Carmaker2FC::DoorRiReSts;   

      }
   $IndcrTurnSts1WdSts =  @Carmaker2FC::IndcrTurnSts1WdSts; 
    
   $IndcrTypExtReq  =  @Carmaker2FC::IndcrTypExtReq;
 
  }
  
  
  on frPDU CEMBackBoneSignalIpdu02
  {
    
     $Backbone::CEM::CEMBackBoneSignalIpdu02::DrvrPrsnt = @Carmaker2FC::DrvrPrsntStsDrvrPrsnt;          //channel modify,

     $Backbone::CEM::CEMBackBoneSignalIpdu02::DoorStsForDoorDrvrStsWithFacQly = @Carmaker2FC::DoorStsForDoorDrvrStsWithFacQly;

    
    
    
//      if(@Panel::SW == 1)
//      {
//          $Backbone::VGM::CEMBackBoneSignalIpdu02::VehModMngtGlbSafe1CarModSts1 = @Panel::VehModMngtGlbSafe1CarModSts1;
//          $Backbone::VGM::CEMBackBoneSignalIpdu02::VehModMngtGlbSafe1UsgModSts = @Panel::VehModMngtGlbSafe1UsgModSts;
//      }
//      else{
//          $Backbone::VGM::CEMBackBoneSignalIpdu02::VehModMngtGlbSafe1CarModSts1 = @Carmaker2FC::VehModMngtGlbSafe1CarModSts1;
//          $Backbone::VGM::CEMBackBoneSignalIpdu02::VehModMngtGlbSafe1UsgModSts = @Carmaker2FC::VehModMngtGlbSafe1UsgModSts;
//      }
    
      //@FC2Carmaker_MyCarOutReturn::VehModMngtGlbSafe1CarModSts1=$Backbone::VGM::CEMBackBoneSignalIpdu02::VehModMngtGlbSafe1CarModSts1;
      //@FC2Carmaker_MyCarOutReturn::VehModMngtGlbSafe1UsgModSts=$Backbone::VGM::CEMBackBoneSignalIpdu02::VehModMngtGlbSafe1UsgModSts;


      
  }
  
  on frPDU CEMBackBoneSignalIpdu03
  {
    if(@Panel::SW == 1)
    {
//      $Backbone::VGM::CEMBackBoneSignalIpdu03::DoorDrvrLockSts = @Panel::DoorDrvrLockSts;;          //channel modify,
//      $Backbone::VGM::CEMBackBoneSignalIpdu03::DoorDrvrSts = @Panel::DoorDrvrSts;          //channel modify,
//      $Backbone::VGM::CEMBackBoneSignalIpdu03::DoorLeReLockSts = @Panel::DoorLeReLockSts;          //channel modify,
      $Backbone::CEM::CEMBackBoneSignalIpdu03::DoorDrvrReSts = @Panel::DoorLeReSts;          //channel modify,
//      $Backbone::VGM::CEMBackBoneSignalIpdu03::DoorPassLockSts = @Panel::DoorPassLockSts;          //channel modify,
//      $Backbone::VGM::CEMBackBoneSignalIpdu03::DoorPassSts = @Panel::DoorPassSts;          //channel modify,
//      $Backbone::VGM::CEMBackBoneSignalIpdu03::DoorRiReLockSts = @Panel::DoorRiReLockSts;          //channel modify,
//      $Backbone::CEM::CEMBackBoneSignalIpdu03::DoorPassReSts = @Panel::DoorRiReSts;  

//      $Backbone::VGM::CEMBackBoneSignalIpdu03::TrlrPrsnt = @Panel::TrlrPrsnt;          //channel modify,
    }
    else
    {
//      $Backbone::VGM::CEMBackBoneSignalIpdu03::DoorDrvrLockSts = @Carmaker2FC::DoorDrvrLockSts;          //channel modify,
//      $Backbone::VGM::CEMBackBoneSignalIpdu03::DoorDrvrSts = @Carmaker2FC::DoorDrvrSts;          //channel modify,
//      $Backbone::VGM::CEMBackBoneSignalIpdu03::DoorLeReLockSts = @Carmaker2FC::DoorLeReLockSts;          //channel modify,
      $Backbone::CEM::CEMBackBoneSignalIpdu03::DoorDrvrReSts = @Carmaker2FC::DoorLeReSts;          //channel modify,
//      $Backbone::VGM::CEMBackBoneSignalIpdu03::DoorPassLockSts = @Carmaker2FC::DoorPassLockSts;          //channel modify,
//      $Backbone::VGM::CEMBackBoneSignalIpdu03::DoorPassSts = @Carmaker2FC::DoorPassSts;          //channel modify,
//      $Backbone::VGM::CEMBackBoneSignalIpdu03::DoorRiReLockSts = @Carmaker2FC::DoorRiReLockSts;          //channel modify,
//      $Backbone::CEM::CEMBackBoneSignalIpdu03::DoorPassReSts = @Carmaker2FC::DoorRiReSts;   

//      $Backbone::VGM::CEMBackBoneSignalIpdu03::TrlrPrsnt = @Carmaker2FC::TrlrPrsnt;          //channel modify,
  
      }
    
    
        //20250117_fanjunjie_add
//    if(@FaDC::IndcrSts_UB==1)
//    {
//    @IL_FR1::NODES::N_VGM::PDUS::CEMBackBoneSignalIpdu03::SIGNALS::IndcrSts_UB::UB::Disturb =0;
//    @IL_FR1::NODES::N_VGM::PDUS::CEMBackBoneSignalIpdu03::SIGNALS::IndcrSts_UB::UB::Mode=1;
//    @IL_FR1::NODES::N_VGM::PDUS::CEMBackBoneSignalIpdu03::SIGNALS::IndcrSts_UB::UB::NormalOperation=1;
//    } 
//    else
//    {
//    @IL_FR1::NODES::N_VGM::PDUS::CEMBackBoneSignalIpdu03::SIGNALS::IndcrSts_UB::UB::Disturb=1;
//    @IL_FR1::NODES::N_VGM::PDUS::CEMBackBoneSignalIpdu03::SIGNALS::IndcrSts_UB::UB::Mode=0;
//    @IL_FR1::NODES::N_VGM::PDUS::CEMBackBoneSignalIpdu03::SIGNALS::IndcrSts_UB::UB::NormalOperation=0;
//    }
    //FaDC_IndcrSts_UB();
    
    
    
    
    
       //channel modify,
//    $Backbone::VGM::CEMBackBoneSignalIpdu03::DrvrPrsntStsDrvrPrsnt = @Carmaker2FC::DrvrPrsntStsDrvrPrsnt;          //channel modify,
//    $Backbone::VGM::CEMBackBoneSignalIpdu03::IndcrSts = @Carmaker2FC::IndcrSts;          //channel modify,

    
    //@FC2Carmaker_MyCarOutReturn::DoorDrvrLockSts=$Backbone::VGM::CEMBackBoneSignalIpdu03::DoorDrvrLockSts;
    //@FC2Carmaker_MyCarOutReturn::DoorDrvrSts=$Backbone::VGM::CEMBackBoneSignalIpdu03::DoorDrvrSts;
    //@FC2Carmaker_MyCarOutReturn::DoorLeReLockSts=$Backbone::VGM::CEMBackBoneSignalIpdu03::DoorLeReLockSts;
    //@FC2Carmaker_MyCarOutReturn::DoorLeReSts=$Backbone::VGM::CEMBackBoneSignalIpdu03::DoorLeReSts;
    //@FC2Carmaker_MyCarOutReturn::DoorPassLockSts=$Backbone::VGM::CEMBackBoneSignalIpdu03::DoorPassLockSts;
    //@FC2Carmaker_MyCarOutReturn::DoorPassSts=$Backbone::VGM::CEMBackBoneSignalIpdu03::DoorPassSts;
    //@FC2Carmaker_MyCarOutReturn::DoorRiReLockSts=$Backbone::VGM::CEMBackBoneSignalIpdu03::DoorRiReLockSts;
    //@FC2Carmaker_MyCarOutReturn::DoorRiReSts=$Backbone::VGM::CEMBackBoneSignalIpdu03::DoorRiReSts;
    //@FC2Carmaker_MyCarOutReturn::DrvrPrsntStsDrvrPrsnt=$Backbone::VGM::CEMBackBoneSignalIpdu03::DrvrPrsntStsDrvrPrsnt;
    //@FC2Carmaker_MyCarOutReturn::IndcrSts=$Backbone::VGM::CEMBackBoneSignalIpdu03::IndcrSts;
    //@FC2Carmaker_MyCarOutReturn::LcmaLedStsDrvrSide=$Backbone::VGM::CEMBackBoneSignalIpdu03::LcmaLedStsDrvrSide;
    //@FC2Carmaker_MyCarOutReturn::TrlrPrsnt=$Backbone::VGM::CEMBackBoneSignalIpdu03::TrlrPrsnt;
  }

  on frPDU CEMBackBoneSignalIpdu05
  {
    if(@Panel::SW == 1)
    {

      $Backbone::CEM::CEMBackBoneSignalIpdu05::TrlrPrsnt = @Panel::TrlrPrsnt;          //channel modify,
      $Backbone::CEM::CEMBackBoneSignalIpdu05::LcmaLedStsDrvrSide = @Panel::LcmaLedStsDrvrSide;
      $Backbone::CEM::CEMBackBoneSignalIpdu05::LcmaLedStsPassSide = @Panel::LcmaLedStsPassSide;
    }
    else
    {

      $Backbone::CEM::CEMBackBoneSignalIpdu05::TrlrPrsnt = @Carmaker2FC::TrlrPrsnt;          //channel modify,
      $Backbone::CEM::CEMBackBoneSignalIpdu05::LcmaLedStsDrvrSide = @Carmaker2FC::LcmaLedStsDrvrSide;
      $Backbone::CEM::CEMBackBoneSignalIpdu05::LcmaLedStsPassSide = @Carmaker2FC::LcmaLedStsPassSide;
      }   
  }
 
  on frPDU CEMBackBoneSignalIpdu06
  {
      $Backbone::CEM::CEMBackBoneSignalIpdu06::HzrdLiWarnCrashEve = @Carmaker2FC::HzrdLiWarnCrashEve;
   }
 
 /* 
 on frPDU CEMBackBoneSignalIpdu04
  {

    $Backbone::CEM::CEMBackBoneSignalIpdu04::VehCfgPrm_UB=1;
    if(@FaDC::VehCfgPrm_UB==1)
    {
      @IL_FR1::NODES::N_CEM::PDUS::CEMBackBoneSignalIpdu04::SIGGRPS::VehCfgPrm::UB::Disturb =0;
      @IL_FR1::NODES::N_CEM::PDUS::CEMBackBoneSignalIpdu04::SIGGRPS::VehCfgPrm::UB::Mode=1;
      @IL_FR1::NODES::N_CEM::PDUS::CEMBackBoneSignalIpdu04::SIGGRPS::VehCfgPrm::UB::NormalOperation=1;
     } 
    else
    {
      @IL_FR1::NODES::N_CEM::PDUS::CEMBackBoneSignalIpdu04::SIGGRPS::VehCfgPrm::UB::Disturb=1;
      @IL_FR1::NODES::N_CEM::PDUS::CEMBackBoneSignalIpdu04::SIGGRPS::VehCfgPrm::UB::Mode=0;
      @IL_FR1::NODES::N_CEM::PDUS::CEMBackBoneSignalIpdu04::SIGGRPS::VehCfgPrm::UB::NormalOperation=0;
    } 
    FaDC_VehCfgPrm_UB();

    if(@FaDC::DoorDrvrStsWithFacQly_UB==1)
    {
      @IL_FR1::NODES::N_CEM::PDUS::CEMBackBoneSignalIpdu02::SIGGRPS::DoorDrvrStsWithFacQly::UB::Disturb =0;
      @IL_FR1::NODES::N_CEM::PDUS::CEMBackBoneSignalIpdu02::SIGGRPS::DoorDrvrStsWithFacQly::UB::Mode=1;
      @IL_FR1::NODES::N_CEM::PDUS::CEMBackBoneSignalIpdu02::SIGGRPS::DoorDrvrStsWithFacQly::UB::NormalOperation=1;
    } 
    else
    {
    @IL_FR1::NODES::N_CEM::PDUS::CEMBackBoneSignalIpdu02::SIGGRPS::DoorDrvrStsWithFacQly::UB::Disturb=1;
    @IL_FR1::NODES::N_CEM::PDUS::CEMBackBoneSignalIpdu02::SIGGRPS::DoorDrvrStsWithFacQly::UB::Mode=0;
    @IL_FR1::NODES::N_CEM::PDUS::CEMBackBoneSignalIpdu02::SIGGRPS::DoorDrvrStsWithFacQly::UB::NormalOperation=0;
    }
    FaDC_DoorDrvrStsWithFacQly_UB();
    
    
    
 // $Backbone::VGM::CEMBackBoneSignalIpdu06::VehBattUSysUQf=@FaDC::VehBattUSysUQf;
 // $Backbone::VGM::CEMBackBoneSignalIpdu06::DoorDrvrStsWithFacQlyDoorSts = @Carmaker2FC::DoorDrvrStsWithFacQlyDoorSts;
  //$Backbone::VGM::CEMBackBoneSignalIpdu06::HoodSts = @Carmaker2FC::HoodSts;     
  //$DoorDrvrStsWithFacQlyFacQly=@FaDC::DoorDrvrStsWithFacQlyFacQly;
    
  //@FC2Carmaker_MyCarOutReturn::VehBattUSysUQf=$Backbone::VGM::CEMBackBoneSignalIpdu06::VehBattUSysUQf;
  //@FC2Carmaker_MyCarOutReturn::DoorDrvrStsWithFacQlyDoorSts=$Backbone::VGM::CEMBackBoneSignalIpdu06::DoorDrvrStsWithFacQlyDoorSts;
  //@FC2Carmaker_MyCarOutReturn::HoodSts=$Backbone::VGM::CEMBackBoneSignalIpdu06::HoodSts;



  Cfg_count++;
  if(Cfg_count<5)
  {

    if(@Carmaker2FC:: SwtIndcr_Cfg==2)
    {
      $Backbone::VGM::CEMBackBoneSignalIpdu23::VehCfgPrmExtBlkIDBytePosn1=0x1B;
      $Backbone::VGM::CEMBackBoneSignalIpdu23::VehCfgPrmExtCCPBytePosn2=@Carmaker2FC:: SwtIndcr_Cfg;
      $Backbone::VGM::CEMBackBoneSignalIpdu23::VehCfgPrmExtCCPBytePosn2=2;
    }
  }
    //--------
    if(@Carmaker2FC:: LDW_LKA_ELK_Cfg!=132&&@Carmaker2FC::language_Cfg!=10)
    {
      $VehCfgPrmBlk=0x1B;
      $Backbone::CEM::CEMBackBoneSignalIpdu04::VehCfgPrmBlk=0x2E;
      $Backbone::CEM::CEMBackBoneSignalIpdu04::VehCfgPrmVal1=@Carmaker2FC:: LDW_LKA_ELK_Cfg;
    }
    
    else
    {
      $Backbone::CEM::CEMBackBoneSignalIpdu04::VehCfgPrmBlk=CFG(@Panel::Vehicle_Cfg,Cfg_byte%72,0); 
      $Backbone::VGM::CEMBackBoneSignalIpdu23::VehCfgPrmExtBlkIDBytePosn1=CFG_Ext(@Panel::Vehicle_Cfg,Cfg_byte%72,0);
      
      //write VehCfgPrmCCPBytePosn2 value///
      switch($Backbone::CEM::CEMBackBoneSignalIpdu04::VehCfgPrmBlk)
      {
      case 1:
        $Backbone::CEM::CEMBackBoneSignalIpdu04::VehCfgPrmVal1=@Carmaker2FC::Vehicle_Cfg;
      break;

      case 2:
        $Backbone::CEM::CEMBackBoneSignalIpdu04::VehCfgPrmVal1=@Carmaker2FC::DOW_Cfg_rudder;
      break;
      case 46:
        $Backbone::CEM::CEMBackBoneSignalIpdu04::VehCfgPrmVal1=@Carmaker2FC::LDW_LKA_ELK_Cfg;
      break;
      case 99:
        $VehCfgPrmVal1=@Carmaker2FC::SwtIndcr_Cfg;
      break;
        
      case 27:
        $Backbone::VGM::CemBackBoneSignalIPdu23::VehCfgPrmExtCCPBytePosn2=@Carmaker2FC::SwtIndcr_Cfg;
      break;
        
        
      case 72:
        $Backbone::CEM::CEMBackBoneSignalIpdu04::VehCfgPrmVal3=@Carmaker2FC::DMS_Cfg;
      break;
        
     default:
        $Backbone::CEM::CEMBackBoneSignalIpdu04::VehCfgPrmVal1=CFG(@Panel::Vehicle_Cfg,Cfg_byte%72,1);
        $Backbone::VGM::CemBackBoneSignalIPdu23::VehCfgPrmExtCCPBytePosn2=CFG_Ext(@Panel::Vehicle_Cfg,Cfg_byte%72,1);
        $Backbone::CEM::CEMBackBoneSignalIpdu04::VehCfgPrmVal3=CFG(@Panel::Vehicle_Cfg,Cfg_byte%72,3);
      break;   
    }

       switch($Backbone::VGM::CemBackBoneSignalIPdu23::VehCfgPrmExtBlkIDBytePosn1)
    {
     case 27:
       $Backbone::VGM::CemBackBoneSignalIPdu23::VehCfgPrmExtCCPBytePosn2=@Carmaker2FC::SwtIndcr_Cfg; 
     break;

    }
   
    //write VehCfgPrmCCPBytePosn3 value///
   switch(Cfg_byte%72)
    {
      case 4:
        $Backbone::CEM::CEMBackBoneSignalIpdu04::VehCfgPrmVal2=@Carmaker2FC::ACC_Cfg;
        break;
      case 22:
        $Backbone::CEM::CEMBackBoneSignalIpdu04::VehCfgPrmVal2=@Carmaker2FC::TSI_Cfg;
        break;
      case 46:
        $Backbone::CEM::CEMBackBoneSignalIpdu04::VehCfgPrmVal2=@Carmaker2FC::EMA_Cfg;
       break;
      case 69:
        $Backbone::CEM::CEMBackBoneSignalIpdu04::VehCfgPrmVal2=@Carmaker2FC::DOW_Cfg_enable;
        break;
      default:
          $Backbone::CEM::CEMBackBoneSignalIpdu04::VehCfgPrmVal2=CFG(@Panel::Vehicle_Cfg,Cfg_byte%72,2);
          $Backbone::VGM::CemBackBoneSignalIPdu23::VehCfgPrmExtCCPBytePosn3=CFG_Ext(@Panel::Vehicle_Cfg,Cfg_byte%72,2);
        break; 
    }
    
    //write VehCfgPrmCCPBytePosn4 value///
    switch(Cfg_byte%72) 
      case 32:
        $Backbone::CEM::CEMBackBoneSignalIpdu04::VehCfgPrmVal3=@Carmaker2FC::language_Cfg;
      break;
     case 69:
        $Backbone::CEM::CEMBackBoneSignalIpdu04::VehCfgPrmVal3=@Carmaker2FC::FCTA_Cfg;
     break;
       
     case 72:
       $VehCfgPrmVal3=@Carmaker2FC::DMS_Cfg;
     break;
        
     default:
       $VehCfgPrmVal3=CFG(@Panel::Vehicle_Cfg,Cfg_byte%72,3);
       $Backbone::VGM::CemBackBoneSignalIPdu23::VehCfgPrmExtCCPBytePosn4=CFG_Ext(@Panel::Vehicle_Cfg,Cfg_byte%72,3);
      break; 
    
    //write VehCfgPrmCCPBytePosn5 value///
    switch(Cfg_byte%72)
    {
      case 71:
        $Backbone::CEM::CEMBackBoneSignalIpdu04::VehCfgPrmVal4=@Carmaker2FC::HWA_Cfg;
        break;
      default:
        $Backbone::CEM::CEMBackBoneSignalIpdu04::VehCfgPrmVal4=CFG(@Panel::Vehicle_Cfg,Cfg_byte%72,4);
        $Backbone::VGM::CemBackBoneSignalIPdu23::VehCfgPrmExtCCPBytePosn5=CFG_Ext(@Panel::Vehicle_Cfg,Cfg_byte%72,4);
        break; 
    }

    //write VehCfgPrmCCPBytePosn6 value///
    switch(Cfg_byte%72)
    {
      case 22:
        $Backbone::CEM::CEMBackBoneSignalIpdu04::VehCfgPrmVal5=@Carmaker2FC::RCTA_Cfg;
        break;
      default:
        $Backbone::CEM::CEMBackBoneSignalIpdu04::VehCfgPrmVal5=CFG(@Panel::Vehicle_Cfg,Cfg_byte%72,5);
        $Backbone::VGM::CEMBackBoneSignalIpdu23::VehCfgPrmExtCCPBytePosn6=CFG_Ext(@Panel::Vehicle_Cfg,Cfg_byte%72,5);
        break;
    }
    
    //write VehCfgPrmCCPBytePosn7 value///
    switch(Cfg_byte%72)
    
      case 22:
        $Backbone::CEM::CEMBackBoneSignalIpdu04::VehCfgPrmVal6=@Carmaker2FC::RCW_Cfg;
        break;
      default:
         $Backbone::CEM::CEMBackBoneSignalIpdu04::VehCfgPrmVal6=CFG(@Panel::Vehicle_Cfg,Cfg_byte%72,6);
        $Backbone::VGM::CemBackBoneSignalIPdu23::VehCfgPrmExtCCPBytePosn7=CFG_Ext(@Panel::Vehicle_Cfg,Cfg_byte%72,6);
        break;   
    
    //write VehCfgPrmCCPBytePosn8 value///
    $Backbone::CEM::CEMBackBoneSignalIpdu04::VehCfgPrmVal7=CFG(@Panel::Vehicle_Cfg,Cfg_byte%72,7);
    $Backbone::VGM::CemBackBoneSignalIPdu23::VehCfgPrmExtCCPBytePosn8=CFG_Ext(@Panel::Vehicle_Cfg,Cfg_byte%72,7);
    }
     
  }
  else
  {
    Cfg_count=0;
    Cfg_byte++;
  }
  
    $Backbone::CEM::CEMBackBoneSignalIpdu04::VehCfgPrm_UB=1;  
  }
}
*/

  
//  on frPDU CEMBackBoneSignalIpdu07
//  {
//  $Backbone::VGM::CEMBackBoneSignalIpdu07::WipgInfoWipgSpdInfo = @Carmaker2FC::WipgInfoWipgSpdInfo;
//    
//    //@FC2Carmaker_MyCarOutReturn::WipgInfoWipgSpdInfo=$Backbone::VGM::CEMBackBoneSignalIpdu07::WipgInfoWipgSpdInfo;
//  }    
  
  on frPDU CEMBackBoneSignalIpdu07
  {
    Vin_count++;
	if(Vin_count>14)
	  {
	    Vin_count=0;
		$Backbone::CEM::CEMBackBoneSignalIpdu07::VinBlk=VIN_V446K[2][0];
		$Backbone::CEM::CEMBackBoneSignalIpdu07::VinPosn1=VIN_V446K[2][1]; 
		$Backbone::CEM::CEMBackBoneSignalIpdu07::VinPosn2=VIN_V446K[2][2];          
		$Backbone::CEM::CEMBackBoneSignalIpdu07::VinPosn3=VIN_V446K[2][3];          
		$Backbone::CEM::CEMBackBoneSignalIpdu07::VinPosn4=VIN_V446K[2][4];          
		$Backbone::CEM::CEMBackBoneSignalIpdu07::VinPosn5=VIN_V446K[2][5];
		$Backbone::CEM::CEMBackBoneSignalIpdu07::VinPosn6=VIN_V446K[2][6];  
		$Backbone::CEM::CEMBackBoneSignalIpdu07::VinPosn7=VIN_V446K[2][7]; 
	  }
    else if( (Vin_count >=2&& Vin_count <=4)||Vin_count ==10||Vin_count ==11 )
    {
				$Backbone::CEM::CEMBackBoneSignalIpdu07::VinBlk=VIN_V446K[0][0];
				$Backbone::CEM::CEMBackBoneSignalIpdu07::VinPosn1=VIN_V446K[0][1]; 
				$Backbone::CEM::CEMBackBoneSignalIpdu07::VinPosn2=VIN_V446K[0][2];          
				$Backbone::CEM::CEMBackBoneSignalIpdu07::VinPosn3=VIN_V446K[0][3];          
				$Backbone::CEM::CEMBackBoneSignalIpdu07::VinPosn4=VIN_V446K[0][4];          
				$Backbone::CEM::CEMBackBoneSignalIpdu07::VinPosn5=VIN_V446K[0][5];
				$Backbone::CEM::CEMBackBoneSignalIpdu07::VinPosn6=VIN_V446K[0][6];  
				$Backbone::CEM::CEMBackBoneSignalIpdu07::VinPosn7=VIN_V446K[0][7]; 
	}
    else if( (Vin_count >=12&&Vin_count <=14)||Vin_count ==5||Vin_count ==6 )
    {
			    $Backbone::CEM::CEMBackBoneSignalIpdu07::VinBlk=VIN_V446K[1][0];
				$Backbone::CEM::CEMBackBoneSignalIpdu07::VinPosn1=VIN_V446K[1][1]; 
				$Backbone::CEM::CEMBackBoneSignalIpdu07::VinPosn2=VIN_V446K[1][2];          
				$Backbone::CEM::CEMBackBoneSignalIpdu07::VinPosn3=VIN_V446K[1][3];          
				$Backbone::CEM::CEMBackBoneSignalIpdu07::VinPosn4=VIN_V446K[1][4];          
				$Backbone::CEM::CEMBackBoneSignalIpdu07::VinPosn5=VIN_V446K[1][5];
				$Backbone::CEM::CEMBackBoneSignalIpdu07::VinPosn6=VIN_V446K[1][6];  
				$Backbone::CEM::CEMBackBoneSignalIpdu07::VinPosn7=VIN_V446K[1][7]; 
	}
    else if( (Vin_count >=7&&Vin_count <=9)||Vin_count ==1 )
    {
				$Backbone::CEM::CEMBackBoneSignalIpdu07::VinBlk=VIN_V446K[2][0];
				$Backbone::CEM::CEMBackBoneSignalIpdu07::VinPosn1=VIN_V446K[2][1]; 
				$Backbone::CEM::CEMBackBoneSignalIpdu07::VinPosn2=VIN_V446K[2][2];          
				$Backbone::CEM::CEMBackBoneSignalIpdu07::VinPosn3=VIN_V446K[2][3];          
				$Backbone::CEM::CEMBackBoneSignalIpdu07::VinPosn4=VIN_V446K[2][4];          
				$Backbone::CEM::CEMBackBoneSignalIpdu07::VinPosn5=VIN_V446K[2][5];
				$Backbone::CEM::CEMBackBoneSignalIpdu07::VinPosn6=VIN_V446K[2][6];  
				$Backbone::CEM::CEMBackBoneSignalIpdu07::VinPosn7=VIN_V446K[2][7]; 
	}

    $Vin_UB=1;
//  $Backbone::VGM::CEMBackBoneSignalIpdu08::TrLockSts = @Carmaker2FC::TrLockSts;          //channel modify,
    
    //@FC2Carmaker_MyCarOutReturn::TrLockSts=$Backbone::VGM::CEMBackBoneSignalIpdu08::TrLockSts;
  }
  
//  on frPDU CEMBackBoneSignalIpdu10
//  {
//  $Backbone::VGM::CEMBackBoneSignalIpdu10::RcwmLiActvd = @Carmaker2FC::RcwmLiActvd;
//    
//    //@FC2Carmaker_MyCarOutReturn::RcwmLiActvd=$Backbone::VGM::CEMBackBoneSignalIpdu10::RcwmLiActvd;
//  }
  
  
  
//  on frPDU CEMBackBoneSignalIpdu18
//  {
//  $Backbone::VGM::CEMBackBoneSignalIpdu18::AlrmStsAlrmSt = @Carmaker2FC::AlrmStsAlrmSt;
//    
//    //@FC2Carmaker_MyCarOutReturn::AlrmStsAlrmSt=$Backbone::VGM::CEMBackBoneSignalIpdu18::AlrmStsAlrmSt;
//  }
  
//  on frPDU CemBackBoneSignalIPdu25
//  {
//
////    if(@FaDC::SwtIndcr_UB==1)
////    {
////    @IL_FR1::NODES::N_VGM::PDUS::CemBackBoneSignalIPdu25::SIGGRPS::SwtIndcr::UB::Disturb =0;
////    @IL_FR1::NODES::N_VGM::PDUS::CemBackBoneSignalIPdu25::SIGGRPS::SwtIndcr::UB::Mode=1;
////    @IL_FR1::NODES::N_VGM::PDUS::CemBackBoneSignalIPdu25::SIGGRPS::SwtIndcr::UB::NormalOperation=1;
////
////    } 
////    else
////    {
////    @IL_FR1::NODES::N_VGM::PDUS::CemBackBoneSignalIPdu25::SIGGRPS::SwtIndcr::UB::Disturb=1;
////    @IL_FR1::NODES::N_VGM::PDUS::CemBackBoneSignalIPdu25::SIGGRPS::SwtIndcr::UB::Mode=0;
////    @IL_FR1::NODES::N_VGM::PDUS::CemBackBoneSignalIPdu25::SIGGRPS::SwtIndcr::UB::NormalOperation=0;
////    }
//    //FaDC_SwtIndcr_UB();
//    
//    
//    //20250117_fanjunjie_add
////     if(@FaDC::SwtIndcrIndcrTypExtReqChks_Control==0)
////    {
////    ILNodeDisturbChecksum("CemBackBoneSignalIPdu25","SwtIndcrIndcrTypExtReq",0,0,1000,0);
////    }
////    else
////    {
////    ILNodeDisturbChecksum("CemBackBoneSignalIPdu25","SwtIndcrIndcrTypExtReq",0,1,0,0);
////    }
////      if((@FaDC::SwtIndcrIndcrTypExtReqCntr_Control==0&&temp_SwtIndcrIndcrTypExtReqCntr_Control==1))
////    {
////    @IL_FR1::NODES::N_VGM::PDUS::CemBackBoneSignalIPdu25::SIGGRPS::SwtIndcrIndcrTypExtReq::CNTR::Disturb=1;
////    }
////    else
////    {
////    @IL_FR1::NODES::N_VGM::PDUS::CemBackBoneSignalIPdu25::SIGGRPS::SwtIndcrIndcrTypExtReq::CNTR::Disturb=0;
////    }
////    if((@FaDC::SwtIndcrIndcrTypExtReqCntr_Control==1&&temp_SwtIndcrIndcrTypExtReqCntr_Control==0))
////    { 
////    @IL_FR1::NODES::N_VGM::PDUS::CemBackBoneSignalIPdu25::SIGGRPS::SwtIndcrIndcrTypExtReq::CNTR::NormalOperation=1;
////    }
////    else
////    {
////    @IL_FR1::NODES::N_VGM::PDUS::CemBackBoneSignalIPdu25::SIGGRPS::SwtIndcrIndcrTypExtReq::CNTR::NormalOperation=0;
////    }
////    temp_SwtIndcrIndcrTypExtReqChks_Control=@FaDC::SwtIndcrIndcrTypExtReqChks_Control;
////    temp_SwtIndcrIndcrTypExtReqCntr_Control=@FaDC::SwtIndcrIndcrTypExtReqCntr_Control;
//    //FaDC_SwtIndcrIndcrTypExtReq_E2E();
//    
//   
//    
//    

//  $Backbone::VGM::CemBackBoneSignalIPdu25::SwtIndcrIndcrTypExtReq = @Carmaker2FC::SwtIndcrIndcrTypExtReq;          //channel modify,
//  $Backbone::VGM::CemBackBoneSignalIPdu25::TrSts = @Carmaker2FC::TrSts;          //channel modify,
//    

//  //@FC2Carmaker_MyCarOutReturn::SwtIndcrIndcrTypExtReq=$Backbone::VGM::CemBackBoneSignalIPdu25::SwtIndcrIndcrTypExtReq;
//  //@FC2Carmaker_MyCarOutReturn::TrSts=$Backbone::VGM::CemBackBoneSignalIPdu25::TrSts;
//  }
 
  
  on frPDU CEMBackBoneSignalIpdu27
  {
    
  $DirctnIndcrStlkPos = @Carmaker2FC::DirctnIndcrStlkPos;
  $DirctnIndcrStlkPos_UB  = 1;
  $Backbone::CEM::CEMBackBoneSignalIpdu27::DirctnIndcrSts_UB  = 1;   
  $Backbone::CEM::CEMBackBoneSignalIpdu27::DirctnIndcrStsDirctnIndcrSts  = @Carmaker2FC::DirctnIndcrStsDirctnIndcrSts; 
    
   }  
  
//  on frPDU CemBackBoneSignalIPdu54
//  {
//  $Backbone::VGM::CemBackBoneSignalIPdu54::TurnIndcrMonostableQf = @FaDC::TurnIndcrMonostableQf;
//  $Backbone::VGM::CemBackBoneSignalIPdu54::TurnIndcrMonostableTurnIndcrMonostable=@Carmaker2FC::TurnIndcrMonostable;
//  //@FC2Carmaker_MyCarOutReturn::TurnIndcrMonostableQf=$Backbone::VGM::CemBackBoneSignalIPdu54::TurnIndcrMonostableQf;
//  //@FC2Carmaker_MyCarOutReturn::TurnIndcrMonostable=$Backbone::VGM::CemBackBoneSignalIPdu54::TurnIndcrMonostableTurnIndcrMonostable;
//  
//   //20250117_fanjunjie_add
////  if(@FaDC::TurnIndcrMonostable_UB==1)
////  {
////  @IL_FR1::NODES::N_VGM::PDUS::CemBackBoneSignalIPdu54::SIGGRPS::TurnIndcrMonostable::UB::Disturb =0;
////  @IL_FR1::NODES::N_VGM::PDUS::CemBackBoneSignalIPdu54::SIGGRPS::TurnIndcrMonostable::UB::Mode=1;
////  @IL_FR1::NODES::N_VGM::PDUS::CemBackBoneSignalIPdu54::SIGGRPS::TurnIndcrMonostable::UB::NormalOperation=1;
////  } 
////  else
////  {
////  @IL_FR1::NODES::N_VGM::PDUS::CemBackBoneSignalIPdu54::SIGGRPS::TurnIndcrMonostable::UB::Disturb=1;
////  @IL_FR1::NODES::N_VGM::PDUS::CemBackBoneSignalIPdu54::SIGGRPS::TurnIndcrMonostable::UB::Mode=0;
////  @IL_FR1::NODES::N_VGM::PDUS::CemBackBoneSignalIPdu54::SIGGRPS::TurnIndcrMonostable::UB::NormalOperation=0;
////  }
//  //FaDC_TurnIndcrMonostable_UB();
//  
//  
//    
//    //20250117_fanjunjie_add
////      if(@FaDC::TurnIndcrMonostableChks_Control==0)
////    {
////    ILNodeDisturbChecksum("CemBackBoneSignalIPdu54","TurnIndcrMonostable",0,0,1000,0);
////    }
////    else
////    {
////    ILNodeDisturbChecksum("CemBackBoneSignalIPdu54","TurnIndcrMonostable",0,1,0,0);
////    }
////      if((@FaDC::TurnIndcrMonostableCntr_Control==0&&temp_TurnIndcrMonostableCntr_Control==1))
////    {
////    @IL_FR1::NODES::N_VGM::PDUS::CemBackBoneSignalIPdu54::SIGGRPS::TurnIndcrMonostable::CNTR::Disturb=1;
////    }
////    else
////    {
////    @IL_FR1::NODES::N_VGM::PDUS::CemBackBoneSignalIPdu54::SIGGRPS::TurnIndcrMonostable::CNTR::Disturb=0;
////    }
////    if((@FaDC::TurnIndcrMonostableCntr_Control==1&&temp_TurnIndcrMonostableCntr_Control==0))
////    { 
////    @IL_FR1::NODES::N_VGM::PDUS::CemBackBoneSignalIPdu54::SIGGRPS::TurnIndcrMonostable::CNTR::NormalOperation=1;
////    }
////    else
////    {
////    @IL_FR1::NODES::N_VGM::PDUS::CemBackBoneSignalIPdu54::SIGGRPS::TurnIndcrMonostable::CNTR::NormalOperation=0;
////    }
////    temp_TurnIndcrMonostableChks_Control=@FaDC::TurnIndcrMonostableChks_Control;
////    temp_TurnIndcrMonostableCntr_Control=@FaDC::TurnIndcrMonostableCntr_Control;
//    //FaDC_TurnIndcrMonostable_E2E();
//  
//  
//  
//    
//  }
  
  
  on frPDU DIMBackBoneSignalIPdu02
  {
    $SteerAutDrvActvReq = @Carmaker2FC::SteerAutDrvActvReq;
    $SteerAutDrvDeactvnReq = @Carmaker2FC::SteerAutDrvDeactvnReq;
    $LaneKeepAidActvSts=@Carmaker2FC::LaneKeepAidActvSts;
    $IntvAndWarnModForLaneKeepAidSts=@Carmaker2FC::IntvAndWarnModForLaneKeepAidSts;
    $AccSts=@Carmaker2FC::AccSts;
    //$BkpOfDstTrvld=@Carmaker2FC::BkpOfDstTrvld;
    
  
//  $Backbone::IHU::DIMBackBoneSignalIPdu02::DrvrACCFctDeactvnReqSts = @Carmaker2FC::DrvrACCFctDeactvnReqSts;
    
  //@FC2Carmaker_MyCarOutReturn::DrvrACCFctDeactvnReqSts=$Backbone::IHU::DIMBackBoneSignalIPdu02::DrvrACCFctDeactvnReqSts;
    
  }
  
  on frPDU DIMBackBoneSignalIPdu04
  {
    
    // $SetSpdForCrsCtrlFct = @Carmaker2FC::SetSpdForCrsCtrlFct;
    $SpdLimnAdpvRespByDrvr = @Carmaker2FC::SpdLimnAdpvRespByDrvr;
    

//    $Backbone::IHU::DIMBackBoneSignalIPdu04::DrvrACCrsSetSpdReqDrvrCrsSetSpdReq = @Carmaker2FC::DrvrACCrsSetSpdReqDrvrCrsSetSpdReq;
  
   //////Set ACC Panel Speed Control////   
  
//  $Backbone::IHU::DIMBackBoneSignalIPdu04::AsyAutDrvCtrlTypDIMReq = @Carmaker2FC::AsyAutDrvCtrlTypDIMReq;
//  $Backbone::IHU::DIMBackBoneSignalIPdu04::DrvrACCrsSetSpdReqDrvrACCrsCtrlSetInSpdReq = @Carmaker2FC::DrvrACCrsSetSpdReqDrvrACCrsCtrlSetInSpdReq;
//  $Backbone::IHU::DIMBackBoneSignalIPdu04::VehSpdIndcdVeSpdIndcdUnit = @Carmaker2FC::VehSpdIndcdVeSpdIndcdUnit;          //channel modify,
//  $Backbone::IHU::DIMBackBoneSignalIPdu04::DrvrACCrsSetSpdReqSetSpdForCrsCtrlFctActive = @Carmaker2FC::DrvrACCrsSetSpdReqSetSpdForCrsCtrlFctActive;
  
 
//  if($Backbone::IHU::DIMBackBoneSignalIPdu04::VehSpdIndcdVeSpdIndcdUnit==1)
//  {   
//      if ((@Carmaker2FC::VehSpdLgtA*2.237)<24.86)
//        { $Backbone::IHU::DIMBackBoneSignalIPdu04::VehSpdIndcdVehSpdIndcd=round(@Carmaker2FC::VehSpdLgtA*2.237*1.05);}
//        
//    else if ((@Carmaker2FC::VehSpdLgtA*2.237)<161.56 && (@Carmaker2FC::VehSpdLgtA*2.237)>=24.86)
//        { $Backbone::IHU::DIMBackBoneSignalIPdu04::VehSpdIndcdVehSpdIndcd=round(@Carmaker2FC::VehSpdLgtA*2.237*1.02+0.75);}
//      
//     else      
//       { $Backbone::IHU::DIMBackBoneSignalIPdu04::VehSpdIndcdVehSpdIndcd=round(@Carmaker2FC::VehSpdLgtA*2.237+4);}
//   
//  }
//  else
//  {
//   
//   if(@Carmaker2FC::speed_swt==1) 
//    {
//      $Backbone::IHU::DIMBackBoneSignalIPdu04::VehSpdIndcdVehSpdIndcd= @Carmaker2FC::speed;
//      $ChassisCAN1::BBM::VddmChas1Fr10::WhlSpdCircumlFrntWhlSpdCircumlFrntRi= (@Carmaker2FC::speed)/3.6;   //20241204
//      $ChassisCAN1::BBM::VddmChas1Fr10::WhlSpdCircumlFrntLe= (@Carmaker2FC::speed)/3.6;   //20241204
//      $ChassisCAN1::BBM::VddmChas1Fr55::WhlSpdCircumlReLe= (@Carmaker2FC::speed)/3.6;   //20241204
//      $ChassisCAN1::BBM::VddmChas1Fr55::WhlSpdCircumlReRi= (@Carmaker2FC::speed)/3.6;   //20241204
//      
//      $Backbone::BBM::VddmBackBoneSignalIPdu40::WhlSpdCircumlFrntWhlSpdCircumlFrntRi= (@Carmaker2FC::speed)/3.6;   //20241204
//      $Backbone::BBM::VddmBackBoneSignalIPdu40::WhlSpdCircumlFrntLe= (@Carmaker2FC::speed)/3.6;   //20241204
//      $Backbone::BBM::VddmBackBoneSignalIPdu40::WhlSpdCircumlReLe= (@Carmaker2FC::speed)/3.6;   //20241204
//      $Backbone::BBM::VddmBackBoneSignalIPdu40::WhlSpdCircumlReRi= (@Carmaker2FC::speed)/3.6;   //20241204
//    }
//   else
//    {  
//    if (@Carmaker2FC::VehSpdLgtA*3.6<40)
//      { $Backbone::IHU::DIMBackBoneSignalIPdu04::VehSpdIndcdVehSpdIndcd=round(abs(@Carmaker2FC::VehSpdLgtA)*3.6*(1+0.05));}
//      
//    else if (@Carmaker2FC::VehSpdLgtA*3.6<260 &&@Carmaker2FC::VehSpdLgtA*3.6>=40)
//      { $Backbone::IHU::DIMBackBoneSignalIPdu04::VehSpdIndcdVehSpdIndcd=round(abs(@Carmaker2FC::VehSpdLgtA)*3.6*(1+0.02)+1.2);}
//
//    else      
//      { $Backbone::IHU::DIMBackBoneSignalIPdu04::VehSpdIndcdVehSpdIndcd=round(abs(@Carmaker2FC::VehSpdLgtA)*3.6+6.5);}
//
//    }  
//       $VehSpdAvgIndcdVehSpdIndcd=round(abs(@Carmaker2FC::VehSpdIndcdVehSpdIndcd)*3.6); 
//  }     
    
    
    
//  waste 20241029 -sun you////
//if($Backbone::IHU::DIMBackBoneSignalIPdu04::VehSpdIndcdVeSpdIndcdUnit==1)
//{   
//  if ((@Carmaker2FC::VehSpdIndcdVehSpdIndcd*2.237)<24.86)
//    { 
//      $Backbone::IHU::DIMBackBoneSignalIPdu04::VehSpdIndcdVehSpdIndcd=round(@Carmaker2FC::VehSpdIndcdVehSpdIndcd*2.237*1.05);
//    }
//    
//  else if ((@Carmaker2FC::VehSpdIndcdVehSpdIndcd*2.237)<161.56 && (@Carmaker2FC::VehSpdIndcdVehSpdIndcd*2.237)>=24.86)
//    { 
//      $Backbone::IHU::DIMBackBoneSignalIPdu04::VehSpdIndcdVehSpdIndcd=round(@Carmaker2FC::VehSpdIndcdVehSpdIndcd*2.237*1.02+0.75);
//    }
//
//  else      
//   { 
//    $Backbone::IHU::DIMBackBoneSignalIPdu04::VehSpdIndcdVehSpdIndcd=round(@Carmaker2FC::VehSpdIndcdVehSpdIndcd*2.237+4);
//   }
//}
//else
//{
//  if(@Carmaker2FC::VehSpdLgtA_Set >0 &&@Carmaker2FC::VehSpdIndcdVehSpdIndcd_Set==0) 
//    { 
//      $Backbone::IHU::DIMBackBoneSignalIPdu04::VehSpdIndcdVehSpdIndcd=abs( @Carmaker2FC::VehSpdLgtA_Set)*3.6;
//      $Backbone::BBM::BcmVddmBackBoneSignalIPdu06::VehSpdLgtA=@Carmaker2FC::VehSpdLgtA_Set;
//    }
//  else if(@Carmaker2FC::VehSpdIndcdVehSpdIndcd_Set>0 && @Carmaker2FC::VehSpdLgtA_Set ==0)
//    {
//      $Backbone::IHU::DIMBackBoneSignalIPdu04::VehSpdIndcdVehSpdIndcd=@Carmaker2FC::VehSpdIndcdVehSpdIndcd_Set;
//      $Backbone::BBM::BcmVddmBackBoneSignalIPdu06::VehSpdLgtA=@Carmaker2FC::VehSpdIndcdVehSpdIndcd_Set/3.6;
//    }
//  else
//  {  
//    if (@Carmaker2FC::VehSpdIndcdVehSpdIndcd*3.6<40)
//      {
//        $Backbone::IHU::DIMBackBoneSignalIPdu04::VehSpdIndcdVehSpdIndcd=round(abs(@Carmaker2FC::VehSpdIndcdVehSpdIndcd)*3.6*(1+0.05));
//      }
//      
//    else if (@Carmaker2FC::VehSpdIndcdVehSpdIndcd*3.6<260 &&@Carmaker2FC::VehSpdIndcdVehSpdIndcd*3.6>=40)
//    {
//      $Backbone::IHU::DIMBackBoneSignalIPdu04::VehSpdIndcdVehSpdIndcd=round(abs(@Carmaker2FC::VehSpdIndcdVehSpdIndcd)*3.6*(1+0.02)+1.2);
//    }
//
//    else      
//    { 
//      $Backbone::IHU::DIMBackBoneSignalIPdu04::VehSpdIndcdVehSpdIndcd=round(abs(@Carmaker2FC::VehSpdIndcdVehSpdIndcd)*3.6+6.5);
//    }
//
//   }  
//} 
//  waste 20241029 -sun you////
  
  
  //@FC2Carmaker_MyCarOutReturn::AsyAutDrvCtrlTypDIMReq=$Backbone::IHU::DIMBackBoneSignalIPdu04::AsyAutDrvCtrlTypDIMReq;
  //@FC2Carmaker_MyCarOutReturn::DrvrACCrsSetSpdReqDrvrACCrsCtrlSetInSpdReq=$Backbone::IHU::DIMBackBoneSignalIPdu04::DrvrACCrsSetSpdReqDrvrACCrsCtrlSetInSpdReq;
  //@FC2Carmaker_MyCarOutReturn::DrvrACCrsSetSpdReqDrvrCrsSetSpdReq=$Backbone::IHU::DIMBackBoneSignalIPdu04::DrvrACCrsSetSpdReqDrvrCrsSetSpdReq;
  //@FC2Carmaker_MyCarOutReturn::VehSpdIndcdVehSpdIndcd=$Backbone::IHU::DIMBackBoneSignalIPdu04::VehSpdIndcdVehSpdIndcd;
  //@FC2Carmaker_MyCarOutReturn::VehSpdIndcdVeSpdIndcdUnit=$Backbone::IHU::DIMBackBoneSignalIPdu04::VehSpdIndcdVeSpdIndcdUnit;
  //@FC2Carmaker_MyCarOutReturn::DrvrACCrsSetSpdReqSetSpdForCrsCtrlFctActive=$Backbone::IHU::DIMBackBoneSignalIPdu04::DrvrACCrsSetSpdReqSetSpdForCrsCtrlFctActive;
  $VehSpdIndcdQly =@sysvar::FaDC::VehSpdIndcdQly ;
  }
    
  on frPDU DIMBackBoneSignalIPdu07
  {
//  if(@FaDC::CrsCtrlTiGapAdjReq_UB==1)
//  {
//  @IL_FR1::NODES::N_IHU::PDUS::DIMBackBoneSignalIPdu07::SIGNALS::CrsCtrlTiGapAdjReq_UB::UB::Disturb =0;
//  @IL_FR1::NODES::N_IHU::PDUS::DIMBackBoneSignalIPdu07::SIGNALS::CrsCtrlTiGapAdjReq_UB::UB::Mode=1;
//  @IL_FR1::NODES::N_IHU::PDUS::DIMBackBoneSignalIPdu07::SIGNALS::CrsCtrlTiGapAdjReq_UB::UB::NormalOperation=1;
//  } 
//  else
//  {
//  @IL_FR1::NODES::N_IHU::PDUS::DIMBackBoneSignalIPdu07::SIGNALS::CrsCtrlTiGapAdjReq_UB::UB::Disturb=1;
//  @IL_FR1::NODES::N_IHU::PDUS::DIMBackBoneSignalIPdu07::SIGNALS::CrsCtrlTiGapAdjReq_UB::UB::Mode=0;
//  @IL_FR1::NODES::N_IHU::PDUS::DIMBackBoneSignalIPdu07::SIGNALS::CrsCtrlTiGapAdjReq_UB::UB::NormalOperation=0;
//  }
  //FaDC_CrsCtrlTiGapAdjReq_UB();
  
//    
//  if(@FaDC::DrvrCrsCtrlFctActvReq_UB==1)
//  {
//  @IL_FR1::NODES::N_IHU::PDUS::DIMBackBoneSignalIPdu07::SIGNALS::DrvrCrsCtrlFctActvReq_UB::UB::Disturb =0;
//  @IL_FR1::NODES::N_IHU::PDUS::DIMBackBoneSignalIPdu07::SIGNALS::DrvrCrsCtrlFctActvReq_UB::UB::Mode=1;
//  @IL_FR1::NODES::N_IHU::PDUS::DIMBackBoneSignalIPdu07::SIGNALS::DrvrCrsCtrlFctActvReq_UB::UB::NormalOperation=1;
//  } 
//  else
//  {
//  @IL_FR1::NODES::N_IHU::PDUS::DIMBackBoneSignalIPdu07::SIGNALS::DrvrCrsCtrlFctActvReq_UB::UB::Disturb=1;
//  @IL_FR1::NODES::N_IHU::PDUS::DIMBackBoneSignalIPdu07::SIGNALS::DrvrCrsCtrlFctActvReq_UB::UB::Mode=0;
//  @IL_FR1::NODES::N_IHU::PDUS::DIMBackBoneSignalIPdu07::SIGNALS::DrvrCrsCtrlFctActvReq_UB::UB::NormalOperation=0;
//  }
  //FaDC_DrvrCrsCtrlFctActvReq_UB();
  
    
//  if(@FaDC::SftySigGroupFromHmiSafe1_UB==1)
//  {
//  @IL_FR1::NODES::N_IHU::PDUS::DIMBackBoneSignalIPdu07::SIGGRPS::SftySigGroupFromHmiSafe1::UB::Disturb =1;
//  @IL_FR1::NODES::N_IHU::PDUS::DIMBackBoneSignalIPdu07::SIGGRPS::SftySigGroupFromHmiSafe1::UB::Mode=0;
//  @IL_FR1::NODES::N_IHU::PDUS::DIMBackBoneSignalIPdu07::SIGGRPS::SftySigGroupFromHmiSafe1::UB::NormalOperation=0;
//    @IL_FR1::NODES::N_IHU::PDUS::DIMBackBoneSignalIPdu07::SIGGRPS::SftySigGroupFromHmiSafe1::UB::Value=1;
//  } 
//  else
//  {
//  @IL_FR1::NODES::N_IHU::PDUS::DIMBackBoneSignalIPdu07::SIGGRPS::SftySigGroupFromHmiSafe1::UB::Disturb=1;
//  @IL_FR1::NODES::N_IHU::PDUS::DIMBackBoneSignalIPdu07::SIGGRPS::SftySigGroupFromHmiSafe1::UB::Mode=0;
//  @IL_FR1::NODES::N_IHU::PDUS::DIMBackBoneSignalIPdu07::SIGGRPS::SftySigGroupFromHmiSafe1::UB::NormalOperation=0;
//  @IL_FR1::NODES::N_IHU::PDUS::DIMBackBoneSignalIPdu07::SIGGRPS::SftySigGroupFromHmiSafe1::UB::Value=0;
//  }
  //FaDC_SftySigGroupFromHmiSafe1_UB();
  
  
//  if(@FaDC::SftySigGroupFromHmiSafe1SftySigGroupFromHmiSafeChks_Control==0)
//    {
//    ILNodeDisturbChecksum("DIMBackBoneSignalIPdu07","SftySigGroupFromHmiSafe1",0,0,1000,0);
//    }
//    else
//    {
//    ILNodeDisturbChecksum("DIMBackBoneSignalIPdu07","SftySigGroupFromHmiSafe1",0,1,0,0);
//    }
//  //kangrui-2025/2/7-add  
//  if((@FaDC::SftySigGroupFromHmiSafe1SftySigGroupFromHmiSafeCntr_Control==0&&temp_SftySigGroupFromHmiSafe1SftySigGroupFromHmiSafeCntr_Control==1))
//  {
//  @IL_FR1::NODES::N_IHU::PDUS::DIMBackBoneSignalIPdu07::SIGGRPS::SftySigGroupFromHmiSafe1::CNTR::Disturb=1;
//  }
//  else
//  {
//  @IL_FR1::NODES::N_IHU::PDUS::DIMBackBoneSignalIPdu07::SIGGRPS::SftySigGroupFromHmiSafe1::CNTR::Disturb=0;
//  }
//  
//  if((@FaDC::SftySigGroupFromHmiSafe1SftySigGroupFromHmiSafeCntr_Control==1&&temp_SftySigGroupFromHmiSafe1SftySigGroupFromHmiSafeCntr_Control==0))
//  {  
//  @IL_FR1::NODES::N_IHU::PDUS::DIMBackBoneSignalIPdu07::SIGGRPS::SftySigGroupFromHmiSafe1::CNTR::NormalOperation=1;
//  }
//  else
//  {
//  @IL_FR1::NODES::N_IHU::PDUS::DIMBackBoneSignalIPdu07::SIGGRPS::SftySigGroupFromHmiSafe1::CNTR::NormalOperation=0;
//  }
//
//  temp_SftySigGroupFromHmiSafe1SftySigGroupFromHmiSafeChks_Control=@FaDC::SftySigGroupFromHmiSafe1SftySigGroupFromHmiSafeChks_Control;
//  temp_SftySigGroupFromHmiSafe1SftySigGroupFromHmiSafeCntr_Control=@FaDC::SftySigGroupFromHmiSafe1SftySigGroupFromHmiSafeCntr_Control;
  //FaDC_SftySigGroupFromHmiSafe1SftySigGroupFromHmiSafe_E2E();
  
//    
//    if(@Panel::SW == 1)
//      {
//      $Backbone::IHU::DIMBackBoneSignalIPdu07::CrsCtrlTiGapAdjReq = @Panel::CrsCtrlTiGapAdjReq;
//      $Backbone::IHU::DIMBackBoneSignalIPdu07::SftySigGroupFromHmiSafe1SftyHmiEna = @Panel::SftySigGroupFromHmiSafe1SftyHmiEna;
//      }
//    else
//      {
//      $Backbone::IHU::DIMBackBoneSignalIPdu07::CrsCtrlTiGapAdjReq = @Carmaker2FC::CrsCtrlTiGapAdjReq;
//      $Backbone::IHU::DIMBackBoneSignalIPdu07::SftySigGroupFromHmiSafe1SftyHmiEna = @Carmaker2FC::SftySigGroupFromHmiSafe1SftyHmiEna;
//      }
//    
//  $Backbone::IHU::DIMBackBoneSignalIPdu07::DrvrCrsCtrlFctActvReq = @Carmaker2FC::DrvrCrsCtrlFctActvReq;

  //@FC2Carmaker_MyCarOutReturn::CrsCtrlTiGapAdjReq=$Backbone::IHU::DIMBackBoneSignalIPdu07::CrsCtrlTiGapAdjReq;
  //@FC2Carmaker_MyCarOutReturn::DrvrCrsCtrlFctActvReq=$Backbone::IHU::DIMBackBoneSignalIPdu07::DrvrCrsCtrlFctActvReq;
  //@FC2Carmaker_MyCarOutReturn::SftySigGroupFromHmiSafe1SftyHmiEna=$Backbone::IHU::DIMBackBoneSignalIPdu07::SftySigGroupFromHmiSafe1SftyHmiEna;

  }
  
   on frPDU DIMBackBoneSignalIPdu01
  { 
    $Backbone::DIM::DIMBackBoneSignalIPdu01::DrvrCrsCtrlFctActvReq = @Carmaker2FC::DrvrCrsCtrlFctActvReq;
    $Backbone::DIM::DIMBackBoneSignalIPdu01::DrvrCrsCtrlFctDeactvnReq = @Carmaker2FC::DrvrCrsCtrlFctDeactvnReq;
    
    $Backbone::DIM::DIMBackBoneSignalIPdu01::VehSpdIndcdUnit = @Carmaker2FC::VehSpdIndcdVeSpdIndcdUnit;          //channel modify,

      if($Backbone::DIM::DIMBackBoneSignalIPdu01::VehSpdIndcdUnit==1)
  {   
      if ((@Carmaker2FC::VehSpdLgtA*2.237)<24.86)
        { $Backbone::DIM::DIMBackBoneSignalIPdu01::VehSpdIndcdVal=round(@Carmaker2FC::VehSpdLgtA*2.237*1.05);}
        
    else if ((@Carmaker2FC::VehSpdLgtA*2.237)<161.56 && (@Carmaker2FC::VehSpdLgtA*2.237)>=24.86)
        { $Backbone::DIM::DIMBackBoneSignalIPdu01::VehSpdIndcdVal=round(@Carmaker2FC::VehSpdLgtA*2.237*1.02+0.75);}
      
     else      
       { $Backbone::DIM::DIMBackBoneSignalIPdu01::VehSpdIndcdVal=round(@Carmaker2FC::VehSpdLgtA*2.237+4);}
   
  }
  else
  {
   
   if(@Carmaker2FC::speed_swt==1) 
    {
      $Backbone::DIM::DIMBackBoneSignalIPdu01::VehSpdIndcdVal= @Carmaker2FC::speed;
//      $ChassisCAN1::BBM::VddmChas1Fr10::WhlSpdCircumlFrntWhlSpdCircumlFrntRi= (@Carmaker2FC::speed)/3.6;   //20241204
//      $ChassisCAN1::BBM::VddmChas1Fr10::WhlSpdCircumlFrntLe= (@Carmaker2FC::speed)/3.6;   //20241204
//      $ChassisCAN1::BBM::VddmChas1Fr55::WhlSpdCircumlReLe= (@Carmaker2FC::speed)/3.6;   //20241204
//      $ChassisCAN1::BBM::VddmChas1Fr55::WhlSpdCircumlReRi= (@Carmaker2FC::speed)/3.6;   //20241204
      
      $Backbone::VCU1::VDDMBackBoneSignalIPdu04::WhlSpdCircumlFrntWhlSpdCircumlFrntRi= (@Carmaker2FC::speed)/3.6;   //20241204
      $Backbone::VCU1::VDDMBackBoneSignalIPdu04::WhlSpdCircumlFrntLe= (@Carmaker2FC::speed)/3.6;   //20241204
      $Backbone::VCU1::VDDMBackBoneSignalIPdu04::WhlSpdCircumlReLe= (@Carmaker2FC::speed)/3.6;   //20241204
      $Backbone::VCU1::VDDMBackBoneSignalIPdu04::WhlSpdCircumlReRi= (@Carmaker2FC::speed)/3.6;   //20241204
    }
   else
    {  
    if (@Carmaker2FC::VehSpdLgtA*3.6<40)
      { $Backbone::DIM::DIMBackBoneSignalIPdu01::VehSpdIndcdVal=round(abs(@Carmaker2FC::VehSpdLgtA)*3.6*(1+0.05));}
      
    else if (@Carmaker2FC::VehSpdLgtA*3.6<260 &&@Carmaker2FC::VehSpdLgtA*3.6>=40)
      { $Backbone::DIM::DIMBackBoneSignalIPdu01::VehSpdIndcdVal=round(abs(@Carmaker2FC::VehSpdLgtA)*3.6*(1+0.02)+1.2);}

    else      
      { $Backbone::DIM::DIMBackBoneSignalIPdu01::VehSpdIndcdVal=round(abs(@Carmaker2FC::VehSpdLgtA)*3.6+6.5);}

    }  
    //   $VehSpdAvgIndcdVehSpdIndcd=round(abs(@Carmaker2FC::VehSpdIndcdVehSpdIndcd)*3.6);
    
  }  
    
    
    
  }
  
   on frPDU IHUBackboneSignalIPdu01
  { 
    $Backbone::IHU::IHUBackboneSignalIPdu01::DrvModReq = @Carmaker2FC::DrvModReq;          //channel modify,
    $Backbone::IHU::IHUBackboneSignalIPdu01::CtraSwOnOff2CtraSwBrkOnOff = @Carmaker2FC::CtraSwOnOff2CtraSwBrkOnOff;
    $Backbone::IHU::IHUBackboneSignalIPdu01::CtraSwOnOff2CtraSwOnOff2 = @Carmaker2FC::CtraSwOnOff2CtraSwOnOff2;
  }
  
  
//  on frPDU IHUBackBoneSignalIPdu03
//  {
//    
//  }
//  
//    on frPDU IHUBackBoneSignalIPdu02
//  {
//    
//  }
//  

  on frPDU IHUBackBoneSignalIPdu02 
  {
    $AccAdprTurnSpdActvSts = @Carmaker2FC::AccAdprTurnSpdActvSts;

    
    
//      if(@Panel::SW == 1)
//      {
//      $Backbone::IHU::IHUBackboneSignalIPdu02::DrvrLaneChgAutActvStsOnOff1 = @Panel::DrvrLaneChgAutActvStsOnOff1;
//      }
//      else
//      {
//      $Backbone::IHU::IHUBackboneSignalIPdu02::DrvrLaneChgAutActvStsOnOff1 = @Carmaker2FC::DrvrLaneChgAutActvStsOnOff1;
//     }
//      
//  $Backbone::IHU::IHUBackboneSignalIPdu02::HznEdgeFormOfWay = @Carmaker2FC::HznEdgeFormOfWay;
//  $Backbone::IHU::IHUBackboneSignalIPdu02::HznEdgeOffset = @Carmaker2FC::HznEdgeOffset;
//  $Backbone::IHU::IHUBackboneSignalIPdu02::HznEdgePathIndex = @Carmaker2FC::HznEdgePathIndex;
//  $Backbone::IHU::IHUBackboneSignalIPdu02::HznEdgeSubPathIndex = @Carmaker2FC::HznEdgeSubPathIndex;
    
  //@FC2Carmaker_MyCarOutReturn::DrvrLaneChgAutActvStsOnOff1=$Backbone::IHU::IHUBackboneSignalIPdu02::DrvrLaneChgAutActvStsOnOff1;
  //@FC2Carmaker_MyCarOutReturn::HznEdgeFormOfWay=$Backbone::IHU::IHUBackboneSignalIPdu02::HznEdgeFormOfWay;
  //@FC2Carmaker_MyCarOutReturn::HznEdgeOffset=$Backbone::IHU::IHUBackboneSignalIPdu02::HznEdgeOffset;
  //@FC2Carmaker_MyCarOutReturn::HznEdgePathIndex=$Backbone::IHU::IHUBackboneSignalIPdu02::HznEdgePathIndex;
  //@FC2Carmaker_MyCarOutReturn::HznEdgeSubPathIndex=$Backbone::IHU::IHUBackboneSignalIPdu02::HznEdgeSubPathIndex;

  }
  
  on frPDU IHUBackBoneSignalIPdu03
  {
    $AccAdprSpdLimActvSts = @Carmaker2FC::AccAdprSpdLimActvSts;
////  $Backbone::IHU::IHUBackBoneSignalIPdu03::DrvModReq = @Carmaker2FC::DrvModReq;          //channel modify,
//  $Backbone::IHU::IHUBackBoneSignalIPdu03::HznPosnOffset = @Carmaker2FC::HznPosnOffset;
//  $Backbone::IHU::IHUBackBoneSignalIPdu03::HznPosnPathIndex = @Carmaker2FC::HznPosnPathIndex;
//  $Backbone::IHU::IHUBackBoneSignalIPdu03::HznSegBuiltupArea = @Carmaker2FC::HznSegBuiltupArea;
//  $Backbone::IHU::IHUBackBoneSignalIPdu03::HznSegOffset = @Carmaker2FC::HznSegOffset;
//  $Backbone::IHU::IHUBackBoneSignalIPdu03::HznSegPathIndex = @Carmaker2FC::HznSegPathIndex;
//  $Backbone::IHU::IHUBackBoneSignalIPdu03::HznSegTunnel = @Carmaker2FC::HznSegTunnel;
//  $Backbone::IHU::IHUBackBoneSignalIPdu03::HznSegDividedRoad = @Carmaker2FC::HznSegDividedRoad;
//  $Backbone::IHU::IHUBackBoneSignalIPdu03::HznSegFormofWay = @Carmaker2FC::HznSegFormofWay;
//  $Backbone::IHU::IHUBackBoneSignalIPdu03::HznSegFunctionalRoadClass = @Carmaker2FC::HznSegFunctionalRoadClass;
//  
//  $Backbone::IHU::IHUBackBoneSignalIPdu03::WarnTypForLaneKeepAidSts = @Carmaker2FC::WarnTypForLaneKeepAidSts;
    
          if(@Panel::SW == 1)
      {
//          $Backbone::IHU::IHUBackBoneSignalIPdu04::RCWSwOnOffOnOff1 = @Panel::RCWSwOnOffOnOff1;
//          $Backbone::IHU::IHUBackBoneSignalIPdu04::BSDSwOnOffOnOff1 = @Panel::BSDSwOnOffOnOff1;
//          $Backbone::IHU::IHUBackBoneSignalIPdu04::BSDaudioOnOff = @Panel::BSDaudioOnOff;
//          $Backbone::IHU::IHUBackBoneSignalIPdu04::CllsnAidSnvtySeldStsCllsnAidSnvtySeldSts = @Panel::CllsnAidSnvtySeldStsCllsnAidSnvtySeldSts;
//          $Backbone::IHU::IHUBackBoneSignalIPdu04::LaneKeepAidActvStsOnOff1 = @Panel::LaneKeepAidActvStsOnOff1;
          $Backbone::IHU::IHUBackBoneSignalIPdu03::WarnTypForLaneKeepAidSts = @Panel::WarnTypForLaneKeepAidStsWarnTypForLaneKeepAidSts;
      }
      else
      {
//          $Backbone::IHU::IHUBackBoneSignalIPdu04::RCWSwOnOffOnOff1 = @Carmaker2FC::RCWSwOnOffOnOff1;
//          $Backbone::IHU::IHUBackBoneSignalIPdu04::BSDSwOnOffOnOff1 = @Carmaker2FC::BSDSwOnOffOnOff1;
//          $Backbone::IHU::IHUBackBoneSignalIPdu04::BSDaudioOnOff = @Carmaker2FC::BSDaudioOnOff;
//          $Backbone::IHU::IHUBackBoneSignalIPdu04::CllsnAidSnvtySeldStsCllsnAidSnvtySeldSts = @Carmaker2FC::CllsnAidSnvtySeldStsCllsnAidSnvtySeldSts;
//          $Backbone::IHU::IHUBackBoneSignalIPdu04::LaneKeepAidActvStsOnOff1 = @Carmaker2FC::LaneKeepAidActvStsOnOff1;
          $Backbone::IHU::IHUBackBoneSignalIPdu03::WarnTypForLaneKeepAidSts = @Carmaker2FC::WarnTypForLaneKeepAidStsWarnTypForLaneKeepAidSts;
      }
  }

  on frPDU IHUBackBoneSignalIPdu04
  {

//    
           $Backbone::IHU::IHUBackBoneSignalIPdu04::WarnTypForLaneChgWarnSts = @Carmaker2FC::WarnTypForLaneChgWarnSts;
//    

//
//  $Backbone::IHU::IHUBackBoneSignalIPdu04::BSDSwOnOffIdPen = @Carmaker2FC::BSDSwOnOffIdPen;
//
//  $Backbone::IHU::IHUBackBoneSignalIPdu04::LaneKeepAidActvStsOnOff1 = @Carmaker2FC::LaneKeepAidActvStsOnOff1;
//  $Backbone::IHU::IHUBackBoneSignalIPdu04::WarnTypForLaneKeepAidStsWarnTypForLaneKeepAidSts = @Carmaker2FC::WarnTypForLaneKeepAidStsWarnTypForLaneKeepAidSts;
//  $Backbone::IHU::IHUBackBoneSignalIPdu04::PlannedPahDe = @Carmaker2FC::PlannedPahDe;
//    
//  //@FC2Carmaker_MyCarOutReturn::BSDaudioOnOff=$Backbone::IHU::IHUBackBoneSignalIPdu04::BSDaudioOnOff;
//  //@FC2Carmaker_MyCarOutReturn::BSDSwOnOffIdPen=$Backbone::IHU::IHUBackBoneSignalIPdu04::BSDSwOnOffIdPen;
//  //@FC2Carmaker_MyCarOutReturn::BSDSwOnOffOnOff1=$Backbone::IHU::IHUBackBoneSignalIPdu04::BSDSwOnOffOnOff1;
//  //@FC2Carmaker_MyCarOutReturn::CllsnAidSnvtySeldStsCllsnAidSnvtySeldSts=$Backbone::IHU::IHUBackBoneSignalIPdu04::CllsnAidSnvtySeldStsCllsnAidSnvtySeldSts;
//  //@FC2Carmaker_MyCarOutReturn::LaneKeepAidActvStsOnOff1=$Backbone::IHU::IHUBackBoneSignalIPdu04::LaneKeepAidActvStsOnOff1;
//  //@FC2Carmaker_MyCarOutReturn::RCWSwOnOffOnOff1=$Backbone::IHU::IHUBackBoneSignalIPdu04::RCWSwOnOffOnOff1;
//  //@FC2Carmaker_MyCarOutReturn::WarnTypForLaneKeepAidStsWarnTypForLaneKeepAidSts=$Backbone::IHU::IHUBackBoneSignalIPdu04::WarnTypForLaneKeepAidStsWarnTypForLaneKeepAidSts;
//  //@FC2Carmaker_MyCarOutReturn::PlannedPahDe=$Backbone::IHU::IHUBackBoneSignalIPdu04::PlannedPahDe;
  }
  
  on frPDU IHUBackBoneSignalIPdu07
  {
    $PtDrvrSetgSts = @Carmaker2FC::PtDrvrSetgSts;
    $LaneKeepAidRoadEdgeActvSts = @Carmaker2FC::LaneKeepAidRoadEdgeActvSts;
    
    $BlisSwOnOff = @Carmaker2FC::BlisSwOnOff;
    
    $DriveAwayInfoActvReq = @Carmaker2FC::DriveAwayInfoActvReq;
    
//    if(@Panel::SW == 1)
//    {
//      $Backbone::IHU::IHUBackBoneSignalIPdu07::CtraSwOnOffOnOff1 = @Panel::CtraSwOnOffOnOff1;
//      $Backbone::IHU::IHUBackBoneSignalIPdu07::DOWSwOnOffOnOff1 = @Panel::DOWSwOnOffOnOff1;
//    }
//    else
//    {
//      $Backbone::IHU::IHUBackBoneSignalIPdu07::CtraSwOnOffOnOff1 = @Carmaker2FC::CtraSwOnOffOnOff1;
//      $Backbone::IHU::IHUBackBoneSignalIPdu07::DOWSwOnOffOnOff1 = @Carmaker2FC::DOWSwOnOffOnOff1;
//    }
//
//  $Backbone::IHU::IHUBackBoneSignalIPdu07::DOWSwOnOffIdPen = @Carmaker2FC::DOWSwOnOffIdPen;
//    $Backbone::IHU::IHUBackBoneSignalIPdu07::NOPCofmOfLanChagOnoff=@Carmaker2FC::NOPCofmOfLanChagOnoff;
//    //@FC2Carmaker_MyCarOutReturn::CtraSwOnOffOnOff1=$Backbone::IHU::IHUBackBoneSignalIPdu07::CtraSwOnOffOnOff1;
//      //@FC2Carmaker_MyCarOutReturn::NOPCofmOfLanChagOnoff=$Backbone::IHU::IHUBackBoneSignalIPdu07::NOPCofmOfLanChagOnoff;
//  //@FC2Carmaker_MyCarOutReturn::DOWSwOnOffIdPen=$Backbone::IHU::IHUBackBoneSignalIPdu07::DOWSwOnOffIdPen;
//  //@FC2Carmaker_MyCarOutReturn::DOWSwOnOffOnOff1=$Backbone::IHU::IHUBackBoneSignalIPdu07::DOWSwOnOffOnOff1;
  }

//  // 20241214_fanjunjie add
//    on frPDU ASDMBackBoneSignalIPdu12
//  {
//    
//      @sysvar::IL_FR1::NODES::N_ASDM::PDUS::ASDMBackBoneSignalIPdu12::SIGNALS::PrkgDstCtrlWarn_UB::UB::Disturb=1;
//      @sysvar::IL_FR1::NODES::N_ASDM::PDUS::ASDMBackBoneSignalIPdu12::SIGNALS::PrkgDstCtrlWarn_UB::UB::Mode=0;
//      @sysvar::IL_FR1::NODES::N_ASDM::PDUS::ASDMBackBoneSignalIPdu12::SIGNALS::PrkgDstCtrlWarn_UB::UB::Value=1;
//      @sysvar::IL_CAN3::NODES::N_PAS::MESSAGES::PASSafetyCANFD4Fr04::SIGNALS::PrkgDstCtrlWarn_UB::UB::Disturb=1;
//      @sysvar::IL_CAN3::NODES::N_PAS::MESSAGES::PASSafetyCANFD4Fr04::SIGNALS::PrkgDstCtrlWarn_UB::UB::Mode=0;
//      @sysvar::IL_CAN3::NODES::N_PAS::MESSAGES::PASSafetyCANFD4Fr04::SIGNALS::PrkgDstCtrlWarn_UB::UB::Value=1;
//  }
  

  
//  on frPDU IHUBackBoneSignalIPdu12
//  {
//    //20250117_fanjunjie_add
//    $HznSplyElectcSts=@FaDC::HznSplyElectcSts;
//
//    if(@Panel::SW == 1)
//    {
//      $Backbone::IHU::IHUBackBoneSignalIPdu12::CllsnMtgtnActvSeldSts = @Panel::CllsnMtgtnActvSeldSts;
//      $Backbone::IHU::IHUBackBoneSignalIPdu12::EmgyLaneKeepAidActvStsOnOff1 = @Panel::EmgyLaneKeepAidActvStsOnOff1;
//    }
//    else
//    {
//      $Backbone::IHU::IHUBackBoneSignalIPdu12::CllsnMtgtnActvSeldSts = @Carmaker2FC::CllsnMtgtnActvSeldSts;
//      $Backbone::IHU::IHUBackBoneSignalIPdu12::EmgyLaneKeepAidActvStsOnOff1 = @Carmaker2FC::EmgyLaneKeepAidActvStsOnOff1;  
//    }
////    if(1==1)
////    {
////      @IL_FR1::NODES::N_IHU::PDUS::IHUBackBoneSignalIPdu12::SIGNALS::HznSplyElectcSts_UB::UB::Disturb=1;
////      @IL_FR1::NODES::N_IHU::PDUS::IHUBackBoneSignalIPdu12::SIGNALS::HznSplyElectcSts_UB::UB::Mode=0;
////      @IL_FR1::NODES::N_IHU::PDUS::IHUBackBoneSignalIPdu12::SIGNALS::HznSplyElectcSts_UB::UB::NormalOperation=0;
////      @IL_FR1::NODES::N_IHU::PDUS::IHUBackBoneSignalIPdu12::SIGNALS::HznSplyElectcSts_UB::UB::Value=1;
////
////    } 
////    else
////    {
//////    @IL_CAN1::NODES::N_PSCM1::MESSAGES::PscmChas1Fr02::SIGNALS::HznSplyElectcSts_UB::UB::Disturb =1;
//////    @IL_CAN1::NODES::N_PSCM1::MESSAGES::PscmChas1Fr02::SIGNALS::HznSplyElectcSts_UB::UB::Mode=0;
//////    @IL_CAN1::NODES::N_PSCM1::MESSAGES::PscmChas1Fr02::SIGNALS::HznSplyElectcSts_UB::UB::NormalOperation=0;
//////    @IL_CAN1::NODES::N_PSCM1::MESSAGES::PscmChas1Fr02::SIGNALS::HznSplyElectcSts_UB::UB::Value=0;
////    }
//    
//
//   //@FC2Carmaker_MyCarOutReturn::CllsnMtgtnActvSeldSts=$Backbone::IHU::IHUBackBoneSignalIPdu12::CllsnMtgtnActvSeldSts;
//   //@FC2Carmaker_MyCarOutReturn::EmgyLaneKeepAidActvStsOnOff1=$Backbone::IHU::IHUBackBoneSignalIPdu12::EmgyLaneKeepAidActvStsOnOff1;
//  }
  
//  on frPDU IHUBackBoneSignalIPdu13
//  {
//  $Backbone::IHU::IHUBackBoneSignalIPdu13::HznProfLongOffset = @Carmaker2FC::HznProfLongOffset;
//  $Backbone::IHU::IHUBackBoneSignalIPdu13::HznProfLongPathIndex = @Carmaker2FC::HznProfLongPathIndex;
//  $Backbone::IHU::IHUBackBoneSignalIPdu13::HznProfLongProfileType = @Carmaker2FC::HznProfLongProfileType;
//  $Backbone::IHU::IHUBackBoneSignalIPdu13::HznProfLongValue = @Carmaker2FC::HznProfLongValue;
//
//  //@FC2Carmaker_MyCarOutReturn::HznProfLongOffset=$Backbone::IHU::IHUBackBoneSignalIPdu13::HznProfLongOffset;
//  //@FC2Carmaker_MyCarOutReturn::HznProfLongPathIndex=$Backbone::IHU::IHUBackBoneSignalIPdu13::HznProfLongPathIndex;
//  //@FC2Carmaker_MyCarOutReturn::HznProfLongProfileType=$Backbone::IHU::IHUBackBoneSignalIPdu13::HznProfLongProfileType;
//  //@FC2Carmaker_MyCarOutReturn::HznProfLongValue=$Backbone::IHU::IHUBackBoneSignalIPdu13::HznProfLongValue;
//    
//  }
  
//  on frPDU IHUBackBoneSignalIPdu15
//  {
//  $Backbone::IHU::IHUBackBoneSignalIPdu15::PtDrvrSetgDrvModReqType2 = @Carmaker2FC::PtDrvrSetgDrvModReqType2;
// 
//  //@FC2Carmaker_MyCarOutReturn::PtDrvrSetgDrvModReqType2=$Backbone::IHU::IHUBackBoneSignalIPdu15::PtDrvrSetgDrvModReqType2;  
//  }
// 
  

  
  on frPDU IHUBackBoneSignalIPdu16
  {  
  
    $AsyLaneChgActvSts = @Carmaker2FC::AsyLaneChgActvSts;
  } 
  
//  on frPDU IHUBackBoneSignalIPdu17
//  {
//  $Backbone::IHU::IHUBackBoneSignalIPdu17::HmiDrvrSodReqChg=@Carmaker2FC::HmiDrvrSodReqChg;
//  $Backbone::IHU::IHUBackBoneSignalIPdu17::BSDSwOnOffandWarnType = @Carmaker2FC::BSDSwOnOffandWarnType;
//  $Backbone::IHU::IHUBackBoneSignalIPdu17::HmiDrvrSodReqPilot = @Carmaker2FC::HmiDrvrSodReqPilot;
//  $Backbone::IHU::IHUBackBoneSignalIPdu17::HmiDrvrSodReqChg=@Carmaker2FC::HmiDrvrSodReqChg;
//  //@FC2Carmaker_MyCarOutReturn::BSDSwOnOffandWarnType=$Backbone::IHU::IHUBackBoneSignalIPdu17::BSDSwOnOffandWarnType;
//  //@FC2Carmaker_MyCarOutReturn::HmiDrvrSodReqPilot=$Backbone::IHU::IHUBackBoneSignalIPdu17::HmiDrvrSodReqPilot;
//
//  }
//  
//  on frPDU IHUBackBoneSignalIPdu18
//  {
//  $Backbone::IHU::IHUBackBoneSignalIPdu18::CtrbSwOnOff=@Carmaker2FC::CtrbSwOnOff;
//  $Backbone::IHU::IHUBackBoneSignalIPdu18::VoiceBrstMod = @Carmaker2FC::VoiceBrstMod;
//  $Backbone::IHU::IHUBackBoneSignalIPdu18::CrossInfoDirOfNavRut = @Carmaker2FC::CrossInfoDirOfNavRut;
//  $Backbone::IHU::IHUBackBoneSignalIPdu18::CrossInfoDstToCros = @Carmaker2FC::CrossInfoDstToCros;
//
//  //@FC2Carmaker_MyCarOutReturn::VoiceBrstMod=$Backbone::IHU::IHUBackBoneSignalIPdu18::VoiceBrstMod;
//  //@FC2Carmaker_MyCarOutReturn::CrossInfoDirOfNavRut=$Backbone::IHU::IHUBackBoneSignalIPdu18::CrossInfoDirOfNavRut;
//  //@FC2Carmaker_MyCarOutReturn::CrossInfoDstToCros=$Backbone::IHU::IHUBackBoneSignalIPdu18::CrossInfoDstToCros;
//  }    
//  
//  on frPDU IHUBackBoneSignalIPdu19
//  {
//  $Backbone::IHU::IHUBackBoneSignalIPdu19::NavInfoSts = @Carmaker2FC::NavInfoSts;
//    
//  //@FC2Carmaker_MyCarOutReturn::NavInfoSts=$Backbone::IHU::IHUBackBoneSignalIPdu19::NavInfoSts;
//  }
//  
//  on frPDU IHUBackBoneSignalIPdu26
//  {
//    if(@Panel::SW == 1)
//    {
//      $Backbone::IHU::IHUBackBoneSignalIPdu26::AccFusnTrfcReqOnOff1 = @Panel::AccFusnTrfcReqOnOff1;
//    }
//    else
//    {
//      $Backbone::IHU::IHUBackBoneSignalIPdu26::AccFusnTrfcReqOnOff1 = @Carmaker2FC::AccFusnTrfcReqOnOff1;
//    }
//
//  
//    
//  //@FC2Carmaker_MyCarOutReturn::AccFusnTrfcReqOnOff1=$Backbone::IHU::IHUBackBoneSignalIPdu26::AccFusnTrfcReqOnOff1;
//  } 
//  
//  on frPDU IHUBackBoneSignalIPdu37
//  {
//  $Backbone::IHU::IHUBackBoneSignalIPdu37::DrvrPfmncAlrmReqFromDHU = @Carmaker2FC::DrvrPfmncAlrmReqFromDHU;
//    
//  //@FC2Carmaker_MyCarOutReturn::DrvrPfmncAlrmReqFromDHU=$Backbone::IHU::IHUBackBoneSignalIPdu37::DrvrPfmncAlrmReqFromDHU;
//  }

  
  
  
  
//  on frPDU IHUBackBoneSignalIPdu51
//  {
////    if(@FaDC::EyeOnRoadEyesOnRoadChks_Control==0)
////    {
////      ILNodeDisturbChecksum("IHUBackBoneSignalIPdu51","EyeOnRoadEyesOnRoad",0,0,1000,0);
////    }
////    else
////    {
////       ILNodeDisturbChecksum("IHUBackBoneSignalIPdu51","EyeOnRoadEyesOnRoad",0,1,0,0);
////    }
////     if((@FaDC::EyeOnRoadEyesOnRoadCntr_Control==0&&temp_EyeOnRoadEyesOnRoadCntr==1))
////    {
////      @IL_FR1::NODES::N_IHU::PDUS::IHUBackBoneSignalIPdu51::SIGGRPS::EyeOnRoadFromDHU::CNTR::Disturb=1;
////    }
////    else
////    {
////      @IL_FR1::NODES::N_IHU::PDUS::IHUBackBoneSignalIPdu51::SIGGRPS::EyeOnRoadFromDHU::CNTR::Disturb=0;
////    }
////
////     if(@FaDC::EyeOnRoadEyesOnRoadCntr_Control==1&&temp_EyeOnRoadEyesOnRoadCntr==0)
////    {
////      @IL_FR1::NODES::N_IHU::PDUS::IHUBackBoneSignalIPdu51::SIGGRPS::EyeOnRoadFromDHU::CNTR::NormalOperation=1;
////    }
////    else
////    {
////      @IL_FR1::NODES::N_IHU::PDUS::IHUBackBoneSignalIPdu51::SIGGRPS::EyeOnRoadFromDHU::CNTR::NormalOperation=0;
////    }
////    temp_EyeOnRoadEyesOnRoadCntr=@FaDC::EyeOnRoadEyesOnRoadCntr_Control;
////    temp_EyeOnRoadEyesOnRoadChks=@FaDC::EyeOnRoadEyesOnRoadChks_Control;
//    //FaDC_EyeOnRoadEyesOnRoad_E2E();
//    
//    
//  $Backbone::IHU::IHUBackBoneSignalIPdu51::EyeOnRoadFromDHUEyesOnRoad = @Carmaker2FC::EyeOnRoadFromDHUEyesOnRoad;
////  $Backbone::IHU::IHUBackBoneSignalIPdu60::SnsrDrvrPfmncStsFromDHU = @Carmaker2FC::SnsrDrvrPfmncStsFromDHU;
//  
//  //@FC2Carmaker_MyCarOutReturn::EyeOnRoadFromDHUEyesOnRoad=$Backbone::IHU::IHUBackBoneSignalIPdu51::EyeOnRoadFromDHUEyesOnRoad;
//  }
  
  
//  on frPDU IHUBackBoneSignalIPdu60
//  {
//    $Backbone::IHU::IHUBackBoneSignalIPdu60::SnsrDrvrPfmncStsFromDHU = @Carmaker2FC::SnsrDrvrPfmncStsFromDHU;
//  }
  
//    //20250402_fanjunjie_add
//  on message VddmChas1Fr01
//  {
//    $ChassisCAN1::VDDM::VddmChas1Fr01::AsyDataWithCmpSafeYawRateQf=@FaDC::AsyDataWithCmpSafeYawRateQf;
//  }
  
  on frPDU SRSBackboneSignalIPdu01
  {  
  
      $Backbone::SRS::SRSBackboneSignalIPdu01::BltLockStAtDrvrForBltLockSt1 = @Carmaker2FC::BltLockStAtDrvrBltLockSt1; 
      $Backbone::SRS::SRSBackboneSignalIPdu01::BltLockStAtDrvrForDevErrSts2 = @Carmaker2FC::BltLockStAtDrvrForDevErrSts2;
  }
  
    on frPDU SRSBackboneSignalIPdu02
  {  
  
      $Backbone::SRS::SRSBackboneSignalIPdu02::BltLockStAtPassForBltLockSts = @Carmaker2FC::BltLockStAtPassForBltLockSts; 
      $Backbone::SRS::SRSBackboneSignalIPdu02::BltLockStAtPassForBltLockSt1 = @Carmaker2FC::BltLockStAtPassForBltLockSt1;
  }
  
    on frPDU SRSBackboneSignalIPdu03
  {  
  
      $PassSeatSts = @Carmaker2FC::PassSeatSts; 

  }
  
//  on frPDU SRSBackBoneSignalIPdu04
//  {
//    
//
//    
//    
//    //@FC2Carmaker_MyCarOutReturn::AgDataRawSafeYawRate=$Backbone::SRS::SRSBackBoneSignalIPdu04::AgDataRawSafeYawRate;
//    //@FC2Carmaker_MyCarOutReturn::AsyDataWithCmpSafeALatWithCmp=$Backbone::SRS::SRSBackBoneSignalIPdu04::AsyDataWithCmpSafeALatWithCmp;
//    //@FC2Carmaker_MyCarOutReturn::AgDataRawSafeRollRate=$Backbone::SRS::SRSBackBoneSignalIPdu04::AgDataRawSafeRollRate;
//    //@FC2Carmaker_MyCarOutReturn::AsyDataWithCmpSafeGrdtOfALgt=$Backbone::SRS::SRSBackBoneSignalIPdu04::AsyDataWithCmpSafeGrdtOfALgt;
//    //@FC2Carmaker_MyCarOutReturn::AsyDataWithCmpSafeYawRateWithCmp=$Backbone::SRS::SRSBackBoneSignalIPdu04::AsyDataWithCmpSafeYawRateWithCmp;
//    //@FC2Carmaker_MyCarOutReturn::AgDataRawSafeRollRateQf=$Backbone::SRS::SRSBackBoneSignalIPdu04::AgDataRawSafeRollRateQf;
//    //@FC2Carmaker_MyCarOutReturn::AsyDataWithCmpSafeALat1Qf=$Backbone::SRS::SRSBackBoneSignalIPdu04::AsyDataWithCmpSafeALat1Qf;
//  } 

  
  
  
//  on frPDU SRSBackboneSignalIPdu05
//  {
    //20250117_fanjunjie_add
//    if( (@FaDC::ADataRawSafe_UB==1) && (@FaDC::ADataRawSafeALgt_UB==1) )
//    {
//    @IL_FR1::NODES::N_SRS::PDUS::SRSBackboneSignalIPdu05::SIGGRPS::ADataRawSafe::UB::Disturb =0;
//    @IL_FR1::NODES::N_SRS::PDUS::SRSBackboneSignalIPdu05::SIGGRPS::ADataRawSafe::UB::Mode=1;
//    @IL_FR1::NODES::N_SRS::PDUS::SRSBackboneSignalIPdu05::SIGGRPS::ADataRawSafe::UB::NormalOperation=1;
//    } 
//    else
//    {
//    @IL_FR1::NODES::N_SRS::PDUS::SRSBackboneSignalIPdu05::SIGGRPS::ADataRawSafe::UB::Disturb=1;
//    @IL_FR1::NODES::N_SRS::PDUS::SRSBackboneSignalIPdu05::SIGGRPS::ADataRawSafe::UB::Mode=0;
//    @IL_FR1::NODES::N_SRS::PDUS::SRSBackboneSignalIPdu05::SIGGRPS::ADataRawSafe::UB::NormalOperation=0;
//    }
    //FaDC_ADataRawSafe_UB();
    
    
    //20250224_fanjunjie_add
//    if(@FaDC::BltLockStAtDrvr_UB==1)
//    {
//    @IL_FR1::NODES::N_SRS::PDUS::SRSBackboneSignalIPdu05::SIGGRPS::BltLockStAtDrvr::UB::Disturb =0;
//    @IL_FR1::NODES::N_SRS::PDUS::SRSBackboneSignalIPdu05::SIGGRPS::BltLockStAtDrvr::UB::Mode=1;
//    @IL_FR1::NODES::N_SRS::PDUS::SRSBackboneSignalIPdu05::SIGGRPS::BltLockStAtDrvr::UB::NormalOperation=1;
//    } 
//    else
//    {
//    @IL_FR1::NODES::N_SRS::PDUS::SRSBackboneSignalIPdu05::SIGGRPS::BltLockStAtDrvr::UB::Disturb=1;
//    @IL_FR1::NODES::N_SRS::PDUS::SRSBackboneSignalIPdu05::SIGGRPS::BltLockStAtDrvr::UB::Mode=0;
//    @IL_FR1::NODES::N_SRS::PDUS::SRSBackboneSignalIPdu05::SIGGRPS::BltLockStAtDrvr::UB::NormalOperation=0;
//    }
    //FaDC_BltLockStAtDrvr_UB();
    
    
    

//    if(@FaDC::ADataRawSafeChks_Control==0)
//    {
//    ILNodeDisturbChecksum("SRSBackboneSignalIPdu05","ADataRawSafe",0,0,1000,0);
//    }
//    else
//    {
//    ILNodeDisturbChecksum("SRSBackboneSignalIPdu05","ADataRawSafe",0,1,0,0);
//    }
    //20250205kangrui_add
    
//    if((@FaDC::ADataRawSafeCntr_Control==0&&temp_ADataRawSafeCntr_Control==1))
//    {
//    @IL_FR1::NODES::N_SRS::PDUS::SRSBackboneSignalIPdu05::SIGGRPS::ADataRawSafe::CNTR::Disturb=1;
//    }
//    else
//    {
//    @IL_FR1::NODES::N_SRS::PDUS::SRSBackboneSignalIPdu05::SIGGRPS::ADataRawSafe::CNTR::Disturb=0;
//    }
//    if((@FaDC::ADataRawSafeCntr_Control==1&&temp_ADataRawSafeCntr_Control==0))
//    { 
//    @IL_FR1::NODES::N_SRS::PDUS::SRSBackboneSignalIPdu05::SIGGRPS::ADataRawSafe::CNTR::NormalOperation=1;
//    }
//    else
//    {
//    @IL_FR1::NODES::N_SRS::PDUS::SRSBackboneSignalIPdu05::SIGGRPS::ADataRawSafe::CNTR::NormalOperation=0;
//    }
//    temp_ADataRawSafeChks_Control=@FaDC::ADataRawSafeChks_Control;
//    temp_ADataRawSafeCntr_Control=@FaDC::ADataRawSafeCntr_Control;
    //FaDC_ADataRawSafe_E2E();
    
    

//    $Backbone::SRS::SRSBackboneSignalIPdu05::BltLockStAtDrvrBltLockSt1 = @Carmaker2FC::BltLockStAtDrvrBltLockSt1;          //channel modify,
//    $Backbone::SRS::SRSBackboneSignalIPdu05::BltLockStAtDrvrBltLockSts = @Carmaker2FC::BltLockStAtDrvrBltLockSts;          //channel modify,
//    $Backbone::SRS::SRSBackboneSignalIPdu05::BltLockStSafeAtDrvrBltLockSt1 = @Carmaker2FC::BltLockStSafeAtDrvrBltLockSt1;          //channel modify,

    //@FC2Carmaker_MyCarOutReturn::ADataRawSafeALat=$Backbone::SRS::SRSBackboneSignalIPdu05::ADataRawSafeALat;
    //@FC2Carmaker_MyCarOutReturn::ADataRawSafeALat1Qf=$Backbone::SRS::SRSBackboneSignalIPdu05::ADataRawSafeALat1Qf;
    //@FC2Carmaker_MyCarOutReturn::ADataRawSafeALgt=$Backbone::SRS::SRSBackboneSignalIPdu05::ADataRawSafeALgt;
    //@FC2Carmaker_MyCarOutReturn::ADataRawSafeALgt1Qf=$Backbone::SRS::SRSBackboneSignalIPdu05::ADataRawSafeALgt1Qf;
    //@FC2Carmaker_MyCarOutReturn::BltLockStAtDrvrBltLockSt1=$Backbone::SRS::SRSBackboneSignalIPdu05::BltLockStAtDrvrBltLockSt1;
    //@FC2Carmaker_MyCarOutReturn::BltLockStAtDrvrBltLockSts=$Backbone::SRS::SRSBackboneSignalIPdu05::BltLockStAtDrvrBltLockSts;
    //@FC2Carmaker_MyCarOutReturn::BltLockStSafeAtDrvrBltLockSt1=$Backbone::SRS::SRSBackboneSignalIPdu05::BltLockStSafeAtDrvrBltLockSt1;

//  } 
  
//  on frPDU VddmBackBoneSignalIPdu00
//  {
//    $Backbone::VDDM::VddmBackBoneSignalIPdu00::ADModCtrlInhbnADModCtrlInhbn = @Carmaker2FC::ADModCtrlInhbnADModCtrlInhbn;
////    $Backbone::VDDM::VddmBackBoneSignalIPdu00::CrsCtrlOvrdn = @Carmaker2FC::CrsCtrlOvrdn;
//    $Backbone::VDDM::VddmBackBoneSignalIPdu00::EngSt1WdStsEngSt1WdSts = @Carmaker2FC::EngSt1WdStsEngSt1WdSts;       
//  
//    //@FC2Carmaker_MyCarOutReturn::ADModCtrlInhbnADModCtrlInhbn=$Backbone::VDDM::VddmBackBoneSignalIPdu00::ADModCtrlInhbnADModCtrlInhbn;
//    //@FC2Carmaker_MyCarOutReturn::CrsCtrlOvrdn=$Backbone::VDDM::VddmBackBoneSignalIPdu00::CrsCtrlOvrdn;
//    //@FC2Carmaker_MyCarOutReturn::EngSt1WdStsEngSt1WdSts=$Backbone::VDDM::VddmBackBoneSignalIPdu00::EngSt1WdStsEngSt1WdSts;
//  
//  } 
 
  on frPDU VDDMBackBoneSignalIPdu02
  {
    
    
    if(@Panel::SW == 1)
    {    
      $Backbone::VCU1::VDDMBackBoneSignalIPdu02::AccrPedlRat = @Panel::AccrPedlRatAccrPedlRat;
      $Backbone::VCU1::VDDMBackBoneSignalIPdu02::PinionSteerAg1 = @Panel::PinionSteerAgGroupPinionSteerAg1;          //channel modify,
      $Backbone::VCU1::VDDMBackBoneSignalIPdu02::GearLvrIndcn = @Panel::GearLvrIndcn;
//      $Backbone::VCU1::VDDMBackBoneSignalIPdu02::PinionSteerAgGroupSteerWhlTq = @Panel::PinionSteerAgGroupSteerWhlTq;          //channel modify,
//      $Backbone::VCU1::VDDMBackBoneSignalIPdu02::SteerWhlSnsrAg = @Panel::SteerWhlSnsrAg;          //channel modify,
//      $Backbone::VCU1::VDDMBackBoneSignalIPdu02::SteerWhlSnsrAgSpd = @Panel::SteerWhlSnsrAgSpd;          //channel modify,
//      $Backbone::VCU1::VDDMBackBoneSignalIPdu02::PinionSteerAgGroupPinionSteerAgSpd1 = @Panel::PinionSteerAgGroupPinionSteerAgSpd1;
    }
    else
    {
      $Backbone::VCU1::VDDMBackBoneSignalIPdu02::AccrPedlRat = @Carmaker2FC::AccrPedlRatAccrPedlRat;
      $Backbone::VCU1::VDDMBackBoneSignalIPdu02::PinionSteerAg1 = BypassSwitch_float(@Carmaker2FC::SteerWhlSnsrAg,@Carmaker2FC::PinionSteerAgGroupPinionSteerAg1);         //channel modify,
      $Backbone::VCU1::VDDMBackBoneSignalIPdu02::GearLvrIndcn = @Carmaker2FC::GearLvrIndcn;
//      $Backbone::VCU1::VDDMBackBoneSignalIPdu02::PinionSteerAgGroupSteerWhlTq = @Carmaker2FC::PinionSteerAgGroupSteerWhlTq;         
//      $Backbone::VCU1::VDDMBackBoneSignalIPdu02::SteerWhlSnsrAg = BypassSwitch_float(@Carmaker2FC::SteerWhlSnsrAg,@Carmaker2FC::PinionSteerAgGroupPinionSteerAg1);          //channel modify,
//      $Backbone::VCU1::VDDMBackBoneSignalIPdu02::SteerWhlSnsrAgSpd = BypassSwitch_float(@Carmaker2FC::SteerWhlSnsrAgSpd,@Carmaker2FC::PinionSteerAgGroupPinionSteerAgSpd1*0.1);
//      $Backbone::VCU1::VDDMBackBoneSignalIPdu02::PinionSteerAgGroupPinionSteerAgSpd1 = BypassSwitch_float(@Carmaker2FC::SteerWhlSnsrAgSpd,@Carmaker2FC::PinionSteerAgGroupPinionSteerAgSpd1*0.1);
    }
    /////Accped with override logic////
    if ($Backbone::VCU1::VDDMBackBoneSignalIPdu02::AccrPedlRat >0 && $Backbone::VCU1::VDDMBackBoneSignalIPdu02::AccrPedlRat <3 ) 
    {
      $Backbone::VCU1::VDDMBackBoneSignalIPdu03::AccrPedlPsdAccrPedlPsd=1;
    }
    else if($Backbone::VCU1::VDDMBackBoneSignalIPdu02::AccrPedlRat >3)
    {
      $CrsCtrlOvrdn=1;
      $Backbone::VCU1::VDDMBackBoneSignalIPdu03::AccrPedlPsdAccrPedlPsd=1;
    }
    else
    {
      $CrsCtrlOvrdn=0;
      $Backbone::VCU1::VDDMBackBoneSignalIPdu03::AccrPedlPsdAccrPedlPsd=0;
    }
//    $Backbone::VDDM::VDDMBackBoneSignalIPdu02::PinionSteerAgGroupPinionSteerAgSpd1Qf=@FaDC::PinionSteerAgGroupPinionSteerAgSpd1Qf;
    $Backbone::VCU1::VDDMBackBoneSignalIPdu02::PinionSteerAg1Qf = @FaDC::PinionSteerAgGroupPinionSteerAg1Qf;          //channel modify,
//    $Backbone::VDDM::VDDMBackBoneSignalIPdu02::PinionSteerAgGroupSteerWhlTqQf=@FaDC::PinionSteerAgGroupSteerWhlTqQf;
    //@FC2Carmaker_MyCarOutReturn::AccrPedlPsdAccrPedlPsd=$Backbone::VDDM::VDDMBackBoneSignalIPdu02::AccrPedlPsdAccrPedlPsd;
    //@FC2Carmaker_MyCarOutReturn::AccrPedlRatAccrPedlRat=$Backbone::VDDM::VDDMBackBoneSignalIPdu02::AccrPedlRatAccrPedlRat;
    //@FC2Carmaker_MyCarOutReturn::PinionSteerAgGroupPinionSteerAg1=$Backbone::VDDM::VDDMBackBoneSignalIPdu02::PinionSteerAgGroupPinionSteerAg1;
    //@FC2Carmaker_MyCarOutReturn::PinionSteerAgGroupSteerWhlTq=$Backbone::VDDM::VDDMBackBoneSignalIPdu02::PinionSteerAgGroupSteerWhlTq;
    //@FC2Carmaker_MyCarOutReturn::SteerWhlSnsrAg=$Backbone::VDDM::VDDMBackBoneSignalIPdu02::SteerWhlSnsrAg;
    //@FC2Carmaker_MyCarOutReturn::SteerWhlSnsrAgSpd=$Backbone::VDDM::VDDMBackBoneSignalIPdu02::SteerWhlSnsrAgSpd;
    //@FC2Carmaker_MyCarOutReturn::PinionSteerAgGroupPinionSteerAgSpd1=$Backbone::VDDM::VDDMBackBoneSignalIPdu02::PinionSteerAgGroupPinionSteerAgSpd1;
    //@FC2Carmaker_MyCarOutReturn::PinionSteerAgGroupPinionSteerAg1Qf=$Backbone::VDDM::VDDMBackBoneSignalIPdu02::PinionSteerAgGroupPinionSteerAg1Qf;
    //@FC2Carmaker_MyCarOutReturn::PinionSteerAgGroupPinionSteerAgSpd1Qf=$Backbone::VDDM::VDDMBackBoneSignalIPdu02::PinionSteerAgGroupPinionSteerAgSpd1Qf;
    //@FC2Carmaker_MyCarOutReturn::PinionSteerAgGroupSteerWhlTqQf=$Backbone::VDDM::VDDMBackBoneSignalIPdu02::PinionSteerAgGroupSteerWhlTqQf;
    
    
    
    //20250324_fanjunjie_add
//    if(@FaDC::AccrPedlPsdChks_Control==0)
//    {
//    ILNodeDisturbChecksum("VDDMBackBoneSignalIPdu02","AccrPedlPsd",0,0,1000,0);
//    }
//    else
//    {
//    ILNodeDisturbChecksum("VDDMBackBoneSignalIPdu02","AccrPedlPsd",0,1,0,0);
//    }
//    
//    if((@FaDC::AccrPedlPsdCntr_Control==0&&temp_AccrPedlPsdCntr_Control==1))
//    {
//    @IL_FR1::NODES::N_VDDM::PDUS::VDDMBackBoneSignalIPdu02::SIGGRPS::AccrPedlPsd::CNTR::Disturb=1;
//    }
//    else
//    {
//    @IL_FR1::NODES::N_VDDM::PDUS::VDDMBackBoneSignalIPdu02::SIGGRPS::AccrPedlPsd::CNTR::Disturb=0;
//    }
//    if((@FaDC::AccrPedlPsdCntr_Control==1&&temp_AccrPedlPsdCntr_Control==0))
//    { 
//    @IL_FR1::NODES::N_VDDM::PDUS::VDDMBackBoneSignalIPdu02::SIGGRPS::AccrPedlPsd::CNTR::NormalOperation=1;
//    }
//    else
//    {
//    @IL_FR1::NODES::N_VDDM::PDUS::VDDMBackBoneSignalIPdu02::SIGGRPS::AccrPedlPsd::CNTR::NormalOperation=0;
//    }
//    temp_AccrPedlPsdChks_Control=@FaDC::AccrPedlPsdChks_Control;
//    temp_AccrPedlPsdCntr_Control=@FaDC::AccrPedlPsdCntr_Control;
    //FaDC_AccrPedlPsd_E2E();
    
          //calculate wheel speed///
     $Backbone::VCU1::VDDMBackBoneSignalIPdu02::WhlRotToothCntrFrntLe=(int)($Backbone::VCU1::VDDMBackBoneSignalIPdu02::WhlRotToothCntrFrntLe + calculate_wheelsum($Backbone::VCU1::VDDMBackBoneSignalIPdu04::WhlSpdCircumlFrntLe))%256;
     $Backbone::VCU1::VDDMBackBoneSignalIPdu02::WhlRotToothCntrFrntRi=(int)($Backbone::VCU1::VDDMBackBoneSignalIPdu02::WhlRotToothCntrFrntRi + calculate_wheelsum($Backbone::VCU1::VDDMBackBoneSignalIPdu04::WhlSpdCircumlFrntWhlSpdCircumlFrntRi))%256;
     $Backbone::VCU1::VDDMBackBoneSignalIPdu02::WhlRotToothCntrReLe=(int)($Backbone::VCU1::VDDMBackBoneSignalIPdu02::WhlRotToothCntrReLe + calculate_wheelsum($Backbone::VCU1::VDDMBackBoneSignalIPdu04::WhlSpdCircumlReLe))%256;
     $Backbone::VCU1::VDDMBackBoneSignalIPdu02::WhlRotToothCntrReRi=(int)($Backbone::VCU1::VDDMBackBoneSignalIPdu02::WhlRotToothCntrReRi + calculate_wheelsum($Backbone::VCU1::VDDMBackBoneSignalIPdu04::WhlSpdCircumlReRi))%256; 
    
     $Backbone::VCU1::VDDMBackBoneSignalIPdu02::DrvrDecelReq = @Carmaker2FC::DrvrDecelReqFloat8;
     $Backbone::VCU1::VDDMBackBoneSignalIPdu02::ALgtStdFromWhlSpdSafe = @Carmaker2FC::ALgtStdFromWhlSpdALgtStdFromWhlSpd;
  } 
  
  on frPDU VDDMBackBoneSignalIPdu03
  {

      

//    $Backbone::BBM::BcmVddmBackBoneSignalIPdu03::BrkSysCylPMstAct = @Carmaker2FC::BrkSysCylPMstAct;          //channel modify,

    //@FC2Carmaker_MyCarOutReturn::ALgtStdFromWhlSpdALgtStdFromWhlSpd=$Backbone::BBM::BcmVddmBackBoneSignalIPdu03::ALgtStdFromWhlSpdALgtStdFromWhlSpd;
    //@FC2Carmaker_MyCarOutReturn::BrkSysCylPMstAct=$Backbone::BBM::BcmVddmBackBoneSignalIPdu03::BrkSysCylPMstAct;
    //@FC2Carmaker_MyCarOutReturn::EscCtrlIndcn=$Backbone::BBM::BcmVddmBackBoneSignalIPdu03::EscCtrlIndcn;
    //@FC2Carmaker_MyCarOutReturn::EscStEscSt=$Backbone::BBM::BcmVddmBackBoneSignalIPdu03::EscStEscSt;
    //@FC2Carmaker_MyCarOutReturn::GearLvrIndcn=$Backbone::VDDM::VDDMBackBoneSignalIPdu03::GearLvrIndcn;
    
    //    if(@FaDC::DrvrSteerWhlHldGroup_UB==1)
//    {
//    @IL_FR1::NODES::N_VDDM::PDUS::VDDMBackBoneSignalIPdu31::SIGGRPS::DrvrSteerWhlHldGroup::UB::Disturb =0;
//    @IL_FR1::NODES::N_VDDM::PDUS::VDDMBackBoneSignalIPdu31::SIGGRPS::DrvrSteerWhlHldGroup::UB::Mode=1;
//    @IL_FR1::NODES::N_VDDM::PDUS::VDDMBackBoneSignalIPdu31::SIGGRPS::DrvrSteerWhlHldGroup::UB::NormalOperation=1;
//    } 
//    else
//    {
//    @IL_FR1::NODES::N_VDDM::PDUS::VDDMBackBoneSignalIPdu31::SIGGRPS::DrvrSteerWhlHldGroup::UB::Disturb=1;
//    @IL_FR1::NODES::N_VDDM::PDUS::VDDMBackBoneSignalIPdu31::SIGGRPS::DrvrSteerWhlHldGroup::UB::Mode=0;
//    @IL_FR1::NODES::N_VDDM::PDUS::VDDMBackBoneSignalIPdu31::SIGGRPS::DrvrSteerWhlHldGroup::UB::NormalOperation=0;
//    }
//    //FaDC_DrvrSteerWhlHldGroup_UB();

  $SteerTqReqScaCoeff = @Carmaker2FC::SteerTqReqScaCoeff;
  $Backbone::VCU1::VDDMBackBoneSignalIPdu03::DrvrSteerWhlHldGroupDrvrSteerWhlHld = @Carmaker2FC::DrvrSteerWhlHldGroupDrvrSteerWhlHld;          //channel modify,
  $Backbone::VCU1::VDDMBackBoneSignalIPdu03::DrvrSteerWhlHldGroupDrvrSteerWhlHldQly = @Carmaker2FC::DrvrSteerWhlHldGroupDrvrSteerWhlHldQly;
 
//  //@FC2Carmaker_MyCarOutReturn::DrvrSteerWhlHldGroupDrvrSteerWhlHld=$Backbone::VDDM::VDDMBackBoneSignalIPdu31::DrvrSteerWhlHldGroupDrvrSteerWhlHld;
//  //@FC2Carmaker_MyCarOutReturn::DrvrSteerWhlHldGroupDrvrSteerWhlHldQly=$Backbone::VDDM::VDDMBackBoneSignalIPdu31::DrvrSteerWhlHldGroupDrvrSteerWhlHldQly;
  }
  
//  on frPDU VDDMBackBoneSignalIPdu04
//  {
//
//    
//}
  
    on frPDU VDDMBackBoneSignalIpdu05
  {
  
        if(@Panel::SW == 1)
    {
//      $Backbone::VDDM::VDDMBackBoneSignalIPdu03::GearLvrIndcn = @Panel::GearLvrIndcn;
//      $Backbone::BBM::BcmVddmBackBoneSignalIPdu03::EscCtrlIndcn = @Panel::EscCtrlIndcn;
      $Backbone::VCU1::VDDMBackBoneSignalIpdu05::EscSt = @Panel::EscStEscSt;
    }
    else
    {
//      $Backbone::VDDM::VDDMBackBoneSignalIPdu03::GearLvrIndcn = @Carmaker2FC::GearLvrIndcn;
//      $Backbone::BBM::BcmVddmBackBoneSignalIPdu03::EscCtrlIndcn = @Carmaker2FC::EscCtrlIndcn;
      $Backbone::VCU1::VDDMBackBoneSignalIpdu05::EscSt = @Carmaker2FC::EscStEscSt;
    }
    
    //$TrsmParkLockd = @Carmaker2FC::TrsmParkLockd;
    //$InhbOfAsySftyDecelByVehDyn = @Carmaker2FC::InhbOfAsySftyDecelByVehDyn;
    $AsySftyEnaDecelAckd = @Carmaker2FC::AsySftyEnaDecelAckdp;
    $AsySftyDecelEnadByVehDyn = @Carmaker2FC::AsySftyDecelEnadByVehDyn;
    
    $EscActvCtrlIndcdToDrvr = @Carmaker2FC::EscActvCtrlIndcdToDrvr;
  }
//  on frPDU VDDMBackBoneSignalIPdu14
//  {
////    if(@FaDC::LatCtrlModCfmd_UB==1)
////    {
////    @IL_FR1::NODES::N_VDDM::PDUS::VDDMBackBoneSignalIPdu14::SIGGRPS::LatCtrlModCfmd::UB::Disturb =1;
////    @IL_FR1::NODES::N_VDDM::PDUS::VDDMBackBoneSignalIPdu14::SIGGRPS::LatCtrlModCfmd::UB::Mode=0;
////    @IL_FR1::NODES::N_VDDM::PDUS::VDDMBackBoneSignalIPdu14::SIGGRPS::LatCtrlModCfmd::UB::NormalOperation=0;
////    @IL_FR1::NODES::N_VDDM::PDUS::VDDMBackBoneSignalIPdu14::SIGGRPS::LatCtrlModCfmd::UB::Value=1;
////    } 
////    else
////    {
////    @IL_FR1::NODES::N_VDDM::PDUS::VDDMBackBoneSignalIPdu14::SIGGRPS::LatCtrlModCfmd::UB::Disturb=1;
////    @IL_FR1::NODES::N_VDDM::PDUS::VDDMBackBoneSignalIPdu14::SIGGRPS::LatCtrlModCfmd::UB::Mode=0;
////    @IL_FR1::NODES::N_VDDM::PDUS::VDDMBackBoneSignalIPdu14::SIGGRPS::LatCtrlModCfmd::UB::NormalOperation=0;
////    @IL_FR1::NODES::N_VDDM::PDUS::VDDMBackBoneSignalIPdu14::SIGGRPS::LatCtrlModCfmd::UB::Value=0;
////    }
//    //FaDC_LatCtrlModCfmd_UB();
//    
// 
//    //@FC2Carmaker_MyCarOutReturn::LatCtrlModCfmdLatCtrlMod=$Backbone::VDDM::VDDMBackBoneSignalIPdu14::LatCtrlModCfmdLatCtrlMod;  
//  }
  
//  on frPDU VDDMBackBoneSignalIPdu11
//  {
//  $Backbone::VDDM::VDDMBackBoneSignalIPdu11::SuspPosnVertRi1SuspPosnVertRiFrntQf=@FaDC::SuspPosnVertRi1SuspPosnVertRiFrntQf;
//  $Backbone::VDDM::VDDMBackBoneSignalIPdu11::SuspPosnVertRi1SuspPosnVertRiReQf=@FaDC::SuspPosnVertRi1SuspPosnVertRiReQf;
//  //@FC2Carmaker_MyCarOutReturn::SuspPosnVertRi1SuspPosnVertRiFrntQf=$Backbone::VDDM::VDDMBackBoneSignalIPdu11::SuspPosnVertRi1SuspPosnVertRiFrntQf;
//  //@FC2Carmaker_MyCarOutReturn::SuspPosnVertRi1SuspPosnVertRiReQf=$Backbone::VDDM::VDDMBackBoneSignalIPdu11::SuspPosnVertRi1SuspPosnVertRiReQf;
//  }
  
  
//  on frPDU VDDMBackBoneSignalIPdu18
//  {
//  $Backbone::VDDM::VDDMBackBoneSignalIPdu18::SuspPosnVertLe1FrntQf=@FaDC::SuspPosnVertLe1FrntQf;
////  $Backbone::VDDM::VDDMBackBoneSignalIPdu18::SteerServoSts = @Carmaker2FC::SteerServoSts;          //channel modify,
////  $ChassisCAN1::PSCM1::PscmChas1Fr02::SteerServoSts = @Carmaker2FC::SteerServoSts;   
//    
//  $Backbone::VDDM::VDDMBackBoneSignalIPdu18::SuspPosnVertLe1ReQf=@FaDC::SuspPosnVertLe1ReQf;
//  
//  //@FC2Carmaker_MyCarOutReturn::SteerServoSts=$Backbone::VDDM::VDDMBackBoneSignalIPdu18::SteerServoSts;
//  //@FC2Carmaker_MyCarOutReturn::SuspPosnVertLe1FrntQf=$Backbone::VDDM::VDDMBackBoneSignalIPdu18::SuspPosnVertLe1FrntQf;
//  //@FC2Carmaker_MyCarOutReturn::SuspPosnVertLe1ReQf=$Backbone::VDDM::VDDMBackBoneSignalIPdu18::SuspPosnVertLe1ReQf;
//  }
  
  
  on frPDU VDDMBackBoneSignalIpdu06
  {  
  $Backbone::VCU1::VDDMBackBoneSignalIpdu06::SteerServoSts = @Carmaker2FC::SteerServoSts;
  }  
  
  
//  on frPDU VDDMBackBoneSignalIPdu01
//  {
//////      $Backbone::BBM::VddmBackBoneSignalIPdu40::WhlDirRotlFrntLe = @Carmaker2FC::WhlDirRotlFrntLe;
//////      $Backbone::BBM::VddmBackBoneSignalIPdu40::WhlDirRotlFrntRi = @Carmaker2FC::WhlDirRotlFrntRi;
////    
////    $OvrdDecelByDrvrOvrdDecelByDrvr = @Carmaker2FC::OvrdDecelByDrvrOvrdDecelByDrvr;
////    
////        if(@Panel::SW == 1)
////    {    
////      $Backbone::VCU1::VDDMBackBoneSignalIPdu01::PinionSteerAgSpd1 = @Panel::PinionSteerAgGroupPinionSteerAgSpd1;
////    }
////    else
////    {
////
////      $Backbone::VCU1::VDDMBackBoneSignalIPdu01::PinionSteerAgSpd1 = BypassSwitch_float(@Carmaker2FC::SteerWhlSnsrAgSpd,@Carmaker2FC::PinionSteerAgGroupPinionSteerAgSpd1*0.1);
////    }
////    
////    $Backbone::VCU1::VDDMBackBoneSignalIPdu01::PinionSteerAgSpd1Qf=@FaDC::PinionSteerAgGroupPinionSteerAgSpd1Qf;    
//// 
////      $Backbone::VCU1::VDDMBackBoneSignalIPdu01::SteerWhlTq = @Carmaker2FC::PinionSteerAgGroupSteerWhlTq;
////      $Backbone::VCU1::VDDMBackBoneSignalIPdu01::SteerWhlTqQf=@FaDC::PinionSteerAgGroupSteerWhlTqQf;  
////    
////    
////      $Backbone::VCU1::VDDMBackBoneSignalIPdu01::WhlDirRotlReLe = @Carmaker2FC::WhlDirRotlReLe;
////      $Backbone::VCU1::VDDMBackBoneSignalIPdu01::WhlDirRotlReRi = @Carmaker2FC::WhlDirRotlReRi;
////    
////    
////      $Backbone::VCU1::VDDMBackBoneSignalIPdu01::EpbStsEpbSts = @Carmaker2FC::EpbStsEpbSts;
////      $Backbone::VCU1::VDDMBackBoneSignalIPdu01::AbsCtrlActv = @Carmaker2FC::AbsCtrlActvCtrlSts1; 
////    
////      $Backbone::VCU1::VDDMBackBoneSignalIPdu01::BrkPedlPsdQf=@FaDC::BrkPedlPsdQf;
////      $Backbone::VCU1::VDDMBackBoneSignalIPdu01::BrkPedlPsd = @Carmaker2FC::BrkPedlPsdBrkPedlPsd;
////    
////      $AccStbOk = @Carmaker2FC::AccStbOk;
////    //      //@FC2Carmaker_MyCarOutReturn::WhlDirRotlFrntLe=$Backbone::BBM::VddmBackBoneSignalIPdu40::WhlDirRotlFrntLe;
//////      //@FC2Carmaker_MyCarOutReturn::WhlDirRotlFrntRi=$Backbone::BBM::VddmBackBoneSignalIPdu40::WhlDirRotlFrntRi;
//////      //@FC2Carmaker_MyCarOutReturn::WhlDirRotlReLe=$Backbone::BBM::VddmBackBoneSignalIPdu40::WhlDirRotlReLe;
//////      //@FC2Carmaker_MyCarOutReturn::WhlDirRotlReRi=$Backbone::BBM::VddmBackBoneSignalIPdu40::WhlDirRotlReRi;
////    
////        if(@Panel::SW == 1)
////    {
////
////      $Backbone::VCU1::VDDMBackBoneSignalIPdu01::EscCtrlIndcn = @Panel::EscCtrlIndcn;
////
////    }
////    else
////    {
////
////      $Backbone::VCU1::VDDMBackBoneSignalIPdu01::EscCtrlIndcn = @Carmaker2FC::EscCtrlIndcn;
////
////    }
////    
////  $Backbone::VCU1::VDDMBackBoneSignalIPdu01::VehSpdLgtSafeQf=@FaDC::VehSpdLgtQf;    
////        if(@Carmaker2FC::speed_swt==0) 
////  {
////    if(abs(@Carmaker2FC::VehSpdIndcdVehSpdIndcd)>0.04) 
////      {
//////      $Backbone::VCU1::VDDMBackBoneSignalIPdu01::VehSpdLgtSafe = abs(@Carmaker2FC::VehSpdIndcdVehSpdIndcd);
////        $Backbone::VCU1::VDDMBackBoneSignalIPdu01::VehSpdLgtSafe = abs(@Carmaker2FC::VehSpdLgtA);
//////     $ChassisCAN1::BBM::VddmChas1Fr05::VehSpdLgtA= abs(@Carmaker2FC::VehSpdIndcdVehSpdIndcd);    //20241204
////      }
////     else
////    {
////    $Backbone::VCU1::VDDMBackBoneSignalIPdu01::VehSpdLgtSafe = 0; 
//////   $ChassisCAN1::BBM::VddmChas1Fr05::VehSpdLgtA= 0;    //20241204
////     }
////      
////  }
////    
////   else
////  {  
////  $Backbone::VCU1::VDDMBackBoneSignalIPdu01::VehSpdLgtSafe=(@Carmaker2FC::speed)/3.6;
//////  $ChassisCAN1::BBM::VddmChas1Fr05::VehSpdLgtA= (@Carmaker2FC::speed)/3.6;    //20241204
////   }  
//    
//   } 
  

  
 
//// ******My Carout Variant******///
//// ******Message transmit through Flexray Channel******///
// on message MB79_VERSIONS_FL
//  {
//    $SW_Z4_Ver_App_FL=60;
//    $SW_Z4_Ver_Major_FL=210;
//    $SW_Z4_Ver_Minor_FL=1211;
//  }
//  
//  on message MB79_VERSIONS_FR
//  {
//    $SW_Z4_Ver_App_FR=60;
//    $SW_Z4_Ver_Major_FR=210;
//    $SW_Z4_Ver_Minor_FR=1211;
//  }
  
  
//on message FSRLSafetyCANFD1Frame00
//  {
//    $FrntSideRdrLeStsForDim=@Carmaker2FC::FrntSideRdrLeStsForDim;
//    $FrntSideRdrLeStsRdrStsMisAlign=@Carmaker2FC::FrntSideRdrLeStsRdrStsMisAlign;
//    
//    //20250117_fanjunjie_add
//    $FrntSideRdrLeStsRdrStsBlkd0bin=@FaDC::FrntSideRdrLeStsRdrStsBlkd0bin;
//    $FrntSideRdrRiStsRdrStsBlkd0bin=@FaDC::FrntSideRdrRiStsRdrStsBlkd0bin;
//    $ReSideRdrLeStsRdrStsBlkd0bin=@FaDC::ReSideRdrLeStsRdrStsBlkd0bin;
//    $ReSideRdrRiStsRdrStsBlkd0bin=@FaDC::ReSideRdrRiStsRdrStsBlkd0bin;
//   
//    
//    
//    //20250117_fanjunjie_add
//  if(@FaDC::FrntSideRdrLeStsRdrStsChks_Control==0)
//{ 
//  ILNodeDisturbChecksum("FSRLSafetyCANFD1Frame00","FrntSideRdrLeSts",0,0,1000,0);
//}
//  if(@FaDC::FrntSideRdrLeStsRdrStsCntr_Control==0)
//{ 
//   ILNodeDisturbCounter("FSRLSafetyCANFD1Frame00","FrntSideRdrLeSts",0,0,1000,0,1);
//}
//    
//    
//  }
  
//on message FSRRSafetyCANFD1Frame00 
//{
//  $FrntSideRdrRiStsForDim=@Carmaker2FC::FrntSideRdrRiStsForDim;
//  $FrntSideRdrRiStsRdrStsMisAlign=@Carmaker2FC::FrntSideRdrRiStsRdrStsMisAlign;
//}
//
//on message FLRSafetyCANFD2Frame00
//  {
//    $FrntRdrStsForDim=@Carmaker2FC::FrntRdrStsForDim;
//    $FrntRdrStsRdrStsMisAlign=@FaDC::FrntRdrStsRdrStsMisAlign;
////    $FrntRdrStsRdrStsMisAlign=@Carmaker2FC::FrntRdrStsRdrStsMisAlign;
//    $FrntRdrStsRdrStsBlkd0bin=@FaDC::FrntRdrStsRdrStsBlkd0bin;
//    
//    //20250324_fanjunjie_add
//   $FrntRdrStsRdrStsFaulty=@FaDC::FrntRdrStsRdrStsFaulty;
//  }
  
//    on message MB79_VERSIONS_FLR
//  {
//    $SW_Z4_Ver_App_FLR=61;
//    $SW_Z4_Ver_Major_FLR=210;
//    $SW_Z4_Ver_Minor_FLR=1210;
//  }
//  
//  
//    on message MB79_VERSIONS_RL
//  {
//    $SW_Z4_Ver_App_RL=60;
//    $SW_Z4_Ver_Major_RL=210;
//    $SW_Z4_Ver_Minor_RL=1211;
//  } 
//
//   on message MB79_VERSIONS_RR
//  {
//    $SW_Z4_Ver_App_RR=60;
//    $SW_Z4_Ver_Major_RR=210;
//    $SW_Z4_Ver_Minor_RR=1211;
//  } 
//  
  
  

  
  
  

//on message SODLSafetyCANFD3Frame00 
//{
//  $ReSideRdrLeStsForDim=@Carmaker2FC::ReSideRdrLeStsForDim;
//  $ReSideRdrLeStsRdrStsMisAlign=@Carmaker2FC::ReSideRdrLeStsRdrStsMisAlign;
//}
//
//on message SODRSafetyCANFD3Frame00 
//{
//  $ReSideRdrRiStsForDim=@Carmaker2FC::ReSideRdrRiStsForDim;
//  $ReSideRdrRiStsRdrStsMisAlign=@Carmaker2FC::ReSideRdrRiStsRdrStsMisAlign;
//}

  
//// ******Message transmit through Channel CAN4******///   
//  on message PASSafetyCANFD4Fr01
//{
//    $SafetyCANFD4::PAS::PASSafetyCANFD4Fr01::PrkgAssiElectcStabyProgCtrlModReqGroupPASElectcStabyProgCtrlModReq = @Carmaker2FC::PrkgAssiElectcStabyProgCtrlModReqGroupPASElectcStabyProgCtrlModReq;
////    $SafetyCANFD4::PAS::PASSafetyCANFD4Fr01::PrkgEmgyBrkEmgyBrkReq = @Carmaker2FC::PrkgEmgyBrkEmgyBrkReq;
//    $SafetyCANFD4::PAS::PASSafetyCANFD4Fr01::PrkgAssiSysRemPrkgSts = @Carmaker2FC::PrkgAssiSysRemPrkgSts;
//
//
////    //@FC2Carmaker_MyCarOutReturn::PrkgAssiElectcStabyProgCtrlModReqGroupPASElectcStabyProgCtrlModReq=$SafetyCANFD4::PAS::PASSafetyCANFD4Fr01::PrkgAssiElectcStabyProgCtrlModReqGroupPASElectcStabyProgCtrlModReq;
////    //@FC2Carmaker_MyCarOutReturn::PrkgEmgyBrkEmgyBrkReq=$SafetyCANFD4::PAS::PASSafetyCANFD4Fr01::PrkgEmgyBrkEmgyBrkReq;
//}

//  on message PASSafetyCANFD4Fr20
//{
//  $SafetyCANFD4::PAS::PASSafetyCANFD4Fr20::PrkgEmgyBrkSysSts = @Carmaker2FC::PrkgEmgyBrkSysSts;
//  //@FC2Carmaker_MyCarOutReturn::PrkgEmgyBrkSysSts=$SafetyCANFD4::PAS::PASSafetyCANFD4Fr20::PrkgEmgyBrkSysSts;
//
//  //20250224_fanjunjie_add
//  $SafetyCANFD4::PAS::PASSafetyCANFD4Fr20::DrvrAsscSysSts = @Carmaker2FC::DrvrAsscSysSts;
//}

//// ******Message transmit through Channel CAN4******///     

//// ******Message transmit through Channel CAN5******///
//on message RmlToAsdmPasSafeDiagResFrame
//  {
//    
//  }
//  
//on message RmrPassSafeCANFr01
//  {
//    
//  }
//  
//on message RmlPassSafeCANFrame1
//  {
//    
//  }
//// ******Message transmit through Channel CAN5******///

//// ******Message transmit through Channel CAN5******///  
  
//// ******Message transmit through Channel CAN6******///
//    on message VddmChas1Fr03
//  {
//    $ChassisCAN1::VDDM::VddmChas1Fr03::ADataRawSafeALat=BypassSwitch_float(@Carmaker2FC::ADataRawSafeALat_Set,@Carmaker2FC::ADataRawSafeALat);
//
//    
//  }
  
  
//on message BcmChas1NMFr
//  {
//    
//  }

//on message PscmChas1Fr01
//  {
//    $DrvrSteerActvDrvrSteerActv=@Carmaker2FC::DrvrSteerActvDrvrSteerActv;
//    
////    if(@FaDC::DrvrSteerActvChks_Control==0)
////    {
////    ILNodeDisturbChecksum("PscmChas1Fr01","DrvrSteerActv",0,0,1000,0);
////    }
////    else
////    {
////    ILNodeDisturbChecksum("PscmChas1Fr01","DrvrSteerActv",0,1,0,0);
////    }
////
////    if((@FaDC::DrvrSteerActvCntr_Control==0&&temp_DrvrSteerActvCntr_Control==1))
////    {
////    @IL_CAN1::NODES::N_PSCM1::MESSAGES::PscmChas1Fr01::SIGGRPS::DrvrSteerActv::CNTR::Disturb=1;
////    }
////    else
////    {
////    @IL_CAN1::NODES::N_PSCM1::MESSAGES::PscmChas1Fr01::SIGGRPS::DrvrSteerActv::CNTR::Disturb=0;
////    }
////    if((@FaDC::DrvrSteerActvCntr_Control==1&&temp_DrvrSteerActvCntr_Control==0))
////    { 
////    @IL_CAN1::NODES::N_PSCM1::MESSAGES::PscmChas1Fr01::SIGGRPS::DrvrSteerActv::CNTR::NormalOperation=1;
////    }
////    else
////    {
////    @IL_CAN1::NODES::N_PSCM1::MESSAGES::PscmChas1Fr01::SIGGRPS::DrvrSteerActv::CNTR::NormalOperation=0;
////    }
////    temp_DrvrSteerActvChks_Control=@FaDC::DrvrSteerActvChks_Control;
////    temp_DrvrSteerActvCntr_Control=@FaDC::DrvrSteerActvCntr_Control;
//    //FaDC_DrvrSteerActv_E2E();
//
////    20250117_fanjunjie_add
////     if(@FaDC::DrvrSteerActv_UB==1)
////    {
////    @IL_CAN1::NODES::N_PSCM1::MESSAGES::PscmChas1Fr01::SIGNALS::DrvrSteerActv_UB::UB::Disturb =1;
////    @IL_CAN1::NODES::N_PSCM1::MESSAGES::PscmChas1Fr01::SIGNALS::DrvrSteerActv_UB::UB::Mode=0;
////    @IL_CAN1::NODES::N_PSCM1::MESSAGES::PscmChas1Fr01::SIGNALS::DrvrSteerActv_UB::UB::NormalOperation=0;
////    @IL_CAN1::NODES::N_PSCM1::MESSAGES::PscmChas1Fr01::SIGNALS::DrvrSteerActv_UB::UB::Value=1;
////    } 
////    else
////    {
////    @IL_CAN1::NODES::N_PSCM1::MESSAGES::PscmChas1Fr01::SIGNALS::DrvrSteerActv_UB::UB::Disturb =1;
////    @IL_CAN1::NODES::N_PSCM1::MESSAGES::PscmChas1Fr01::SIGNALS::DrvrSteerActv_UB::UB::Mode=0;
////    @IL_CAN1::NODES::N_PSCM1::MESSAGES::PscmChas1Fr01::SIGNALS::DrvrSteerActv_UB::UB::NormalOperation=0;
////    @IL_CAN1::NODES::N_PSCM1::MESSAGES::PscmChas1Fr01::SIGNALS::DrvrSteerActv_UB::UB::Value=0;
////    }
//    
////        if(@FaDC::DrvrSteerActv_UB==1)
////    {
////    @IL_CAN1::NODES::N_PSCM1::MESSAGES::PscmChas1Fr01::SIGGRPS::DrvrSteerActv::UB::Disturb =0;
////    @IL_CAN1::NODES::N_PSCM1::MESSAGES::PscmChas1Fr01::SIGGRPS::DrvrSteerActv::UB::Mode=1;
////    @IL_CAN1::NODES::N_PSCM1::MESSAGES::PscmChas1Fr01::SIGGRPS::DrvrSteerActv::UB::NormalOperation=1;
////    } 
////    else
////    {
////    @IL_CAN1::NODES::N_PSCM1::MESSAGES::PscmChas1Fr01::SIGGRPS::DrvrSteerActv::UB::Disturb=1;
////    @IL_CAN1::NODES::N_PSCM1::MESSAGES::PscmChas1Fr01::SIGGRPS::DrvrSteerActv::UB::Mode=0;
////    @IL_CAN1::NODES::N_PSCM1::MESSAGES::PscmChas1Fr01::SIGGRPS::DrvrSteerActv::UB::NormalOperation=0;
////    }
//    
//
//    //FaDC_DrvrSteerActv_UB();
//    
//
//  }

//on message PscmChas1Fr02
//  {
//    $ChassisCAN1::PSCM1::PscmChas1Fr02::SteerWhlTqAddl_UB=1.0;
    
//    if(@FaDC::SteerServoSts_UB==1)
//    {
//    @IL_CAN1::NODES::N_PSCM1::MESSAGES::PscmChas1Fr02::SIGNALS::SteerServoSts_UB::UB::Disturb =1;
//    @IL_CAN1::NODES::N_PSCM1::MESSAGES::PscmChas1Fr02::SIGNALS::SteerServoSts_UB::UB::Mode=0;
//    @IL_CAN1::NODES::N_PSCM1::MESSAGES::PscmChas1Fr02::SIGNALS::SteerServoSts_UB::UB::NormalOperation=0;
//    @IL_CAN1::NODES::N_PSCM1::MESSAGES::PscmChas1Fr02::SIGNALS::SteerServoSts_UB::UB::Value=1;
//    } 
//    else
//    {
//    @IL_CAN1::NODES::N_PSCM1::MESSAGES::PscmChas1Fr02::SIGNALS::SteerServoSts_UB::UB::Disturb =1;
//    @IL_CAN1::NODES::N_PSCM1::MESSAGES::PscmChas1Fr02::SIGNALS::SteerServoSts_UB::UB::Mode=0;
//    @IL_CAN1::NODES::N_PSCM1::MESSAGES::PscmChas1Fr02::SIGNALS::SteerServoSts_UB::UB::NormalOperation=0;
//    @IL_CAN1::NODES::N_PSCM1::MESSAGES::PscmChas1Fr02::SIGNALS::SteerServoSts_UB::UB::Value=0;
//    }
    //FaDC_SteerServoSts_UB();
    
    //20250407_fanjunjie_add
//    if(@FaDC::LatCtrlModCfmd_UB==1)
//    {
//    @IL_CAN1::NODES::N_PSCM1::MESSAGES::PscmChas1Fr02::SIGGRPS::LatCtrlModCfmd::UB::Disturb =1;
//    @IL_CAN1::NODES::N_PSCM1::MESSAGES::PscmChas1Fr02::SIGGRPS::LatCtrlModCfmd::UB::Mode=0;
//    @IL_CAN1::NODES::N_PSCM1::MESSAGES::PscmChas1Fr02::SIGGRPS::LatCtrlModCfmd::UB::NormalOperation=0;
//    @IL_CAN1::NODES::N_PSCM1::MESSAGES::PscmChas1Fr02::SIGGRPS::LatCtrlModCfmd::UB::Value=1;
//    } 
//    else
//    {
//    @IL_CAN1::NODES::N_PSCM1::MESSAGES::PscmChas1Fr02::SIGGRPS::LatCtrlModCfmd::UB::Disturb =1;
//    @IL_CAN1::NODES::N_PSCM1::MESSAGES::PscmChas1Fr02::SIGGRPS::LatCtrlModCfmd::UB::Mode=0;
//    @IL_CAN1::NODES::N_PSCM1::MESSAGES::PscmChas1Fr02::SIGGRPS::LatCtrlModCfmd::UB::NormalOperation=0;
//    @IL_CAN1::NODES::N_PSCM1::MESSAGES::PscmChas1Fr02::SIGGRPS::LatCtrlModCfmd::UB::Value=0;
//    }
    //FaDC_LatCtrlModCfmd_UB();
    
    
//  }

 

   
  



//on message PscmChas1Fr03
//  {
//    //20250117_fanjunjie_add
////    if(@FaDC::SteerExtFctSts_UB==1)
////    {
////    @IL_CAN1::NODES::N_PSCM1::MESSAGES::PscmChas1Fr03::SIGGRPS::SteerExtFctSts::UB::Disturb =0;
////    @IL_CAN1::NODES::N_PSCM1::MESSAGES::PscmChas1Fr03::SIGGRPS::SteerExtFctSts::UB::Mode=1;
////    @IL_CAN1::NODES::N_PSCM1::MESSAGES::PscmChas1Fr03::SIGGRPS::SteerExtFctSts::UB::NormalOperation=1;
////    } 
////    else
////    {
////    @IL_CAN1::NODES::N_PSCM1::MESSAGES::PscmChas1Fr03::SIGGRPS::SteerExtFctSts::UB::Disturb=1;
////    @IL_CAN1::NODES::N_PSCM1::MESSAGES::PscmChas1Fr03::SIGGRPS::SteerExtFctSts::UB::Mode=0;
////    @IL_CAN1::NODES::N_PSCM1::MESSAGES::PscmChas1Fr03::SIGGRPS::SteerExtFctSts::UB::NormalOperation=0;
////    }
//    //FaDC_SteerExtFctSts_UB();
//    
//        //20250407_fanjunjie_add
////        if(@FaDC::DrvrSteerWhlHldGroup_UB==1)
////    {
////    @IL_CAN1::NODES::N_PSCM1::MESSAGES::PscmChas1Fr03::SIGGRPS::DrvrSteerWhlHldGroup::UB::Disturb =0;
////    @IL_CAN1::NODES::N_PSCM1::MESSAGES::PscmChas1Fr03::SIGGRPS::DrvrSteerWhlHldGroup::UB::Mode=1;
////    @IL_CAN1::NODES::N_PSCM1::MESSAGES::PscmChas1Fr03::SIGGRPS::DrvrSteerWhlHldGroup::UB::NormalOperation=1;
////    } 
////    else
////    {
////    @IL_CAN1::NODES::N_PSCM1::MESSAGES::PscmChas1Fr03::SIGGRPS::DrvrSteerWhlHldGroup::UB::Disturb=1;
////    @IL_CAN1::NODES::N_PSCM1::MESSAGES::PscmChas1Fr03::SIGGRPS::DrvrSteerWhlHldGroup::UB::Mode=0;
////    @IL_CAN1::NODES::N_PSCM1::MESSAGES::PscmChas1Fr03::SIGGRPS::DrvrSteerWhlHldGroup::UB::NormalOperation=0;
////    }
////        //20250402_fanjunjie_add
////    if(@FaDC::DrvrSteerWhlHldGroup_UB==1)
////    {
////    @IL_CAN1::NODES::N_PSCM1::MESSAGES::PscmChas1Fr03::SIGGRPS::DrvrSteerWhlHldGroup::UB::Disturb =0;
////    @IL_CAN1::NODES::N_PSCM1::MESSAGES::PscmChas1Fr03::SIGGRPS::DrvrSteerWhlHldGroup::UB::Mode=1;
////    @IL_CAN1::NODES::N_PSCM1::MESSAGES::PscmChas1Fr03::SIGGRPS::DrvrSteerWhlHldGroup::UB::NormalOperation=1;
////    } 
////    else
////    {
////    @IL_CAN1::NODES::N_PSCM1::MESSAGES::PscmChas1Fr03::SIGGRPS::DrvrSteerWhlHldGroup::UB::Disturb=1;
////    @IL_CAN1::NODES::N_PSCM1::MESSAGES::PscmChas1Fr03::SIGGRPS::DrvrSteerWhlHldGroup::UB::Mode=0;
////    @IL_CAN1::NODES::N_PSCM1::MESSAGES::PscmChas1Fr03::SIGGRPS::DrvrSteerWhlHldGroup::UB::NormalOperation=0;
////    }
//    //FaDC_DrvrSteerWhlHldGroup_UB();
//    
//    
//    
//    
//  $ChassisCAN1::PSCM1::PscmChas1Fr03::DrvrSteerWhlHldGroupDrvrSteerWhlHldQly = @Carmaker2FC::DrvrSteerWhlHldGroupDrvrSteerWhlHldQly;
//  //@FC2Carmaker_MyCarOutReturn::DrvrSteerWhlHldGroupDrvrSteerWhlHldQly=$ChassisCAN1::PSCM1::PscmChas1Fr03::DrvrSteerWhlHldGroupDrvrSteerWhlHldQly;
//
//  $ChassisCAN1::PSCM1::PscmChas1Fr03::DrvrSteerWhlHldGroupDrvrSteerWhlHld = @Carmaker2FC::DrvrSteerWhlHldGroupDrvrSteerWhlHld;
//  //@FC2Carmaker_MyCarOutReturn::DrvrSteerWhlHldGroupDrvrSteerWhlHld=$ChassisCAN1::PSCM1::PscmChas1Fr03::DrvrSteerWhlHldGroupDrvrSteerWhlHld;
//  }

//on message PscmChas1Fr07
//  {
////    if(@FaDC::PinionSteerAgGroup_UB==1)
////    {
////    @IL_CAN1::NODES::N_PSCM1::MESSAGES::PscmChas1Fr07::SIGGRPS::PinionSteerAgGroup::UB::Disturb =0;
////    @IL_CAN1::NODES::N_PSCM1::MESSAGES::PscmChas1Fr07::SIGGRPS::PinionSteerAgGroup::UB::Mode=1;
////    @IL_CAN1::NODES::N_PSCM1::MESSAGES::PscmChas1Fr07::SIGGRPS::PinionSteerAgGroup::UB::NormalOperation=1;
////    } 
////    else
////    {
////    @IL_CAN1::NODES::N_PSCM1::MESSAGES::PscmChas1Fr07::SIGGRPS::PinionSteerAgGroup::UB::Disturb=1;
////    @IL_CAN1::NODES::N_PSCM1::MESSAGES::PscmChas1Fr07::SIGGRPS::PinionSteerAgGroup::UB::Mode=0;
////    @IL_CAN1::NODES::N_PSCM1::MESSAGES::PscmChas1Fr07::SIGGRPS::PinionSteerAgGroup::UB::NormalOperation=0;
////    }
//    //FaDC_PinionSteerAgGroup_UB();
//    
//    
////    if(@FaDC::PinionSteerAgGroupChks_Control==0)
////    {
////    ILNodeDisturbChecksum("PscmChas1Fr07","PinionSteerAgGroup",0,0,1000,0);
////    }
////    else
////    {
////    ILNodeDisturbChecksum("PscmChas1Fr07","PinionSteerAgGroup",0,1,0,0);
////    }
////    
////    if((@FaDC::PinionSteerAgGroupCntr_Control==0&&temp_PinionSteerAgGroupCntr_Control==1))
////    {
////    @IL_CAN1::NODES::N_PSCM1::MESSAGES::PscmChas1Fr07::SIGGRPS::PinionSteerAgGroup::CNTR::Disturb=1;
////    }
////    else
////    {
////    @IL_CAN1::NODES::N_PSCM1::MESSAGES::PscmChas1Fr07::SIGGRPS::PinionSteerAgGroup::CNTR::Disturb=0;
////    }
////    if((@FaDC::PinionSteerAgGroupCntr_Control==1&&temp_PinionSteerAgGroupCntr_Control==0))
////    { 
////    @IL_CAN1::NODES::N_PSCM1::MESSAGES::PscmChas1Fr07::SIGGRPS::PinionSteerAgGroup::CNTR::NormalOperation=1;
////    }
////    else
////    {
////    @IL_CAN1::NODES::N_PSCM1::MESSAGES::PscmChas1Fr07::SIGGRPS::PinionSteerAgGroup::CNTR::NormalOperation=0;
////    }
////    temp_PinionSteerAgGroupChks_Control=@FaDC::PinionSteerAgGroupChks_Control;
////    temp_PinionSteerAgGroupCntr_Control=@FaDC::PinionSteerAgGroupCntr_Control;
//    //FaDC_PinionSteerAgGroup_E2E();
//    
//    
////    $ChassisCAN1::PSCM1::PscmChas1Fr07::PinionSteerAgGroupSteerWhlTq=@Carmaker2FC::PinionSteerAgGroupSteerWhlTq;
//    $ChassisCAN1::PSCM1::PscmChas1Fr07::PinionSteerAgGroupPinionSteerAg1=BypassSwitch_float(@Carmaker2FC::SteerWhlSnsrAg,@Carmaker2FC::PinionSteerAgGroupPinionSteerAg1);  
//    //20250312//
//    $ChassisCAN1::PSCM1::PscmChas1Fr07::PinionSteerAgGroupPinionSteerAgSpd1=BypassSwitch_float(@Carmaker2FC::SteerWhlSnsrAgSpd,@Carmaker2FC::PinionSteerAgGroupPinionSteerAgSpd1*0.1); 
//    
//    $ChassisCAN1::PSCM1::PscmChas1Fr07::PinionSteerAgGroupPinionSteerAg1Qf=@FaDC::PinionSteerAgGroupPinionSteerAg1Qf;
//    $ChassisCAN1::PSCM1::PscmChas1Fr07::PinionSteerAgGroupPinionSteerAgSpd1Qf=@FaDC::PinionSteerAgGroupPinionSteerAgSpd1Qf;
////    $ChassisCAN1::PSCM1::PscmChas1Fr07::PinionSteerAgGroupSteerWhlTqQf=@FaDC::PinionSteerAgGroupSteerWhlTqQf; 
//
//  }
  
// on message AsdmChas1Fr01
//  {
// @sysvar::FC2Carmaker::PASFuncActive=$PASFuncActive; 
//  }
//on message SasChas1Fr01
//  {
////    if(@FaDC::SteerWhlSnsr_UB==1)
////    {
////    @IL_CAN1::NODES::N_SAS::MESSAGES::SasChas1Fr01::SIGGRPS::SteerWhlSnsr::UB::Disturb =0;
////    @IL_CAN1::NODES::N_SAS::MESSAGES::SasChas1Fr01::SIGGRPS::SteerWhlSnsr::UB::Mode=1;
////    @IL_CAN1::NODES::N_SAS::MESSAGES::SasChas1Fr01::SIGGRPS::SteerWhlSnsr::UB::NormalOperation=1;
////    } 
////    else
////    {
////    @IL_CAN1::NODES::N_SAS::MESSAGES::SasChas1Fr01::SIGGRPS::SteerWhlSnsr::UB::Disturb=1;
////    @IL_CAN1::NODES::N_SAS::MESSAGES::SasChas1Fr01::SIGGRPS::SteerWhlSnsr::UB::Mode=0;
////    @IL_CAN1::NODES::N_SAS::MESSAGES::SasChas1Fr01::SIGGRPS::SteerWhlSnsr::UB::NormalOperation=0;
////    }
//    //FaDC_SteerWhlSnsr_UB();
//    
//    
////    if(@FaDC::SteerWhlSnsrChks_Control==0)
////    {
////    ILNodeDisturbChecksum("SasChas1Fr01","SteerWhlSnsr",0,0,1000,0);
////    }
////    else
////    {
////    ILNodeDisturbChecksum("SasChas1Fr01","SteerWhlSnsr",0,1,0,0);
////    }
////    if((@FaDC::SteerWhlSnsrCntr_Control==0&&temp_SteerWhlSnsrCntr_Control==1))
////    {
////    @IL_CAN1::NODES::N_SAS::MESSAGES::SasChas1Fr01::SIGGRPS::SteerWhlSnsr::CNTR::Disturb=1;
////    }
////    else
////    {
////    @IL_CAN1::NODES::N_SAS::MESSAGES::SasChas1Fr01::SIGGRPS::SteerWhlSnsr::CNTR::Disturb=0;
////    }
////    if((@FaDC::SteerWhlSnsrCntr_Control==1&&temp_SteerWhlSnsrCntr_Control==0))
////    {
////    @IL_CAN1::NODES::N_SAS::MESSAGES::SasChas1Fr01::SIGGRPS::SteerWhlSnsr::CNTR::NormalOperation=1;
////    }
////    else
////    {
////    @IL_CAN1::NODES::N_SAS::MESSAGES::SasChas1Fr01::SIGGRPS::SteerWhlSnsr::CNTR::NormalOperation=0;
////    }
////    temp_SteerWhlSnsrChks_Control=@FaDC::SteerWhlSnsrChks_Control;
////    temp_SteerWhlSnsrCntr_Control=@FaDC::SteerWhlSnsrCntr_Control;
//    //FaDC_SteerWhlSnsr_E2E();
//    
//    
//    $ChassisCAN1::SAS::SasChas1Fr01::SteerWhlSnsrQf=@FaDC::SteerWhlSnsrQf;
//    $ChassisCAN1::SAS::SasChas1Fr01::SteerWhlSnsrAg =BypassSwitch_float(@Carmaker2FC::SteerWhlSnsrAg,@Carmaker2FC::PinionSteerAgGroupPinionSteerAg1);
//    $ChassisCAN1::SAS::SasChas1Fr01::SteerWhlSnsrAgSpd =BypassSwitch_float(@Carmaker2FC::SteerWhlSnsrAgSpd,@Carmaker2FC::PinionSteerAgGroupPinionSteerAgSpd1*0.1);
//  }
//// ******Message transmit through Channel CAN6******///
  
float calculate_wheelsum(float WhlSpd)
  {
    float WhlR,Totalpluse,Whlplus,T,calcuPluse;
    WhlR=0.7534;//WhlR=0.72;
    Totalpluse=109;//Totalpluse=96;
    T=5;//T=10;
    calcuPluse=WhlSpd*T*Totalpluse/(pi*WhlR*1000);
    if(calcuPluse<1.0 && calcuPluse>0.2)
      {
        Whlplus=1;
      }
    else
      {
       Whlplus=calcuPluse;
      }
    return Whlplus;
  }
  
int CFG(int vehicleType,int num,int posn)
{
  //0:HC11,1:HX11,2:XE08
  if(num==0)
  {
    num=72;
  }
  if(vehicleType==0)
  {
    return Carparameter_V446K[num-1][posn];
  }
}

//add_20241203_fanjunjie
 int CFG_Ext(int vehicleType,int num,int posn)
{
  //0:HC11,1:HX11,2:XE08
  if(num==0)
  {
    num=72;
  }
  if(vehicleType==0)
  {
    return Carparameter_V446K_Ext[num-1][posn];
  }

}
  
  
int round(float a)
  {
     if(a-(int)a<0.5) 
      {
        return (int)a;
      }
    else
      {
        return (int)a+1;
      }
  }
  
  ////Use for bypass switch ,when carmaker single_set not 0,assign single_set to  cannoe single///
float BypassSwitch_float (float SwitchSetValueFlag,float CarmakerValue )
  {
    if(SwitchSetValueFlag == 0)
      {
        return CarmakerValue;
      }
    else
      {
        return SwitchSetValueFlag;
      }
  }
  ////Use for bypass switch ,when carmaker single_set not 0,assign single_set to  cannoe single////

  
int resetSwitchcount(int a)
{
@Panel::DrvrACCrsSetSpdReqDrvrCrsSetSpdReq = 0;
@Panel::counter = 0; 
@Panel::Confirm = 0; 
@Panel::falling = 0;
@Panel::rising = 0;
return  (int)a;
}

  
