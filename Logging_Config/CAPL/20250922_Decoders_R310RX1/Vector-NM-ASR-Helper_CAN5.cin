variables
{
  /* NM-IL Include for CAN Vector IL with AUTOSAR NM
   *
   * This include file establishes the coupling between NM --> IL.
   *
   * The simulation node needs to load the components CANoeILNLVector.dll and AsrNM33.dll.
   *
   * Call NMCAN5_OnInit() in "on preStart()" of the main program!
   * Call NMCAN5_OnStart() in "on start()" of the main program!
   *
   * Version 6.5, (c) 2016 Vector Informatik GmbH, Department for Networks and Distributed Systems
   */

  const dword cNMCAN5_NMIndDebug      = 0x0001;
  const dword cNMCAN5_NMInitDebug     = 0x0002;
  const dword cNMCAN5_ILControlDebug  = 0x0010;
  
  const double cNMCAN5_NS2S = 1000000000.0;

  // Internally used variables and timers:
  dword   gNMCAN5_BusContext = 0;
  long    gNMCAN5_CurrentNMState = cCAN5_ASR_NM_STATE_UNDEFINED;
  long    gNMCAN5_CurrentNMInternalRequest = 0;
  
}

/*****************************************************************************
 * Include Initialization
 *****************************************************************************/

void NMCAN5_OnInit ()
{
  // This function must be called from the main program in "on preStart()"!

  //Nm_SetVerbosity(3);
  
  
  gNMCAN5_BusContext = GetBusNameContext(gCAN5BusName);

  if (strncmp("%NODE_NAME%", "_Gateway", 50) == 0)
  {
    gNMPCAN5_DebugFlags |= cNMCAN5_NMIndDebug;
    gNMPCAN5_DebugFlags |= cNMCAN5_NMInitDebug;
    gNMPCAN5_DebugFlags |= cNMPCAN5_NMControlDebug;
    gNMPCAN5_DebugFlags |= cNMCAN5_ILControlDebug;
  }

  SetBusContext(gNMCAN5_BusContext);
  Nm_ConfigureILNotifications( 0, 1 ); // regardless of NM callbacks inform IL
}

void NMCAN5_OnStart ()
{
  // This function must be called from the main program in "on start()"!
  
  if (gNMPCAN5_DebugFlags & cNMCAN5_NMInitDebug)
  {
    write("+++++++++ %NODE_NAME%: CAN NM on start()");
  }
}

/*****************************************************************************
 * NM Control
 * These functions can be called from the main program or react on
 * panel controls in order to manipulate the NM status of the controlled node.
 *****************************************************************************/

void NMCAN5_Enable (int enable)
{
  /* void NMCAN5_Enable (int enable);
   *
   *  Function enables/disables the Network Management DLL.
   */
  int wasEnabled = -1;

  //if (enable == wasEnabled) return;

  if (gNMPCAN5_DebugFlags & cNMPCAN5_NMControlDebug)
  {
    write("[%.6f %NODE_NAME%] NMCAN5_Enable(%d) called ...", TimeNowNS()/cNMCAN5_NS2S, enable);
  }

  SetBusContext(gNMCAN5_BusContext);
  if (enable == 1)
  {
    Nm_CtrlSimulationOn();
  }
  else
  {
    Nm_CtrlSimulationOff();
  }

  wasEnabled = enable;
}

void NMCAN5_SetApplActivity (int activity)
{
  /* void NMCAN5_SetApplActivity (int activity);
   *
   *  Function sets the application activity at the Interaction Layer.
   */
  int wasActivity = -1;

  //if (activity == wasActivity) return;

  if (gNMPCAN5_DebugFlags & cNMPCAN5_NMControlDebug)
  {
    write("[%.6f %NODE_NAME%] NMCAN5_SetApplActivity(%d) called ...", TimeNowNS()/cNMCAN5_NS2S, activity);
  }

  SetBusContext(gNMCAN5_BusContext);
  if (activity > 0)
  {
    Nm_SetApplicationActivity(1);
  }
  else
  {
    Nm_SetApplicationActivity(0);
  }

  wasActivity = activity;
}

NMCAN5_ReleaseBus()
{
  if (gNMPCAN5_DebugFlags & cNMPCAN5_NMControlDebug)
  {
    write("[%.6f %NODE_NAME%]: Nm_NetworkRelease()", TimeNowNS()/cNMCAN5_NS2S);
  }
  SetBusContext(gNMCAN5_BusContext);
  Nm_NetworkRelease();
}

NMCAN5_RequestBus ()
{
  if (gNMPCAN5_DebugFlags & cNMPCAN5_NMControlDebug)
  {
    write("[%.6f %NODE_NAME%]: Nm_NetworkRequest()", TimeNowNS()/cNMCAN5_NS2S);
  }
  SetBusContext(gNMCAN5_BusContext);
  Nm_NetworkRequest();
}

NMCAN5_PassiveBusStart ()
{
  if (gNMPCAN5_DebugFlags & cNMPCAN5_NMControlDebug)
  {
    write("[%.6f %NODE_NAME%]: Nm_PassiveStartUp()", TimeNowNS()/cNMCAN5_NS2S);
  }
  SetBusContext(gNMCAN5_BusContext);
  Nm_PassiveStartUp();
}

NMCAN5_PowerOnStart()
{
  //NMCAN5_PassiveBusStart();
}

on sysvar sysvar::NM_CAN5::StateControl::NmPduTxEnable
{
  SetBusContext(gNMCAN5_BusContext);
  if(@this == 1)
    Nm_DisablePassiveMode(); // NM PDU is transmitted after wake up, and in normal operation and repeat message state
  else 
    Nm_EnablePassiveMode(); // NM PDU is never transmitted
}

/*****************************************************************************
 * NM Indications
 * They are called from the NM simulation in order to control the IL.
 *****************************************************************************/

void NMCAN5_IndNetworkStart()
{
  if (gNMPCAN5_DebugFlags & cNMCAN5_NMIndDebug)
  {
    write("[%.6f %NODE_NAME%]: Nm_NetworkStartInd()", TimeNowNS()/cNMCAN5_NS2S);
  }
  NMCAN5_PassiveBusStart();
}

void NMCAN5_IndNetworkMode()
{
  if (gNMPCAN5_DebugFlags & cNMCAN5_NMIndDebug)
  {
    write("[%.6f %NODE_NAME%]: Nm_NetworkModeInd()", TimeNowNS()/cNMCAN5_NS2S);
  }
  StartSim(gNMCAN5_BusContext, 1, 4);
}

void NMCAN5_IndNetworkTimeout()
{
  if (gNMPCAN5_DebugFlags & cNMCAN5_NMIndDebug)
  {
    write("[%.6f %NODE_NAME%]: Nm_NetworkTimeoutInd()", TimeNowNS()/cNMCAN5_NS2S);
  }
}

void NMCAN5_IndPrepareBusSleepMode()
{
  if (gNMPCAN5_DebugFlags & cNMCAN5_NMIndDebug)
  {
    write("[%.6f %NODE_NAME%]: Nm_PrepareBusSleepModeInd()", TimeNowNS()/cNMCAN5_NS2S);
  }
  StopSim(gNMCAN5_BusContext, 1, 4);
}

void NMCAN5_IndBusSleepMode()
{
  if (gNMPCAN5_DebugFlags & cNMCAN5_NMIndDebug)
  {
    write("[%.6f %NODE_NAME%]: Nm_BusSleepModeInd()", TimeNowNS()/cNMCAN5_NS2S);
  }
}

void NMCAN5_IndStateChangeNotification( long previousState, long currentState) 
{
  long mode;
  if ((previousState == cCAN5_ASR_NM_STATE_UNDEFINED || previousState == cCAN5_ASR_NM_STATE_BUS_SLEEP) && (currentState != cCAN5_ASR_NM_STATE_BUS_SLEEP))
  { 
    @sysvar::NM_CAN5::StateControl::ActiveNodes += 1;
  }
  if ((previousState != cCAN5_ASR_NM_STATE_UNDEFINED) && (currentState == cCAN5_ASR_NM_STATE_BUS_SLEEP))
  { 
    @sysvar::NM_CAN5::StateControl::ActiveNodes -= 1;
  }

  gNMCAN5_CurrentNMState = currentState;

  if ((currentState <= cCAN5_ASR_NM_STATE_BUS_SLEEP) || (currentState > cCAN5_ASR_NM_STATE_SYNCHRONIZE))
  {
    mode = cCAN5_NM_NODE_MODE_Sleep_Mode;
  }
  else
  {
    if (currentState == cCAN5_ASR_NM_STATE_SYNCHRONIZE)
    {
      mode = cCAN5_NM_NODE_MODE_Synchronize_Mode;
    }
    else
    {
      mode = cCAN5_NM_NODE_MODE_Network_Mode;
    }
  }

  if (gNMPCAN5_DebugFlags & cNMCAN5_NMIndDebug)
  {
    write("[%.6f %NODE_NAME%]: NM currentState = %d, mode = %d", TimeNowNS()/cNMCAN5_NS2S, currentState, mode);
  }
}

/*****************************************************************************
 * EOF
 *****************************************************************************/
