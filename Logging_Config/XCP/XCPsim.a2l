/* @@@@ File written by CANAPE_VERSION 17 0 0 @@@@ */
ASAP2_VERSION 1 71
/begin PROJECT XCPsim ""
/begin MODULE CPP ""
/begin MOD_COMMON "" BYTE_ORDER MSB_LAST ALIGNMENT_BYTE 1 ALIGNMENT_WORD 1 ALIGNMENT_LONG 1 ALIGNMENT_INT64 1 ALIGNMENT_FLOAT16_IEEE 1 ALIGNMENT_FLOAT32_IEEE 1 ALIGNMENT_FLOAT64_IEEE 1 /end MOD_COMMON
/begin IF_DATA XCP
 /begin PROTOCOL_LAYER 0x0100 0x07D0 0x07D0 0x00 0x00 0x00 0x00 0x00 0x08 0x08 BYTE_ORDER_MSB_LAST ADDRESS_GRANULARITY_BYTE OPTIONAL_CMD PROGRAM_NEXT OPTIONAL_CMD PROGRAM_RESET OPTIONAL_CMD PROGRAM OPTIONAL_CMD PROGRAM_CLEAR OPTIONAL_CMD PROGRAM_START OPTIONAL_CMD ALLOC_ODT_ENTRY OPTIONAL_CMD ALLOC_ODT OPTIONAL_CMD ALLOC_DAQ OPTIONAL_CMD FREE_DAQ OPTIONAL_CMD GET_DAQ_EVENT_INFO OPTIONAL_CMD GET_DAQ_RESOLUTION_INFO OPTIONAL_CMD GET_DAQ_PROCESSOR_INFO OPTIONAL_CMD GET_DAQ_CLOCK OPTIONAL_CMD START_STOP_SYNCH OPTIONAL_CMD START_STOP_DAQ_LIST OPTIONAL_CMD GET_DAQ_LIST_MODE OPTIONAL_CMD SET_DAQ_LIST_MODE OPTIONAL_CMD WRITE_DAQ OPTIONAL_CMD SET_DAQ_PTR OPTIONAL_CMD CLEAR_DAQ_LIST OPTIONAL_CMD GET_CAL_PAGE OPTIONAL_CMD SET_CAL_PAGE OPTIONAL_CMD DOWNLOAD OPTIONAL_CMD BUILD_CHECKSUM OPTIONAL_CMD SHORT_UPLOAD OPTIONAL_CMD UPLOAD OPTIONAL_CMD SET_MTA OPTIONAL_CMD UNLOCK OPTIONAL_CMD GET_SEED OPTIONAL_CMD GET_ID OPTIONAL_CMD GET_COMM_MODE_INFO COMMUNICATION_MODE_SUPPORTED BLOCK SLAVE MASTER 0x2B 0x00 SEED_AND_KEY_EXTERNAL_FUNCTION "SeedNKeyXcp.dll" /end PROTOCOL_LAYER
 /begin DAQ DYNAMIC 0x00 0x06 0x00 OPTIMISATION_TYPE_DEFAULT ADDRESS_EXTENSION_FREE IDENTIFICATION_FIELD_TYPE_RELATIVE_BYTE GRANULARITY_ODT_ENTRY_SIZE_DAQ_BYTE 0x06 OVERLOAD_INDICATION_PID PRESCALER_SUPPORTED RESUME_SUPPORTED /begin STIM GRANULARITY_ODT_ENTRY_SIZE_STIM_BYTE 0x06 /end STIM /begin TIMESTAMP_SUPPORTED 0x0A SIZE_DWORD UNIT_10US /end TIMESTAMP_SUPPORTED /begin EVENT "Key T" "Key T" 0x00 DAQ 0x01 0x00 0x06 0x00 /end EVENT /begin EVENT "10 ms" "10 ms" 0x01 DAQ_STIM 0x01 0x0A 0x06 0x01 /end EVENT /begin EVENT "100ms" "100ms" 0x02 DAQ_STIM 0x01 0x64 0x06 0x02 /end EVENT /begin EVENT "1ms" "1ms" 0x03 DAQ_STIM 0x01 0x01 0x06 0x03 /end EVENT
  /begin EVENT "FilterBypassDaq" "FilterByp" 0x04 DAQ_STIM 0x01 0x0A 0x06 0x04 /end EVENT
  /begin EVENT "FilterBypassStim" "FilterByp" 0x05 STIM 0x01 0x0A 0x06 0x05 /end EVENT
 /end DAQ
 /begin PAG 0x02 /end PAG
 /begin PGM PGM_MODE_ABSOLUTE 0x01 0x00 /begin SECTOR "FLASH" 0x00 0x1C0000 0x19D2 0x00 0x00 0x00 /end SECTOR /end PGM
 /begin XCP_ON_CAN 0x0100 CAN_ID_MASTER 0x01 CAN_ID_SLAVE 0x02 BAUDRATE 0x07A120 SAMPLE_POINT 0x4B SAMPLE_RATE SINGLE BTL_CYCLES 0x08 SJW 0x02 SYNC_EDGE SINGLE /end XCP_ON_CAN
 /begin XCP_ON_FLX 0x0100 0x03E8 "XCPsim.xml" "Cluster_1" 0x01 HEADER_NAX_LEN PACKET_ALIGNMENT_8
  /begin INITIAL_CMD_BUFFER 0x00
   /begin LPDU_ID FLX_SLOT_ID FIXED 0xDB OFFSET FIXED 0x00 CYCLE_REPETITION FIXED 0x01 CHANNEL FIXED A /end LPDU_ID
   /begin XCP_PACKET CMD FIXED RES_ERR NOT_ALLOWED EV_SERV NOT_ALLOWED DAQ NOT_ALLOWED STIM NOT_ALLOWED /end XCP_PACKET
   MAX_FLX_LEN_BUF VARIABLE 0xAA /end INITIAL_CMD_BUFFER
  /begin INITIAL_RES_ERR_BUFFER 0x01
   /begin LPDU_ID FLX_SLOT_ID FIXED 0xDC OFFSET FIXED 0x00 CYCLE_REPETITION FIXED 0x01 CHANNEL FIXED A /end LPDU_ID
   /begin XCP_PACKET CMD NOT_ALLOWED RES_ERR FIXED EV_SERV FIXED DAQ NOT_ALLOWED STIM NOT_ALLOWED /end XCP_PACKET
   MAX_FLX_LEN_BUF VARIABLE 0xAA /end INITIAL_RES_ERR_BUFFER
  /begin POOL_BUFFER 0x02 MAX_FLX_LEN_BUF VARIABLE 0xFE
   /begin LPDU_ID FLX_SLOT_ID VARIABLE INITIAL_VALUE 0x5C OFFSET VARIABLE INITIAL_VALUE 0x00 CYCLE_REPETITION FIXED 0x01 CHANNEL FIXED A /end LPDU_ID
   /begin XCP_PACKET CMD NOT_ALLOWED RES_ERR NOT_ALLOWED EV_SERV NOT_ALLOWED DAQ FIXED STIM NOT_ALLOWED /end XCP_PACKET
  /end POOL_BUFFER
  /begin POOL_BUFFER 0x03 MAX_FLX_LEN_BUF VARIABLE 0xFE
   /begin LPDU_ID FLX_SLOT_ID VARIABLE INITIAL_VALUE 0x5D OFFSET VARIABLE INITIAL_VALUE 0x00 CYCLE_REPETITION VARIABLE INITIAL_VALUE 0x01 CHANNEL FIXED A /end LPDU_ID
   /begin XCP_PACKET CMD NOT_ALLOWED RES_ERR NOT_ALLOWED EV_SERV NOT_ALLOWED DAQ FIXED STIM NOT_ALLOWED /end XCP_PACKET
  /end POOL_BUFFER
  /begin POOL_BUFFER 0x04 MAX_FLX_LEN_BUF VARIABLE 0x80
   /begin LPDU_ID FLX_SLOT_ID VARIABLE INITIAL_VALUE 0x5E OFFSET VARIABLE INITIAL_VALUE 0x00 CYCLE_REPETITION VARIABLE INITIAL_VALUE 0x01 CHANNEL FIXED A /end LPDU_ID
   /begin XCP_PACKET CMD NOT_ALLOWED RES_ERR NOT_ALLOWED EV_SERV NOT_ALLOWED DAQ FIXED STIM NOT_ALLOWED /end XCP_PACKET
  /end POOL_BUFFER
  /begin POOL_BUFFER 0x05 MAX_FLX_LEN_BUF VARIABLE 0x80
   /begin LPDU_ID FLX_SLOT_ID VARIABLE INITIAL_VALUE 0x5F OFFSET VARIABLE INITIAL_VALUE 0x00 CYCLE_REPETITION VARIABLE INITIAL_VALUE 0x01 CHANNEL FIXED A /end LPDU_ID
   /begin XCP_PACKET CMD NOT_ALLOWED RES_ERR NOT_ALLOWED EV_SERV NOT_ALLOWED DAQ FIXED STIM NOT_ALLOWED /end XCP_PACKET
  /end POOL_BUFFER
 /end XCP_ON_FLX
 /begin XCP_ON_TCP_IP 0x0100 0x15B3 ADDRESS "127.0.0.1" /end XCP_ON_TCP_IP
 /begin XCP_ON_UDP_IP 0x0100 0x15B3 ADDRESS "127.0.0.1" /end XCP_ON_UDP_IP
/end IF_DATA
/begin IF_DATA GENERIC_BSW_TEMPLATE_VERSION 0x010234 /end IF_DATA
/begin MOD_PAR ""
 /begin MEMORY_SEGMENT ECUCODE "" CODE FLASH INTERN 0x4C000 0x9CA5D -1 -1 -1 -1 -1
  /begin IF_DATA XCP
   /begin SEGMENT 0x00 0x01 0x00 0x00 0x00 /begin CHECKSUM XCP_CRC_16_CITT MAX_BLOCK_SIZE 0xFFFF EXTERNAL_FUNCTION "" /end CHECKSUM
    /begin PAGE 0x00 ECU_ACCESS_DONT_CARE XCP_READ_ACCESS_DONT_CARE XCP_WRITE_ACCESS_NOT_ALLOWED /end PAGE
   /end SEGMENT
  /end IF_DATA
 /end MEMORY_SEGMENT
 /begin MEMORY_SEGMENT CALRAM "" DATA FLASH INTERN 0x1C0000 0x19D2 -1 -1 -1 -1 -1
  /begin IF_DATA XCP
   /begin SEGMENT 0x01 0x02 0x00 0x00 0x00 /begin CHECKSUM XCP_CRC_16_CITT MAX_BLOCK_SIZE 0xFFFF EXTERNAL_FUNCTION "" /end CHECKSUM
    /begin PAGE 0x01 ECU_ACCESS_WITH_XCP_ONLY XCP_READ_ACCESS_WITH_ECU_ONLY XCP_WRITE_ACCESS_NOT_ALLOWED /end PAGE
    /begin PAGE 0x00 ECU_ACCESS_WITH_XCP_ONLY XCP_READ_ACCESS_WITH_ECU_ONLY XCP_WRITE_ACCESS_WITH_ECU_ONLY /end PAGE
   /end SEGMENT
  /end IF_DATA
 /end MEMORY_SEGMENT
/end MOD_PAR
/begin COMPU_VTAB_RANGE _ "" 6 0 0 "eCalConcept_Simple" 1 1 "eCalConcept_InitRam" 2 2 "eCalConcept_Dynamic" 3 3 "eCalConcept_Incircuit2" 4 4 "eCalConcept_AUTOSAR" 5 5 "eCalConcept_InitRamAddrMapping" DEFAULT_VALUE "" /end COMPU_VTAB_RANGE
/begin COMPU_VTAB HighLow "High/Low for bits" TAB_VERB 2 0 "Low" 1 "High" DEFAULT_VALUE "" /end COMPU_VTAB
/begin COMPU_VTAB TestStatus.CONVERSION "" TAB_VERB 4 0 "Off" 1 "Silent" 2 "Pending" 3 "Running" DEFAULT_VALUE "" /end COMPU_VTAB
/begin COMPU_METHOD ampl.CONVERSION "" IDENTICAL "%6.2f" "" /end COMPU_METHOD
/begin COMPU_METHOD ampl_d.CONVERSION "" IDENTICAL "%6.2" "" /end COMPU_METHOD
/begin COMPU_METHOD bit12Counter.CONVERSION "" IDENTICAL "%6.2f" "" /end COMPU_METHOD
/begin COMPU_METHOD BitSlice.CONVERSION "" IDENTICAL "%6.2f" "" /end COMPU_METHOD
/begin COMPU_METHOD BitSlice0.CONVERSION "" IDENTICAL "%6.2f" "" /end COMPU_METHOD
/begin COMPU_METHOD BitSlice1.CONVERSION "" IDENTICAL "%6.2f" "" /end COMPU_METHOD
/begin COMPU_METHOD BitSlice2.CONVERSION "" IDENTICAL "%6.2f" "" /end COMPU_METHOD
/begin COMPU_METHOD byte1.CONVERSION "" IDENTICAL "%6.2f" "" /end COMPU_METHOD
/begin COMPU_METHOD byte2.CONVERSION "" IDENTICAL "%6.2f" "" /end COMPU_METHOD
/begin COMPU_METHOD byte3.CONVERSION "" IDENTICAL "%6.2f" "" /end COMPU_METHOD
/begin COMPU_METHOD byte4.CONVERSION "" IDENTICAL "%6.2f" "" /end COMPU_METHOD
/begin COMPU_METHOD byteCounter.CONVERSION "" IDENTICAL "%6.2f" "" /end COMPU_METHOD
/begin COMPU_METHOD bytePWMFilter.CONVERSION "" IDENTICAL "%6.2f" "" /end COMPU_METHOD
/begin COMPU_METHOD channel1.CONVERSION "" IDENTICAL "%6.2f" "" /end COMPU_METHOD
/begin COMPU_METHOD channel2.CONVERSION "" IDENTICAL "%6.2f" "" /end COMPU_METHOD
/begin COMPU_METHOD channel3.CONVERSION "" IDENTICAL "%6.2f" "" /end COMPU_METHOD
/begin COMPU_METHOD channel_d.CONVERSION "" IDENTICAL "%6.2" "" /end COMPU_METHOD
/begin COMPU_METHOD Current "Convert Voltage into Current" FORM "%7.3" "" /begin FORMULA "X*X*2" /end FORMULA /end COMPU_METHOD
/begin COMPU_METHOD Curve1.CONVERSION "" IDENTICAL "%6.2f" "" /end COMPU_METHOD
/begin COMPU_METHOD Curve2.CONVERSION "" IDENTICAL "%6.2f" "" /end COMPU_METHOD
/begin COMPU_METHOD Curve3.CONVERSION "" IDENTICAL "%6.2f" "" /end COMPU_METHOD
/begin COMPU_METHOD DigitalFilterConversion "" LINEAR "%3.1" "Volt" COEFFS_LINEAR 0.001 -0 /end COMPU_METHOD
/begin COMPU_METHOD dwordCounter.CONVERSION "" IDENTICAL "%6.2f" "" /end COMPU_METHOD
/begin COMPU_METHOD Factor100 "" LINEAR "%3.1" "" COEFFS_LINEAR 0.01 -0 /end COMPU_METHOD
/begin COMPU_METHOD FW1.CONVERSION "" IDENTICAL "%6.2f" "" /end COMPU_METHOD
/begin COMPU_METHOD HighLow "High/Low for bits" TAB_VERB "%7.3" "" COMPU_TAB_REF HighLow /end COMPU_METHOD
/begin COMPU_METHOD KF1_X_AXIS.CONVERSION "" IDENTICAL "%6.2f" "" /end COMPU_METHOD
/begin COMPU_METHOD KF1_Y_AXIS.CONVERSION "" IDENTICAL "%6.2f" "" /end COMPU_METHOD
/begin COMPU_METHOD KF2.CONVERSION "" IDENTICAL "%6.2f" "" /end COMPU_METHOD
/begin COMPU_METHOD KF3.CONVERSION "" IDENTICAL "%6.2f" "" /end COMPU_METHOD
/begin COMPU_METHOD KF3_X_AXIS.CONVERSION "" IDENTICAL "%6.2f" "" /end COMPU_METHOD
/begin COMPU_METHOD KF3_Y_AXIS.CONVERSION "" IDENTICAL "%6.2f" "" /end COMPU_METHOD
/begin COMPU_METHOD KF4.CONVERSION "" IDENTICAL "%6.2f" "" /end COMPU_METHOD
/begin COMPU_METHOD KF4_Y_AXIS.CONVERSION "" IDENTICAL "%6.2f" "" /end COMPU_METHOD
/begin COMPU_METHOD KF5.CONVERSION "" IDENTICAL "%6.2f" "" /end COMPU_METHOD
/begin COMPU_METHOD KF5_X_AXIS.CONVERSION "" IDENTICAL "%6.2f" "" /end COMPU_METHOD
/begin COMPU_METHOD KF5_Y_AXIS.CONVERSION "" IDENTICAL "%6.2f" "" /end COMPU_METHOD
/begin COMPU_METHOD KF6.CONVERSION "" IDENTICAL "%6.2f" "" /end COMPU_METHOD
/begin COMPU_METHOD KF6_X_AXIS.CONVERSION "" IDENTICAL "%6.2f" "" /end COMPU_METHOD
/begin COMPU_METHOD KF6_Y_AXIS.CONVERSION "" IDENTICAL "%6.2f" "" /end COMPU_METHOD
/begin COMPU_METHOD KF7.CONVERSION "" IDENTICAL "%6.2f" "" /end COMPU_METHOD
/begin COMPU_METHOD KF8_Conversion "" LINEAR "%3.1" "1/min" COEFFS_LINEAR 0.1 -0 /end COMPU_METHOD
/begin COMPU_METHOD KF8_Y_AXIS.CONVERSION "" LINEAR "%3.1" "Nm" COEFFS_LINEAR 0.1 -0 /end COMPU_METHOD
/begin COMPU_METHOD KL1.CONVERSION "" IDENTICAL "%6.2f" "" /end COMPU_METHOD
/begin COMPU_METHOD KL1Output.CONVERSION "" IDENTICAL "%6.2f" "" /end COMPU_METHOD
/begin COMPU_METHOD KL2.CONVERSION "" IDENTICAL "%6.2f" "" /end COMPU_METHOD
/begin COMPU_METHOD KL3.CONVERSION "" IDENTICAL "%6.2f" "" /end COMPU_METHOD
/begin COMPU_METHOD KL3_X_AXIS.CONVERSION "" IDENTICAL "%6.2f" "" /end COMPU_METHOD
/begin COMPU_METHOD KL4.CONVERSION "" IDENTICAL "%6.2f" "" /end COMPU_METHOD
/begin COMPU_METHOD KL5.CONVERSION "" IDENTICAL "%6.2f" "" /end COMPU_METHOD
/begin COMPU_METHOD KL6.CONVERSION "" IDENTICAL "%6.2f" "" /end COMPU_METHOD
/begin COMPU_METHOD KL6_X_AXIS.CONVERSION "" IDENTICAL "%6.2f" "" /end COMPU_METHOD
/begin COMPU_METHOD KL8_X_AXIS.CONVERSION "" IDENTICAL "%6.2f" "" /end COMPU_METHOD
/begin COMPU_METHOD KL8_Y_AXIS.CONVERSION "" IDENTICAL "%6.2f" "" /end COMPU_METHOD
/begin COMPU_METHOD limit.CONVERSION "" IDENTICAL "%6.2f" "" /end COMPU_METHOD
/begin COMPU_METHOD map4_80_uc.CONVERSION "" IDENTICAL "%6.2f" "" /end COMPU_METHOD
/begin COMPU_METHOD map4_80_uc_X_AXIS.CONVERSION "" IDENTICAL "%6.2f" "" /end COMPU_METHOD
/begin COMPU_METHOD map4_80_uc_Y_AXIS.CONVERSION "" IDENTICAL "%6.2f" "" /end COMPU_METHOD
/begin COMPU_METHOD map5_82_uc.CONVERSION "" IDENTICAL "%6.2f" "" /end COMPU_METHOD
/begin COMPU_METHOD map5_82_uc_X_AXIS.CONVERSION "" IDENTICAL "%6.2f" "" /end COMPU_METHOD
/begin COMPU_METHOD map5_82_uc_Y_AXIS.CONVERSION "" IDENTICAL "%6.2f" "" /end COMPU_METHOD
/begin COMPU_METHOD noise.CONVERSION "" IDENTICAL "%6.2f" "" /end COMPU_METHOD
/begin COMPU_METHOD noise_ampl.CONVERSION "" IDENTICAL "%6.2" "" /end COMPU_METHOD
/begin COMPU_METHOD offset.CONVERSION "" IDENTICAL "%6.2f" "" /end COMPU_METHOD
/begin COMPU_METHOD period.CONVERSION "" IDENTICAL "%6.2f" "" /end COMPU_METHOD
/begin COMPU_METHOD period_d.CONVERSION "" IDENTICAL "%6.2" "" /end COMPU_METHOD
/begin COMPU_METHOD perlin_noise.CONVERSION "" IDENTICAL "%6.2f" "" /end COMPU_METHOD
/begin COMPU_METHOD Pressure "Convert Voltage into Pressure" LINEAR "%7.3" "" COEFFS_LINEAR 0.123457 -0 /end COMPU_METHOD
/begin COMPU_METHOD PWM_Level.CONVERSION "" IDENTICAL "%6.2f" "" /end COMPU_METHOD
/begin COMPU_METHOD PWMFiltered.CONVERSION "" IDENTICAL "%6.2f" "" /end COMPU_METHOD
/begin COMPU_METHOD ShiftByte.CONVERSION "" IDENTICAL "%6.2f" "" /end COMPU_METHOD
/begin COMPU_METHOD Simulator_concept.CONVERSION "enumeration table" TAB_VERB "" "" COMPU_TAB_REF _ /end COMPU_METHOD
/begin COMPU_METHOD testbit0.CONVERSION "" IDENTICAL "%6.2f" "" /end COMPU_METHOD
/begin COMPU_METHOD testbit1.CONVERSION "" IDENTICAL "%6.2f" "" /end COMPU_METHOD
/begin COMPU_METHOD testbit2.CONVERSION "" IDENTICAL "%6.2f" "" /end COMPU_METHOD
/begin COMPU_METHOD testbit3.CONVERSION "" IDENTICAL "%6.2f" "" /end COMPU_METHOD
/begin COMPU_METHOD testbit4.CONVERSION "" IDENTICAL "%6.2f" "" /end COMPU_METHOD
/begin COMPU_METHOD testbit5.CONVERSION "" IDENTICAL "%6.2f" "" /end COMPU_METHOD
/begin COMPU_METHOD testbit6.CONVERSION "" IDENTICAL "%6.2f" "" /end COMPU_METHOD
/begin COMPU_METHOD testbit7.CONVERSION "" IDENTICAL "%6.2f" "" /end COMPU_METHOD
/begin COMPU_METHOD testbitslice0.CONVERSION "" IDENTICAL "%6.2f" "" /end COMPU_METHOD
/begin COMPU_METHOD testbitslice1.CONVERSION "" IDENTICAL "%6.2f" "" /end COMPU_METHOD
/begin COMPU_METHOD testbitslice2.CONVERSION "" IDENTICAL "%6.2f" "" /end COMPU_METHOD
/begin COMPU_METHOD testbyte0.CONVERSION "" IDENTICAL "%6.2f" "" /end COMPU_METHOD
/begin COMPU_METHOD testByte000.CONVERSION "" IDENTICAL "%6.2" "" /end COMPU_METHOD
/begin COMPU_METHOD testByte000[000].CONVERSION "" IDENTICAL "%6.2" "" /end COMPU_METHOD
/begin COMPU_METHOD testByte000[001].CONVERSION "" IDENTICAL "%6.2" "" /end COMPU_METHOD
/begin COMPU_METHOD testByte000[002].CONVERSION "" IDENTICAL "%6.2" "" /end COMPU_METHOD
/begin COMPU_METHOD testByte000[003].CONVERSION "" IDENTICAL "%6.2" "" /end COMPU_METHOD
/begin COMPU_METHOD testByte000[004].CONVERSION "" IDENTICAL "%6.2" "" /end COMPU_METHOD
/begin COMPU_METHOD testByte000[005].CONVERSION "" IDENTICAL "%6.2" "" /end COMPU_METHOD
/begin COMPU_METHOD testByte000[006].CONVERSION "" IDENTICAL "%6.2" "" /end COMPU_METHOD
/begin COMPU_METHOD testByte000[007].CONVERSION "" IDENTICAL "%6.2" "" /end COMPU_METHOD
/begin COMPU_METHOD testbyte1.CONVERSION "" IDENTICAL "%6.2f" "" /end COMPU_METHOD
/begin COMPU_METHOD testbyte2.CONVERSION "" IDENTICAL "%6.2f" "" /end COMPU_METHOD
/begin COMPU_METHOD testbyte3.CONVERSION "" IDENTICAL "%6.2f" "" /end COMPU_METHOD
/begin COMPU_METHOD testbyte4.CONVERSION "" IDENTICAL "%6.2f" "" /end COMPU_METHOD
/begin COMPU_METHOD testbyte5.CONVERSION "" IDENTICAL "%6.2f" "" /end COMPU_METHOD
/begin COMPU_METHOD testbyte6.CONVERSION "" IDENTICAL "%6.2f" "" /end COMPU_METHOD
/begin COMPU_METHOD testbyte7.CONVERSION "" IDENTICAL "%6.2f" "" /end COMPU_METHOD
/begin COMPU_METHOD TestByte_000.CONVERSION "" IDENTICAL "" "" /end COMPU_METHOD
/begin COMPU_METHOD TestByte_015.CONVERSION "" IDENTICAL "" "" /end COMPU_METHOD
/begin COMPU_METHOD TestByte_016.CONVERSION "" IDENTICAL "" "" /end COMPU_METHOD
/begin COMPU_METHOD TestByte_023.CONVERSION "" IDENTICAL "" "" /end COMPU_METHOD
/begin COMPU_METHOD TestByte_024.CONVERSION "" IDENTICAL "" "" /end COMPU_METHOD
/begin COMPU_METHOD TestByte_034.CONVERSION "" IDENTICAL "" "" /end COMPU_METHOD
/begin COMPU_METHOD TestByte_059.CONVERSION "" IDENTICAL "" "" /end COMPU_METHOD
/begin COMPU_METHOD TestByte_061.CONVERSION "" IDENTICAL "" "" /end COMPU_METHOD
/begin COMPU_METHOD TestByte_063.CONVERSION "" IDENTICAL "" "" /end COMPU_METHOD
/begin COMPU_METHOD TestByte_064.CONVERSION "" IDENTICAL "" "" /end COMPU_METHOD
/begin COMPU_METHOD TestByte_097.CONVERSION "" IDENTICAL "" "" /end COMPU_METHOD
/begin COMPU_METHOD TestByte_107.CONVERSION "" IDENTICAL "" "" /end COMPU_METHOD
/begin COMPU_METHOD TestByte_131.CONVERSION "" IDENTICAL "" "" /end COMPU_METHOD
/begin COMPU_METHOD TestByte_156.CONVERSION "" IDENTICAL "" "" /end COMPU_METHOD
/begin COMPU_METHOD TestByte_159.CONVERSION "" IDENTICAL "" "" /end COMPU_METHOD
/begin COMPU_METHOD TestByte_182.CONVERSION "" IDENTICAL "" "" /end COMPU_METHOD
/begin COMPU_METHOD TestByte_183.CONVERSION "" IDENTICAL "" "" /end COMPU_METHOD
/begin COMPU_METHOD TestByte_189.CONVERSION "" IDENTICAL "" "" /end COMPU_METHOD
/begin COMPU_METHOD TestByte_195.CONVERSION "" IDENTICAL "" "" /end COMPU_METHOD
/begin COMPU_METHOD TestByte_216.CONVERSION "" IDENTICAL "" "" /end COMPU_METHOD
/begin COMPU_METHOD TestByte_218.CONVERSION "" IDENTICAL "" "" /end COMPU_METHOD
/begin COMPU_METHOD TestByte_221.CONVERSION "" IDENTICAL "" "" /end COMPU_METHOD
/begin COMPU_METHOD TestByte_251.CONVERSION "" IDENTICAL "" "" /end COMPU_METHOD
/begin COMPU_METHOD TestByte_263.CONVERSION "" IDENTICAL "" "" /end COMPU_METHOD
/begin COMPU_METHOD TestByte_276.CONVERSION "" IDENTICAL "" "" /end COMPU_METHOD
/begin COMPU_METHOD TestByte_277.CONVERSION "" IDENTICAL "" "" /end COMPU_METHOD
/begin COMPU_METHOD TestByte_297.CONVERSION "" IDENTICAL "" "" /end COMPU_METHOD
/begin COMPU_METHOD TestByte_302.CONVERSION "" IDENTICAL "" "" /end COMPU_METHOD
/begin COMPU_METHOD TestByte_324.CONVERSION "" IDENTICAL "" "" /end COMPU_METHOD
/begin COMPU_METHOD TestByte_344.CONVERSION "" IDENTICAL "" "" /end COMPU_METHOD
/begin COMPU_METHOD TestByte_346.CONVERSION "" IDENTICAL "" "" /end COMPU_METHOD
/begin COMPU_METHOD TestByte_354.CONVERSION "" IDENTICAL "" "" /end COMPU_METHOD
/begin COMPU_METHOD TestByte_359.CONVERSION "" IDENTICAL "" "" /end COMPU_METHOD
/begin COMPU_METHOD TestByte_378.CONVERSION "" IDENTICAL "" "" /end COMPU_METHOD
/begin COMPU_METHOD TestByte_402.CONVERSION "" IDENTICAL "" "" /end COMPU_METHOD
/begin COMPU_METHOD TestByte_403.CONVERSION "" IDENTICAL "" "" /end COMPU_METHOD
/begin COMPU_METHOD TestByte_406.CONVERSION "" IDENTICAL "" "" /end COMPU_METHOD
/begin COMPU_METHOD TestByte_413.CONVERSION "" IDENTICAL "" "" /end COMPU_METHOD
/begin COMPU_METHOD TestByte_414.CONVERSION "" IDENTICAL "" "" /end COMPU_METHOD
/begin COMPU_METHOD TestByte_415.CONVERSION "" IDENTICAL "" "" /end COMPU_METHOD
/begin COMPU_METHOD TestByte_427.CONVERSION "" IDENTICAL "" "" /end COMPU_METHOD
/begin COMPU_METHOD TestByte_438.CONVERSION "" IDENTICAL "" "" /end COMPU_METHOD
/begin COMPU_METHOD TestByte_446.CONVERSION "" IDENTICAL "" "" /end COMPU_METHOD
/begin COMPU_METHOD TestByte_448.CONVERSION "" IDENTICAL "" "" /end COMPU_METHOD
/begin COMPU_METHOD TestByte_451.CONVERSION "" IDENTICAL "" "" /end COMPU_METHOD
/begin COMPU_METHOD TestByte_462.CONVERSION "" IDENTICAL "" "" /end COMPU_METHOD
/begin COMPU_METHOD TestByte_466.CONVERSION "" IDENTICAL "" "" /end COMPU_METHOD
/begin COMPU_METHOD TestByte_469.CONVERSION "" IDENTICAL "" "" /end COMPU_METHOD
/begin COMPU_METHOD TestByte_486.CONVERSION "" IDENTICAL "" "" /end COMPU_METHOD
/begin COMPU_METHOD TestByte_494.CONVERSION "" IDENTICAL "" "" /end COMPU_METHOD
/begin COMPU_METHOD TestByte_500.CONVERSION "" IDENTICAL "" "" /end COMPU_METHOD
/begin COMPU_METHOD TestByte_527.CONVERSION "" IDENTICAL "" "" /end COMPU_METHOD
/begin COMPU_METHOD TestByte_530.CONVERSION "" IDENTICAL "" "" /end COMPU_METHOD
/begin COMPU_METHOD TestByte_533.CONVERSION "" IDENTICAL "" "" /end COMPU_METHOD
/begin COMPU_METHOD TestByte_556.CONVERSION "" IDENTICAL "" "" /end COMPU_METHOD
/begin COMPU_METHOD TestByte_589.CONVERSION "" IDENTICAL "" "" /end COMPU_METHOD
/begin COMPU_METHOD TestByte_590.CONVERSION "" IDENTICAL "" "" /end COMPU_METHOD
/begin COMPU_METHOD TestByte_591.CONVERSION "" IDENTICAL "" "" /end COMPU_METHOD
/begin COMPU_METHOD TestByte_592.CONVERSION "" IDENTICAL "" "" /end COMPU_METHOD
/begin COMPU_METHOD TestByte_598.CONVERSION "" IDENTICAL "" "" /end COMPU_METHOD
/begin COMPU_METHOD TestByte_606.CONVERSION "" IDENTICAL "" "" /end COMPU_METHOD
/begin COMPU_METHOD TestByte_608.CONVERSION "" IDENTICAL "" "" /end COMPU_METHOD
/begin COMPU_METHOD TestByte_618.CONVERSION "" IDENTICAL "" "" /end COMPU_METHOD
/begin COMPU_METHOD TestByte_621.CONVERSION "" IDENTICAL "" "" /end COMPU_METHOD
/begin COMPU_METHOD TestByte_627.CONVERSION "" IDENTICAL "" "" /end COMPU_METHOD
/begin COMPU_METHOD TestByte_638.CONVERSION "" IDENTICAL "" "" /end COMPU_METHOD
/begin COMPU_METHOD TestByte_644.CONVERSION "" IDENTICAL "" "" /end COMPU_METHOD
/begin COMPU_METHOD TestByte_647.CONVERSION "" IDENTICAL "" "" /end COMPU_METHOD
/begin COMPU_METHOD TestByte_648.CONVERSION "" IDENTICAL "" "" /end COMPU_METHOD
/begin COMPU_METHOD TestByte_659.CONVERSION "" IDENTICAL "" "" /end COMPU_METHOD
/begin COMPU_METHOD TestByte_668.CONVERSION "" IDENTICAL "" "" /end COMPU_METHOD
/begin COMPU_METHOD TestByte_700.CONVERSION "" IDENTICAL "" "" /end COMPU_METHOD
/begin COMPU_METHOD TestByte_711.CONVERSION "" IDENTICAL "" "" /end COMPU_METHOD
/begin COMPU_METHOD TestByte_715.CONVERSION "" IDENTICAL "" "" /end COMPU_METHOD
/begin COMPU_METHOD TestByte_728.CONVERSION "" IDENTICAL "" "" /end COMPU_METHOD
/begin COMPU_METHOD TestByte_731.CONVERSION "" IDENTICAL "" "" /end COMPU_METHOD
/begin COMPU_METHOD TestByte_732.CONVERSION "" IDENTICAL "" "" /end COMPU_METHOD
/begin COMPU_METHOD TestByte_738.CONVERSION "" IDENTICAL "" "" /end COMPU_METHOD
/begin COMPU_METHOD TestByte_746.CONVERSION "" IDENTICAL "" "" /end COMPU_METHOD
/begin COMPU_METHOD TestByte_752.CONVERSION "" IDENTICAL "" "" /end COMPU_METHOD
/begin COMPU_METHOD TestByte_774.CONVERSION "" IDENTICAL "" "" /end COMPU_METHOD
/begin COMPU_METHOD TestByte_777.CONVERSION "" IDENTICAL "" "" /end COMPU_METHOD
/begin COMPU_METHOD TestByte_778.CONVERSION "" IDENTICAL "" "" /end COMPU_METHOD
/begin COMPU_METHOD TestByte_784.CONVERSION "" IDENTICAL "" "" /end COMPU_METHOD
/begin COMPU_METHOD TestByte_786.CONVERSION "" IDENTICAL "" "" /end COMPU_METHOD
/begin COMPU_METHOD TestByte_789.CONVERSION "" IDENTICAL "" "" /end COMPU_METHOD
/begin COMPU_METHOD TestByte_793.CONVERSION "" IDENTICAL "" "" /end COMPU_METHOD
/begin COMPU_METHOD TestByte_798.CONVERSION "" IDENTICAL "" "" /end COMPU_METHOD
/begin COMPU_METHOD TestByte_855.CONVERSION "" IDENTICAL "" "" /end COMPU_METHOD
/begin COMPU_METHOD TestByte_857.CONVERSION "" IDENTICAL "" "" /end COMPU_METHOD
/begin COMPU_METHOD TestByte_861.CONVERSION "" IDENTICAL "" "" /end COMPU_METHOD
/begin COMPU_METHOD TestByte_865.CONVERSION "" IDENTICAL "" "" /end COMPU_METHOD
/begin COMPU_METHOD TestByte_880.CONVERSION "" IDENTICAL "" "" /end COMPU_METHOD
/begin COMPU_METHOD TestByte_902.CONVERSION "" IDENTICAL "" "" /end COMPU_METHOD
/begin COMPU_METHOD TestByte_905.CONVERSION "" IDENTICAL "" "" /end COMPU_METHOD
/begin COMPU_METHOD TestByte_934.CONVERSION "" IDENTICAL "" "" /end COMPU_METHOD
/begin COMPU_METHOD TestByte_938.CONVERSION "" IDENTICAL "" "" /end COMPU_METHOD
/begin COMPU_METHOD TestByte_947.CONVERSION "" IDENTICAL "" "" /end COMPU_METHOD
/begin COMPU_METHOD TestByte_951.CONVERSION "" IDENTICAL "" "" /end COMPU_METHOD
/begin COMPU_METHOD TestByte_961.CONVERSION "" IDENTICAL "" "" /end COMPU_METHOD
/begin COMPU_METHOD TestByte_965.CONVERSION "" IDENTICAL "" "" /end COMPU_METHOD
/begin COMPU_METHOD TestByte_974.CONVERSION "" IDENTICAL "" "" /end COMPU_METHOD
/begin COMPU_METHOD TestByte_976.CONVERSION "" IDENTICAL "" "" /end COMPU_METHOD
/begin COMPU_METHOD TestByte_981.CONVERSION "" IDENTICAL "" "" /end COMPU_METHOD
/begin COMPU_METHOD TestByte_983.CONVERSION "" IDENTICAL "" "" /end COMPU_METHOD
/begin COMPU_METHOD TestByte_993.CONVERSION "" IDENTICAL "" "" /end COMPU_METHOD
/begin COMPU_METHOD testdword0.CONVERSION "" IDENTICAL "%6.2f" "" /end COMPU_METHOD
/begin COMPU_METHOD testdword1.CONVERSION "" IDENTICAL "%6.2f" "" /end COMPU_METHOD
/begin COMPU_METHOD TestDWord_002.CONVERSION "" IDENTICAL "" "" /end COMPU_METHOD
/begin COMPU_METHOD TestDWord_010.CONVERSION "" IDENTICAL "" "" /end COMPU_METHOD
/begin COMPU_METHOD TestDWord_018.CONVERSION "" IDENTICAL "" "" /end COMPU_METHOD
/begin COMPU_METHOD TestDWord_019.CONVERSION "" IDENTICAL "" "" /end COMPU_METHOD
/begin COMPU_METHOD TestDWord_022.CONVERSION "" IDENTICAL "" "" /end COMPU_METHOD
/begin COMPU_METHOD TestDWord_030.CONVERSION "" IDENTICAL "" "" /end COMPU_METHOD
/begin COMPU_METHOD TestDWord_045.CONVERSION "" IDENTICAL "" "" /end COMPU_METHOD
/begin COMPU_METHOD TestDWord_047.CONVERSION "" IDENTICAL "" "" /end COMPU_METHOD
/begin COMPU_METHOD TestDWord_049.CONVERSION "" IDENTICAL "" "" /end COMPU_METHOD
/begin COMPU_METHOD TestDWord_056.CONVERSION "" IDENTICAL "" "" /end COMPU_METHOD
/begin COMPU_METHOD TestDWord_057.CONVERSION "" IDENTICAL "" "" /end COMPU_METHOD
/begin COMPU_METHOD TestDWord_066.CONVERSION "" IDENTICAL "" "" /end COMPU_METHOD
/begin COMPU_METHOD TestDWord_067.CONVERSION "" IDENTICAL "" "" /end COMPU_METHOD
/begin COMPU_METHOD TestDWord_073.CONVERSION "" IDENTICAL "" "" /end COMPU_METHOD
/begin COMPU_METHOD TestDWord_079.CONVERSION "" IDENTICAL "" "" /end COMPU_METHOD
/begin COMPU_METHOD TestDWord_086.CONVERSION "" IDENTICAL "" "" /end COMPU_METHOD
/begin COMPU_METHOD TestDWord_087.CONVERSION "" IDENTICAL "" "" /end COMPU_METHOD
/begin COMPU_METHOD TestDWord_094.CONVERSION "" IDENTICAL "" "" /end COMPU_METHOD
/begin COMPU_METHOD TestDWord_100.CONVERSION "" IDENTICAL "" "" /end COMPU_METHOD
/begin COMPU_METHOD TestDWord_102.CONVERSION "" IDENTICAL "" "" /end COMPU_METHOD
/begin COMPU_METHOD TestDWord_110.CONVERSION "" IDENTICAL "" "" /end COMPU_METHOD
/begin COMPU_METHOD TestDWord_114.CONVERSION "" IDENTICAL "" "" /end COMPU_METHOD
/begin COMPU_METHOD TestDWord_115.CONVERSION "" IDENTICAL "" "" /end COMPU_METHOD
/begin COMPU_METHOD TestDWord_118.CONVERSION "" IDENTICAL "" "" /end COMPU_METHOD
/begin COMPU_METHOD TestDWord_122.CONVERSION "" IDENTICAL "" "" /end COMPU_METHOD
/begin COMPU_METHOD TestDWord_128.CONVERSION "" IDENTICAL "" "" /end COMPU_METHOD
/begin COMPU_METHOD TestDWord_135.CONVERSION "" IDENTICAL "" "" /end COMPU_METHOD
/begin COMPU_METHOD TestDWord_145.CONVERSION "" IDENTICAL "" "" /end COMPU_METHOD
/begin COMPU_METHOD TestDWord_147.CONVERSION "" IDENTICAL "" "" /end COMPU_METHOD
/begin COMPU_METHOD TestDWord_150.CONVERSION "" IDENTICAL "" "" /end COMPU_METHOD
/begin COMPU_METHOD TestDWord_161.CONVERSION "" IDENTICAL "" "" /end COMPU_METHOD
/begin COMPU_METHOD TestDWord_165.CONVERSION "" IDENTICAL "" "" /end COMPU_METHOD
/begin COMPU_METHOD TestDWord_167.CONVERSION "" IDENTICAL "" "" /end COMPU_METHOD
/begin COMPU_METHOD TestDWord_168.CONVERSION "" IDENTICAL "" "" /end COMPU_METHOD
/begin COMPU_METHOD TestDWord_172.CONVERSION "" IDENTICAL "" "" /end COMPU_METHOD
/begin COMPU_METHOD TestDWord_174.CONVERSION "" IDENTICAL "" "" /end COMPU_METHOD
/begin COMPU_METHOD TestDWord_180.CONVERSION "" IDENTICAL "" "" /end COMPU_METHOD
/begin COMPU_METHOD TestDWord_181.CONVERSION "" IDENTICAL "" "" /end COMPU_METHOD
/begin COMPU_METHOD TestDWord_186.CONVERSION "" IDENTICAL "" "" /end COMPU_METHOD
/begin COMPU_METHOD TestDWord_187.CONVERSION "" IDENTICAL "" "" /end COMPU_METHOD
/begin COMPU_METHOD TestDWord_190.CONVERSION "" IDENTICAL "" "" /end COMPU_METHOD
/begin COMPU_METHOD TestDWord_197.CONVERSION "" IDENTICAL "" "" /end COMPU_METHOD
/begin COMPU_METHOD TestDWord_199.CONVERSION "" IDENTICAL "" "" /end COMPU_METHOD
/begin COMPU_METHOD TestDWord_201.CONVERSION "" IDENTICAL "" "" /end COMPU_METHOD
/begin COMPU_METHOD TestDWord_205.CONVERSION "" IDENTICAL "" "" /end COMPU_METHOD
/begin COMPU_METHOD TestDWord_210.CONVERSION "" IDENTICAL "" "" /end COMPU_METHOD
/begin COMPU_METHOD TestDWord_212.CONVERSION "" IDENTICAL "" "" /end COMPU_METHOD
/begin COMPU_METHOD TestDWord_223.CONVERSION "" IDENTICAL "" "" /end COMPU_METHOD
/begin COMPU_METHOD TestDWord_224.CONVERSION "" IDENTICAL "" "" /end COMPU_METHOD
/begin COMPU_METHOD TestDWord_227.CONVERSION "" IDENTICAL "" "" /end COMPU_METHOD
/begin COMPU_METHOD TestDWord_240.CONVERSION "" IDENTICAL "" "" /end COMPU_METHOD
/begin COMPU_METHOD TestDWord_244.CONVERSION "" IDENTICAL "" "" /end COMPU_METHOD
/begin COMPU_METHOD TestDWord_245.CONVERSION "" IDENTICAL "" "" /end COMPU_METHOD
/begin COMPU_METHOD TestDWord_257.CONVERSION "" IDENTICAL "" "" /end COMPU_METHOD
/begin COMPU_METHOD TestDWord_269.CONVERSION "" IDENTICAL "" "" /end COMPU_METHOD
/begin COMPU_METHOD TestDWord_270.CONVERSION "" IDENTICAL "" "" /end COMPU_METHOD
/begin COMPU_METHOD TestDWord_274.CONVERSION "" IDENTICAL "" "" /end COMPU_METHOD
/begin COMPU_METHOD TestDWord_283.CONVERSION "" IDENTICAL "" "" /end COMPU_METHOD
/begin COMPU_METHOD TestDWord_286.CONVERSION "" IDENTICAL "" "" /end COMPU_METHOD
/begin COMPU_METHOD TestDWord_296.CONVERSION "" IDENTICAL "" "" /end COMPU_METHOD
/begin COMPU_METHOD TestDWord_306.CONVERSION "" IDENTICAL "" "" /end COMPU_METHOD
/begin COMPU_METHOD TestDWord_308.CONVERSION "" IDENTICAL "" "" /end COMPU_METHOD
/begin COMPU_METHOD TestDWord_309.CONVERSION "" IDENTICAL "" "" /end COMPU_METHOD
/begin COMPU_METHOD TestDWord_313.CONVERSION "" IDENTICAL "" "" /end COMPU_METHOD
/begin COMPU_METHOD TestDWord_326.CONVERSION "" IDENTICAL "" "" /end COMPU_METHOD
/begin COMPU_METHOD TestDWord_338.CONVERSION "" IDENTICAL "" "" /end COMPU_METHOD
/begin COMPU_METHOD TestDWord_340.CONVERSION "" IDENTICAL "" "" /end COMPU_METHOD
/begin COMPU_METHOD TestDWord_348.CONVERSION "" IDENTICAL "" "" /end COMPU_METHOD
/begin COMPU_METHOD TestDWord_355.CONVERSION "" IDENTICAL "" "" /end COMPU_METHOD
/begin COMPU_METHOD TestDWord_358.CONVERSION "" IDENTICAL "" "" /end COMPU_METHOD
/begin COMPU_METHOD TestDWord_360.CONVERSION "" IDENTICAL "" "" /end COMPU_METHOD
/begin COMPU_METHOD TestDWord_372.CONVERSION "" IDENTICAL "" "" /end COMPU_METHOD
/begin COMPU_METHOD TestDWord_375.CONVERSION "" IDENTICAL "" "" /end COMPU_METHOD
/begin COMPU_METHOD TestDWord_376.CONVERSION "" IDENTICAL "" "" /end COMPU_METHOD
/begin COMPU_METHOD TestDWord_383.CONVERSION "" IDENTICAL "" "" /end COMPU_METHOD
/begin COMPU_METHOD TestDWord_385.CONVERSION "" IDENTICAL "" "" /end COMPU_METHOD
/begin COMPU_METHOD TestDWord_387.CONVERSION "" IDENTICAL "" "" /end COMPU_METHOD
/begin COMPU_METHOD TestDWord_388.CONVERSION "" IDENTICAL "" "" /end COMPU_METHOD
/begin COMPU_METHOD TestDWord_396.CONVERSION "" IDENTICAL "" "" /end COMPU_METHOD
/begin COMPU_METHOD TestDWord_398.CONVERSION "" IDENTICAL "" "" /end COMPU_METHOD
/begin COMPU_METHOD TestDWord_399.CONVERSION "" IDENTICAL "" "" /end COMPU_METHOD
/begin COMPU_METHOD TestDWord_407.CONVERSION "" IDENTICAL "" "" /end COMPU_METHOD
/begin COMPU_METHOD TestDWord_409.CONVERSION "" IDENTICAL "" "" /end COMPU_METHOD
/begin COMPU_METHOD TestDWord_410.CONVERSION "" IDENTICAL "" "" /end COMPU_METHOD
/begin COMPU_METHOD TestDWord_411.CONVERSION "" IDENTICAL "" "" /end COMPU_METHOD
/begin COMPU_METHOD TestDWord_426.CONVERSION "" IDENTICAL "" "" /end COMPU_METHOD
/begin COMPU_METHOD TestDWord_431.CONVERSION "" IDENTICAL "" "" /end COMPU_METHOD
/begin COMPU_METHOD TestDWord_433.CONVERSION "" IDENTICAL "" "" /end COMPU_METHOD
/begin COMPU_METHOD TestDWord_443.CONVERSION "" IDENTICAL "" "" /end COMPU_METHOD
/begin COMPU_METHOD TestDWord_444.CONVERSION "" IDENTICAL "" "" /end COMPU_METHOD
/begin COMPU_METHOD TestDWord_458.CONVERSION "" IDENTICAL "" "" /end COMPU_METHOD
/begin COMPU_METHOD TestDWord_470.CONVERSION "" IDENTICAL "" "" /end COMPU_METHOD
/begin COMPU_METHOD TestDWord_471.CONVERSION "" IDENTICAL "" "" /end COMPU_METHOD
/begin COMPU_METHOD TestDWord_474.CONVERSION "" IDENTICAL "" "" /end COMPU_METHOD
/begin COMPU_METHOD TestDWord_478.CONVERSION "" IDENTICAL "" "" /end COMPU_METHOD
/begin COMPU_METHOD TestDWord_479.CONVERSION "" IDENTICAL "" "" /end COMPU_METHOD
/begin COMPU_METHOD TestDWord_480.CONVERSION "" IDENTICAL "" "" /end COMPU_METHOD
/begin COMPU_METHOD TestDWord_483.CONVERSION "" IDENTICAL "" "" /end COMPU_METHOD
/begin COMPU_METHOD TestDWord_488.CONVERSION "" IDENTICAL "" "" /end COMPU_METHOD
/begin COMPU_METHOD TestDWord_492.CONVERSION "" IDENTICAL "" "" /end COMPU_METHOD
/begin COMPU_METHOD TestDWord_496.CONVERSION "" IDENTICAL "" "" /end COMPU_METHOD
/begin COMPU_METHOD TestDWord_501.CONVERSION "" IDENTICAL "" "" /end COMPU_METHOD
/begin COMPU_METHOD TestDWord_502.CONVERSION "" IDENTICAL "" "" /end COMPU_METHOD
/begin COMPU_METHOD TestDWord_503.CONVERSION "" IDENTICAL "" "" /end COMPU_METHOD
/begin COMPU_METHOD TestDWord_504.CONVERSION "" IDENTICAL "" "" /end COMPU_METHOD
/begin COMPU_METHOD TestDWord_508.CONVERSION "" IDENTICAL "" "" /end COMPU_METHOD
/begin COMPU_METHOD TestDWord_516.CONVERSION "" IDENTICAL "" "" /end COMPU_METHOD
/begin COMPU_METHOD TestDWord_524.CONVERSION "" IDENTICAL "" "" /end COMPU_METHOD
/begin COMPU_METHOD TestDWord_529.CONVERSION "" IDENTICAL "" "" /end COMPU_METHOD
/begin COMPU_METHOD TestDWord_534.CONVERSION "" IDENTICAL "" "" /end COMPU_METHOD
/begin COMPU_METHOD TestDWord_535.CONVERSION "" IDENTICAL "" "" /end COMPU_METHOD
/begin COMPU_METHOD TestDWord_545.CONVERSION "" IDENTICAL "" "" /end COMPU_METHOD
/begin COMPU_METHOD TestDWord_550.CONVERSION "" IDENTICAL "" "" /end COMPU_METHOD
/begin COMPU_METHOD TestDWord_557.CONVERSION "" IDENTICAL "" "" /end COMPU_METHOD
/begin COMPU_METHOD TestDWord_558.CONVERSION "" IDENTICAL "" "" /end COMPU_METHOD
/begin COMPU_METHOD TestDWord_575.CONVERSION "" IDENTICAL "" "" /end COMPU_METHOD
/begin COMPU_METHOD TestDWord_576.CONVERSION "" IDENTICAL "" "" /end COMPU_METHOD
/begin COMPU_METHOD TestDWord_577.CONVERSION "" IDENTICAL "" "" /end COMPU_METHOD
/begin COMPU_METHOD TestDWord_582.CONVERSION "" IDENTICAL "" "" /end COMPU_METHOD
/begin COMPU_METHOD TestDWord_584.CONVERSION "" IDENTICAL "" "" /end COMPU_METHOD
/begin COMPU_METHOD TestDWord_596.CONVERSION "" IDENTICAL "" "" /end COMPU_METHOD
/begin COMPU_METHOD TestDWord_601.CONVERSION "" IDENTICAL "" "" /end COMPU_METHOD
/begin COMPU_METHOD TestDWord_620.CONVERSION "" IDENTICAL "" "" /end COMPU_METHOD
/begin COMPU_METHOD TestDWord_624.CONVERSION "" IDENTICAL "" "" /end COMPU_METHOD
/begin COMPU_METHOD TestDWord_643.CONVERSION "" IDENTICAL "" "" /end COMPU_METHOD
/begin COMPU_METHOD TestDWord_669.CONVERSION "" IDENTICAL "" "" /end COMPU_METHOD
/begin COMPU_METHOD TestDWord_671.CONVERSION "" IDENTICAL "" "" /end COMPU_METHOD
/begin COMPU_METHOD TestDWord_675.CONVERSION "" IDENTICAL "" "" /end COMPU_METHOD
/begin COMPU_METHOD TestDWord_679.CONVERSION "" IDENTICAL "" "" /end COMPU_METHOD
/begin COMPU_METHOD TestDWord_684.CONVERSION "" IDENTICAL "" "" /end COMPU_METHOD
/begin COMPU_METHOD TestDWord_691.CONVERSION "" IDENTICAL "" "" /end COMPU_METHOD
/begin COMPU_METHOD TestDWord_693.CONVERSION "" IDENTICAL "" "" /end COMPU_METHOD
/begin COMPU_METHOD TestDWord_694.CONVERSION "" IDENTICAL "" "" /end COMPU_METHOD
/begin COMPU_METHOD TestDWord_697.CONVERSION "" IDENTICAL "" "" /end COMPU_METHOD
/begin COMPU_METHOD TestDWord_703.CONVERSION "" IDENTICAL "" "" /end COMPU_METHOD
/begin COMPU_METHOD TestDWord_708.CONVERSION "" IDENTICAL "" "" /end COMPU_METHOD
/begin COMPU_METHOD TestDWord_714.CONVERSION "" IDENTICAL "" "" /end COMPU_METHOD
/begin COMPU_METHOD TestDWord_716.CONVERSION "" IDENTICAL "" "" /end COMPU_METHOD
/begin COMPU_METHOD TestDWord_722.CONVERSION "" IDENTICAL "" "" /end COMPU_METHOD
/begin COMPU_METHOD TestDWord_724.CONVERSION "" IDENTICAL "" "" /end COMPU_METHOD
/begin COMPU_METHOD TestDWord_725.CONVERSION "" IDENTICAL "" "" /end COMPU_METHOD
/begin COMPU_METHOD TestDWord_727.CONVERSION "" IDENTICAL "" "" /end COMPU_METHOD
/begin COMPU_METHOD TestDWord_730.CONVERSION "" IDENTICAL "" "" /end COMPU_METHOD
/begin COMPU_METHOD TestDWord_748.CONVERSION "" IDENTICAL "" "" /end COMPU_METHOD
/begin COMPU_METHOD TestDWord_758.CONVERSION "" IDENTICAL "" "" /end COMPU_METHOD
/begin COMPU_METHOD TestDWord_769.CONVERSION "" IDENTICAL "" "" /end COMPU_METHOD
/begin COMPU_METHOD TestDWord_773.CONVERSION "" IDENTICAL "" "" /end COMPU_METHOD
/begin COMPU_METHOD TestDWord_782.CONVERSION "" IDENTICAL "" "" /end COMPU_METHOD
/begin COMPU_METHOD TestDWord_783.CONVERSION "" IDENTICAL "" "" /end COMPU_METHOD
/begin COMPU_METHOD TestDWord_794.CONVERSION "" IDENTICAL "" "" /end COMPU_METHOD
/begin COMPU_METHOD TestDWord_800.CONVERSION "" IDENTICAL "" "" /end COMPU_METHOD
/begin COMPU_METHOD TestDWord_805.CONVERSION "" IDENTICAL "" "" /end COMPU_METHOD
/begin COMPU_METHOD TestDWord_811.CONVERSION "" IDENTICAL "" "" /end COMPU_METHOD
/begin COMPU_METHOD TestDWord_814.CONVERSION "" IDENTICAL "" "" /end COMPU_METHOD
/begin COMPU_METHOD TestDWord_823.CONVERSION "" IDENTICAL "" "" /end COMPU_METHOD
/begin COMPU_METHOD TestDWord_825.CONVERSION "" IDENTICAL "" "" /end COMPU_METHOD
/begin COMPU_METHOD TestDWord_828.CONVERSION "" IDENTICAL "" "" /end COMPU_METHOD
/begin COMPU_METHOD TestDWord_839.CONVERSION "" IDENTICAL "" "" /end COMPU_METHOD
/begin COMPU_METHOD TestDWord_849.CONVERSION "" IDENTICAL "" "" /end COMPU_METHOD
/begin COMPU_METHOD TestDWord_850.CONVERSION "" IDENTICAL "" "" /end COMPU_METHOD
/begin COMPU_METHOD TestDWord_851.CONVERSION "" IDENTICAL "" "" /end COMPU_METHOD
/begin COMPU_METHOD TestDWord_863.CONVERSION "" IDENTICAL "" "" /end COMPU_METHOD
/begin COMPU_METHOD TestDWord_866.CONVERSION "" IDENTICAL "" "" /end COMPU_METHOD
/begin COMPU_METHOD TestDWord_873.CONVERSION "" IDENTICAL "" "" /end COMPU_METHOD
/begin COMPU_METHOD TestDWord_875.CONVERSION "" IDENTICAL "" "" /end COMPU_METHOD
/begin COMPU_METHOD TestDWord_883.CONVERSION "" IDENTICAL "" "" /end COMPU_METHOD
/begin COMPU_METHOD TestDWord_895.CONVERSION "" IDENTICAL "" "" /end COMPU_METHOD
/begin COMPU_METHOD TestDWord_899.CONVERSION "" IDENTICAL "" "" /end COMPU_METHOD
/begin COMPU_METHOD TestDWord_906.CONVERSION "" IDENTICAL "" "" /end COMPU_METHOD
/begin COMPU_METHOD TestDWord_907.CONVERSION "" IDENTICAL "" "" /end COMPU_METHOD
/begin COMPU_METHOD TestDWord_908.CONVERSION "" IDENTICAL "" "" /end COMPU_METHOD
/begin COMPU_METHOD TestDWord_910.CONVERSION "" IDENTICAL "" "" /end COMPU_METHOD
/begin COMPU_METHOD TestDWord_917.CONVERSION "" IDENTICAL "" "" /end COMPU_METHOD
/begin COMPU_METHOD TestDWord_922.CONVERSION "" IDENTICAL "" "" /end COMPU_METHOD
/begin COMPU_METHOD TestDWord_923.CONVERSION "" IDENTICAL "" "" /end COMPU_METHOD
/begin COMPU_METHOD TestDWord_925.CONVERSION "" IDENTICAL "" "" /end COMPU_METHOD
/begin COMPU_METHOD TestDWord_927.CONVERSION "" IDENTICAL "" "" /end COMPU_METHOD
/begin COMPU_METHOD TestDWord_929.CONVERSION "" IDENTICAL "" "" /end COMPU_METHOD
/begin COMPU_METHOD TestDWord_932.CONVERSION "" IDENTICAL "" "" /end COMPU_METHOD
/begin COMPU_METHOD TestDWord_933.CONVERSION "" IDENTICAL "" "" /end COMPU_METHOD
/begin COMPU_METHOD TestDWord_945.CONVERSION "" IDENTICAL "" "" /end COMPU_METHOD
/begin COMPU_METHOD TestDWord_956.CONVERSION "" IDENTICAL "" "" /end COMPU_METHOD
/begin COMPU_METHOD TestDWord_959.CONVERSION "" IDENTICAL "" "" /end COMPU_METHOD
/begin COMPU_METHOD TestDWord_979.CONVERSION "" IDENTICAL "" "" /end COMPU_METHOD
/begin COMPU_METHOD TestDWord_980.CONVERSION "" IDENTICAL "" "" /end COMPU_METHOD
/begin COMPU_METHOD TestDWord_990.CONVERSION "" IDENTICAL "" "" /end COMPU_METHOD
/begin COMPU_METHOD TestDWord_994.CONVERSION "" IDENTICAL "" "" /end COMPU_METHOD
/begin COMPU_METHOD TestDWord_995.CONVERSION "" IDENTICAL "" "" /end COMPU_METHOD
/begin COMPU_METHOD TestDWord_996.CONVERSION "" IDENTICAL "" "" /end COMPU_METHOD
/begin COMPU_METHOD TestKennfeld.CONVERSION "" IDENTICAL "%6.2f" "" /end COMPU_METHOD
/begin COMPU_METHOD TestKennfeld_X_AXIS.CONVERSION "" IDENTICAL "%6.2f" "" /end COMPU_METHOD
/begin COMPU_METHOD TestKennfeld_Y_AXIS.CONVERSION "" IDENTICAL "%6.2f" "" /end COMPU_METHOD
/begin COMPU_METHOD TestStatus.CONVERSION "" TAB_VERB "%3.1" "" COMPU_TAB_REF TestStatus.CONVERSION /end COMPU_METHOD
/begin COMPU_METHOD TestStruct1.s0.CONVERSION "" IDENTICAL "%6.2" "" /end COMPU_METHOD
/begin COMPU_METHOD TestStruct1.s1.CONVERSION "" IDENTICAL "%6.2" "" /end COMPU_METHOD
/begin COMPU_METHOD TestStruct2[000].s0.CONVERSION "" IDENTICAL "%6.2" "" /end COMPU_METHOD
/begin COMPU_METHOD TestStruct2[000].s1.CONVERSION "" IDENTICAL "%6.2" "" /end COMPU_METHOD
/begin COMPU_METHOD TestStruct2[001].s0.CONVERSION "" IDENTICAL "%6.2" "" /end COMPU_METHOD
/begin COMPU_METHOD TestStruct2[001].s1.CONVERSION "" IDENTICAL "%6.2" "" /end COMPU_METHOD
/begin COMPU_METHOD TestStructStruct1.doubles.CONVERSION "" IDENTICAL "%6.2" "" /end COMPU_METHOD
/begin COMPU_METHOD TestStructStruct1.ints.CONVERSION "" IDENTICAL "%6.2" "" /end COMPU_METHOD
/begin COMPU_METHOD TestStructStruct1.TestStruct2.s0.CONVERSION "" IDENTICAL "%6.2" "" /end COMPU_METHOD
/begin COMPU_METHOD TestStructStruct1.TestStruct2.s1.CONVERSION "" IDENTICAL "%6.2" "" /end COMPU_METHOD
/begin COMPU_METHOD TestStructTypes.cTest.CONVERSION "" IDENTICAL "%6.2" "" /end COMPU_METHOD
/begin COMPU_METHOD TestStructTypes.dTest.CONVERSION "" IDENTICAL "%6.2" "" /end COMPU_METHOD
/begin COMPU_METHOD TestStructTypes.fTest.CONVERSION "" IDENTICAL "%6.2" "" /end COMPU_METHOD
/begin COMPU_METHOD TestStructTypes.iTest.CONVERSION "" IDENTICAL "%6.2" "" /end COMPU_METHOD
/begin COMPU_METHOD TestStructTypes.lTest.CONVERSION "" IDENTICAL "%6.2" "" /end COMPU_METHOD
/begin COMPU_METHOD TestStructTypes.sTest.CONVERSION "" IDENTICAL "%6.2" "" /end COMPU_METHOD
/begin COMPU_METHOD TestStructTypes.ucTest.CONVERSION "" IDENTICAL "%6.2" "" /end COMPU_METHOD
/begin COMPU_METHOD TestStructTypes.uiTest.CONVERSION "" IDENTICAL "%6.2" "" /end COMPU_METHOD
/begin COMPU_METHOD TestStructTypes.ulTest.CONVERSION "" IDENTICAL "%6.2" "" /end COMPU_METHOD
/begin COMPU_METHOD TestStructTypes.usTest.CONVERSION "" IDENTICAL "%6.2" "" /end COMPU_METHOD
/begin COMPU_METHOD testubitslice0.CONVERSION "" IDENTICAL "%6.2f" "" /end COMPU_METHOD
/begin COMPU_METHOD testubitslice1.CONVERSION "" IDENTICAL "%6.2f" "" /end COMPU_METHOD
/begin COMPU_METHOD testubitslice2.CONVERSION "" IDENTICAL "%6.2f" "" /end COMPU_METHOD
/begin COMPU_METHOD testubyte0.CONVERSION "" IDENTICAL "%6.2f" "" /end COMPU_METHOD
/begin COMPU_METHOD testubyte1.CONVERSION "" IDENTICAL "%6.2f" "" /end COMPU_METHOD
/begin COMPU_METHOD testubyte2.CONVERSION "" IDENTICAL "%6.2f" "" /end COMPU_METHOD
/begin COMPU_METHOD testubyte3.CONVERSION "" IDENTICAL "%6.2f" "" /end COMPU_METHOD
/begin COMPU_METHOD testubyte4.CONVERSION "" IDENTICAL "%6.2f" "" /end COMPU_METHOD
/begin COMPU_METHOD testubyte5.CONVERSION "" IDENTICAL "%6.2f" "" /end COMPU_METHOD
/begin COMPU_METHOD testubyte6.CONVERSION "" IDENTICAL "%6.2f" "" /end COMPU_METHOD
/begin COMPU_METHOD testubyte7.CONVERSION "" IDENTICAL "%6.2f" "" /end COMPU_METHOD
/begin COMPU_METHOD testudword0.CONVERSION "" IDENTICAL "%6.2f" "" /end COMPU_METHOD
/begin COMPU_METHOD testudword1.CONVERSION "" IDENTICAL "%6.2f" "" /end COMPU_METHOD
/begin COMPU_METHOD testuword0.CONVERSION "" IDENTICAL "%6.2f" "" /end COMPU_METHOD
/begin COMPU_METHOD testuword1.CONVERSION "" IDENTICAL "%6.2f" "" /end COMPU_METHOD
/begin COMPU_METHOD testuword2.CONVERSION "" IDENTICAL "%6.2f" "" /end COMPU_METHOD
/begin COMPU_METHOD testuword3.CONVERSION "" IDENTICAL "%6.2f" "" /end COMPU_METHOD
/begin COMPU_METHOD testword0.CONVERSION "" IDENTICAL "%6.2f" "" /end COMPU_METHOD
/begin COMPU_METHOD testword1.CONVERSION "" IDENTICAL "%6.2f" "" /end COMPU_METHOD
/begin COMPU_METHOD testword2.CONVERSION "" IDENTICAL "%6.2f" "" /end COMPU_METHOD
/begin COMPU_METHOD testword3.CONVERSION "" IDENTICAL "%6.2f" "" /end COMPU_METHOD
/begin COMPU_METHOD TestWord_001.CONVERSION "" IDENTICAL "" "" /end COMPU_METHOD
/begin COMPU_METHOD TestWord_003.CONVERSION "" IDENTICAL "" "" /end COMPU_METHOD
/begin COMPU_METHOD TestWord_004.CONVERSION "" IDENTICAL "" "" /end COMPU_METHOD
/begin COMPU_METHOD TestWord_005.CONVERSION "" IDENTICAL "" "" /end COMPU_METHOD
/begin COMPU_METHOD TestWord_006.CONVERSION "" IDENTICAL "" "" /end COMPU_METHOD
/begin COMPU_METHOD TestWord_007.CONVERSION "" IDENTICAL "" "" /end COMPU_METHOD
/begin COMPU_METHOD TestWord_008.CONVERSION "" IDENTICAL "" "" /end COMPU_METHOD
/begin COMPU_METHOD TestWord_009.CONVERSION "" IDENTICAL "" "" /end COMPU_METHOD
/begin COMPU_METHOD TestWord_011.CONVERSION "" IDENTICAL "" "" /end COMPU_METHOD
/begin COMPU_METHOD TestWord_012.CONVERSION "" IDENTICAL "" "" /end COMPU_METHOD
/begin COMPU_METHOD TestWord_013.CONVERSION "" IDENTICAL "" "" /end COMPU_METHOD
/begin COMPU_METHOD TestWord_014.CONVERSION "" IDENTICAL "" "" /end COMPU_METHOD
/begin COMPU_METHOD TestWord_017.CONVERSION "" IDENTICAL "" "" /end COMPU_METHOD
/begin COMPU_METHOD TestWord_020.CONVERSION "" IDENTICAL "" "" /end COMPU_METHOD
/begin COMPU_METHOD TestWord_021.CONVERSION "" IDENTICAL "" "" /end COMPU_METHOD
/begin COMPU_METHOD TestWord_025.CONVERSION "" IDENTICAL "" "" /end COMPU_METHOD
/begin COMPU_METHOD TestWord_026.CONVERSION "" IDENTICAL "" "" /end COMPU_METHOD
/begin COMPU_METHOD TestWord_027.CONVERSION "" IDENTICAL "" "" /end COMPU_METHOD
/begin COMPU_METHOD TestWord_028.CONVERSION "" IDENTICAL "" "" /end COMPU_METHOD
/begin COMPU_METHOD TestWord_029.CONVERSION "" IDENTICAL "" "" /end COMPU_METHOD
/begin COMPU_METHOD TestWord_031.CONVERSION "" IDENTICAL "" "" /end COMPU_METHOD
/begin COMPU_METHOD TestWord_032.CONVERSION "" IDENTICAL "" "" /end COMPU_METHOD
/begin COMPU_METHOD TestWord_033.CONVERSION "" IDENTICAL "" "" /end COMPU_METHOD
/begin COMPU_METHOD TestWord_035.CONVERSION "" IDENTICAL "" "" /end COMPU_METHOD
/begin COMPU_METHOD TestWord_036.CONVERSION "" IDENTICAL "" "" /end COMPU_METHOD
/begin COMPU_METHOD TestWord_037.CONVERSION "" IDENTICAL "" "" /end COMPU_METHOD
/begin COMPU_METHOD TestWord_038.CONVERSION "" IDENTICAL "" "" /end COMPU_METHOD
/begin COMPU_METHOD TestWord_039.CONVERSION "" IDENTICAL "" "" /end COMPU_METHOD
/begin COMPU_METHOD TestWord_040.CONVERSION "" IDENTICAL "" "" /end COMPU_METHOD
/begin COMPU_METHOD TestWord_041.CONVERSION "" IDENTICAL "" "" /end COMPU_METHOD
/begin COMPU_METHOD TestWord_042.CONVERSION "" IDENTICAL "" "" /end COMPU_METHOD
/begin COMPU_METHOD TestWord_043.CONVERSION "" IDENTICAL "" "" /end COMPU_METHOD
/begin COMPU_METHOD TestWord_044.CONVERSION "" IDENTICAL "" "" /end COMPU_METHOD
/begin COMPU_METHOD TestWord_046.CONVERSION "" IDENTICAL "" "" /end COMPU_METHOD
/begin COMPU_METHOD TestWord_048.CONVERSION "" IDENTICAL "" "" /end COMPU_METHOD
/begin COMPU_METHOD TestWord_050.CONVERSION "" IDENTICAL "" "" /end COMPU_METHOD
/begin COMPU_METHOD TestWord_051.CONVERSION "" IDENTICAL "" "" /end COMPU_METHOD
/begin COMPU_METHOD TestWord_052.CONVERSION "" IDENTICAL "" "" /end COMPU_METHOD
/begin COMPU_METHOD TestWord_053.CONVERSION "" IDENTICAL "" "" /end COMPU_METHOD
/begin COMPU_METHOD TestWord_054.CONVERSION "" IDENTICAL "" "" /end COMPU_METHOD
/begin COMPU_METHOD TestWord_055.CONVERSION "" IDENTICAL "" "" /end COMPU_METHOD
/begin COMPU_METHOD TestWord_058.CONVERSION "" IDENTICAL "" "" /end COMPU_METHOD
/begin COMPU_METHOD TestWord_060.CONVERSION "" IDENTICAL "" "" /end COMPU_METHOD
/begin COMPU_METHOD TestWord_062.CONVERSION "" IDENTICAL "" "" /end COMPU_METHOD
/begin COMPU_METHOD TestWord_065.CONVERSION "" IDENTICAL "" "" /end COMPU_METHOD
/begin COMPU_METHOD TestWord_068.CONVERSION "" IDENTICAL "" "" /end COMPU_METHOD
/begin COMPU_METHOD TestWord_069.CONVERSION "" IDENTICAL "" "" /end COMPU_METHOD
/begin COMPU_METHOD TestWord_070.CONVERSION "" IDENTICAL "" "" /end COMPU_METHOD
/begin COMPU_METHOD TestWord_071.CONVERSION "" IDENTICAL "" "" /end COMPU_METHOD
/begin COMPU_METHOD TestWord_072.CONVERSION "" IDENTICAL "" "" /end COMPU_METHOD
/begin COMPU_METHOD TestWord_074.CONVERSION "" IDENTICAL "" "" /end COMPU_METHOD
/begin COMPU_METHOD TestWord_075.CONVERSION "" IDENTICAL "" "" /end COMPU_METHOD
/begin COMPU_METHOD TestWord_076.CONVERSION "" IDENTICAL "" "" /end COMPU_METHOD
/begin COMPU_METHOD TestWord_077.CONVERSION "" IDENTICAL "" "" /end COMPU_METHOD
/begin COMPU_METHOD TestWord_078.CONVERSION "" IDENTICAL "" "" /end COMPU_METHOD
/begin COMPU_METHOD TestWord_080.CONVERSION "" IDENTICAL "" "" /end COMPU_METHOD
/begin COMPU_METHOD TestWord_081.CONVERSION "" IDENTICAL "" "" /end COMPU_METHOD
/begin COMPU_METHOD TestWord_082.CONVERSION "" IDENTICAL "" "" /end COMPU_METHOD
/begin COMPU_METHOD TestWord_083.CONVERSION "" IDENTICAL "" "" /end COMPU_METHOD
/begin COMPU_METHOD TestWord_084.CONVERSION "" IDENTICAL "" "" /end COMPU_METHOD
/begin COMPU_METHOD TestWord_085.CONVERSION "" IDENTICAL "" "" /end COMPU_METHOD
/begin COMPU_METHOD TestWord_088.CONVERSION "" IDENTICAL "" "" /end COMPU_METHOD
/begin COMPU_METHOD TestWord_089.CONVERSION "" IDENTICAL "" "" /end COMPU_METHOD
/begin COMPU_METHOD TestWord_090.CONVERSION "" IDENTICAL "" "" /end COMPU_METHOD
/begin COMPU_METHOD TestWord_091.CONVERSION "" IDENTICAL "" "" /end COMPU_METHOD
/begin COMPU_METHOD TestWord_092.CONVERSION "" IDENTICAL "" "" /end COMPU_METHOD
/begin COMPU_METHOD TestWord_093.CONVERSION "" IDENTICAL "" "" /end COMPU_METHOD
/begin COMPU_METHOD Triangle.CONVERSION "" IDENTICAL "%6.2f" "" /end COMPU_METHOD
/begin COMPU_METHOD wordCounter.CONVERSION "" IDENTICAL "%6.2f" "" /end COMPU_METHOD
/begin MEASUREMENT BitSlice "Testsignal: 4 Bit on a byte boundary" UWORD BitSlice.CONVERSION 0 0 0 15 BIT_MASK 0x3C0 ECU_ADDRESS 0x1BE05C FORMAT "%.3" SYMBOL_LINK "wordCounter" 0 /end MEASUREMENT
/begin MEASUREMENT BitSlice0 "Testsignal: 5 Bit" UWORD BitSlice0.CONVERSION 0 0 0 31 BIT_MASK 0x1F ECU_ADDRESS 0x1BE05C FORMAT "%.3" SYMBOL_LINK "wordCounter" 0 /end MEASUREMENT
/begin MEASUREMENT BitSlice1 "Testsignal: 5 Bit " UWORD BitSlice1.CONVERSION 0 0 0 31 BIT_MASK 0x3E0 ECU_ADDRESS 0x1BE05C FORMAT "%.3" SYMBOL_LINK "wordCounter" 0 /end MEASUREMENT
/begin MEASUREMENT BitSlice2 "Testsignal: 5 Bit " UWORD BitSlice2.CONVERSION 0 0 0 63 BIT_MASK 0xFC ECU_ADDRESS 0x1BE05D FORMAT "%.3" SYMBOL_LINK "wordCounter" 1 /end MEASUREMENT
/begin MEASUREMENT Counter_B4 "Single bit demo signal (bit from a byte shifting)" UBYTE HighLow 0 0 0 1 READ_WRITE BIT_MASK 0x10 ECU_ADDRESS 0x1BDCB3 FORMAT "%.3" SYMBOL_LINK "byteCounter" 0 /end MEASUREMENT
/begin MEASUREMENT Counter_B5 "Single bit demo signal (bit from a byte shifting)" UBYTE HighLow 0 0 0 1 READ_WRITE BIT_MASK 0x20 ECU_ADDRESS 0x1BDCB3 FORMAT "%.3" SYMBOL_LINK "byteCounter" 0 /end MEASUREMENT
/begin MEASUREMENT Counter_B6 "Single bit demo signal (bit from a byte shifting)" UBYTE HighLow 0 0 0 1 READ_WRITE BIT_MASK 0x40 ECU_ADDRESS 0x1BDCB3 FORMAT "%.3" SYMBOL_LINK "byteCounter" 0 /end MEASUREMENT
/begin MEASUREMENT Counter_B7 "Single bit demo signal (bit from a byte shifting)" UBYTE HighLow 0 0 0 1 READ_WRITE BIT_MASK 0x80 ECU_ADDRESS 0x1BDCB3 FORMAT "%.3" SYMBOL_LINK "byteCounter" 0 /end MEASUREMENT
/begin AXIS_PTS Curve1 "Curve used as axis" 0x1C07E4 NO_INPUT_QUANTITY SSV__UBYTE_S 0 Curve1.CONVERSION 8 0 255 DEPOSIT ABSOLUTE SYMBOL_LINK "curve1_8_uc" 0 FORMAT "%.3" /end AXIS_PTS
/begin AXIS_PTS Curve2 "Curve used as axis" 0x1C08EC NO_INPUT_QUANTITY CurveX8ub 0 Curve2.CONVERSION 8 0 255 DEPOSIT ABSOLUTE SYMBOL_LINK "curve2_8_uc" 0 FORMAT "%.3" /end AXIS_PTS
/begin AXIS_PTS Curve3 "Curve used as axis" 0x1C097C NO_INPUT_QUANTITY SSV__UBYTE_S 0 Curve3.CONVERSION 6 0 255 DEPOSIT ABSOLUTE SYMBOL_LINK "curve3_8_uc" 0 FORMAT "%.3" /end AXIS_PTS
/begin CHARACTERISTIC FW1 "Testparameter" VALUE 0x1C00AB CurveVub 0 FW1.CONVERSION 0 255 FORMAT "%.3" SYMBOL_LINK "byte4" 0 /end CHARACTERISTIC
/begin CHARACTERISTIC KF1 "8*8 BYTE no axis" MAP 0x1C0550 __UBYTE_Z 0 Factor100 0 2.55
 /begin AXIS_DESCR FIX_AXIS NO_INPUT_QUANTITY KF1_X_AXIS.CONVERSION 8 0 7 READ_ONLY FORMAT "%.0" FIX_AXIS_PAR_DIST 0 1 8 /end AXIS_DESCR
 /begin AXIS_DESCR FIX_AXIS NO_INPUT_QUANTITY KF1_Y_AXIS.CONVERSION 8 0 7 READ_ONLY FORMAT "%.0" FIX_AXIS_PAR_DIST 0 1 8 /end AXIS_DESCR
 SYMBOL_LINK "map3_8_8_uc" 0 FORMAT "%.3" /end CHARACTERISTIC
/begin CHARACTERISTIC KF2 "8*8 BYTE shared axis Curve1/Curve1" MAP 0x1C00D0 __UBYTE_Z 0 KF2.CONVERSION 0 255
 /begin AXIS_DESCR COM_AXIS NO_INPUT_QUANTITY Curve1.CONVERSION 8 0 255 DEPOSIT ABSOLUTE FORMAT "%.3" AXIS_PTS_REF Curve1 /end AXIS_DESCR
 /begin AXIS_DESCR COM_AXIS NO_INPUT_QUANTITY Curve2.CONVERSION 8 0 255 DEPOSIT ABSOLUTE FORMAT "%.3" AXIS_PTS_REF Curve2 /end AXIS_DESCR
 SYMBOL_LINK "map1_8_8_uc" 0 FORMAT "%.3" /end CHARACTERISTIC
/begin CHARACTERISTIC KF3 "8*6 BYTE no axis" MAP 0x1C00D0 __UBYTE_Z 0 KF3.CONVERSION 0 255
 /begin AXIS_DESCR FIX_AXIS NO_INPUT_QUANTITY KF3_X_AXIS.CONVERSION 8 0 7 READ_ONLY FORMAT "%.0" FIX_AXIS_PAR_DIST 0 1 8 /end AXIS_DESCR
 /begin AXIS_DESCR FIX_AXIS NO_INPUT_QUANTITY KF3_Y_AXIS.CONVERSION 6 0 5 READ_ONLY FORMAT "%.0" FIX_AXIS_PAR_DIST 0 1 6 /end AXIS_DESCR
 SYMBOL_LINK "map1_8_8_uc" 0 FORMAT "%.3" /end CHARACTERISTIC
/begin CHARACTERISTIC KF4 "8*6 BYTE shared axis Curve1" MAP 0x1C00D0 __UBYTE_Z 0 KF4.CONVERSION 0 255
 /begin AXIS_DESCR COM_AXIS NO_INPUT_QUANTITY Curve1.CONVERSION 8 0 255 DEPOSIT ABSOLUTE FORMAT "%.3" AXIS_PTS_REF Curve1 /end AXIS_DESCR
 /begin AXIS_DESCR FIX_AXIS NO_INPUT_QUANTITY KF4_Y_AXIS.CONVERSION 6 0 5 READ_ONLY FORMAT "%.0" FIX_AXIS_PAR_DIST 0 1 6 /end AXIS_DESCR
 SYMBOL_LINK "map1_8_8_uc" 0 FORMAT "%.3" /end CHARACTERISTIC
/begin CHARACTERISTIC KF5 "8*6 BYTE memory layout MapX8Y6V86ub" MAP 0x1C0670 MapX8Y6V86ub 0 KF5.CONVERSION 0 255
 /begin AXIS_DESCR STD_AXIS NO_INPUT_QUANTITY KF5_X_AXIS.CONVERSION 8 0 255 DEPOSIT ABSOLUTE FORMAT "%.3" /end AXIS_DESCR
 /begin AXIS_DESCR STD_AXIS NO_INPUT_QUANTITY KF5_Y_AXIS.CONVERSION 6 0 255 DEPOSIT ABSOLUTE FORMAT "%.3" /end AXIS_DESCR
 SYMBOL_LINK "map_kf5" 0 FORMAT "%.3" /end CHARACTERISTIC
/begin CHARACTERISTIC KF6 "8*8 BYTE no axis" MAP 0x1C00D0 __UBYTE_Z 0 KF6.CONVERSION 0 255
 /begin AXIS_DESCR FIX_AXIS NO_INPUT_QUANTITY KF6_X_AXIS.CONVERSION 8 0 7 READ_ONLY FORMAT "%.0" FIX_AXIS_PAR_DIST 0 1 8 /end AXIS_DESCR
 /begin AXIS_DESCR FIX_AXIS NO_INPUT_QUANTITY KF6_Y_AXIS.CONVERSION 8 0 7 READ_ONLY FORMAT "%.0" FIX_AXIS_PAR_DIST 0 1 8 /end AXIS_DESCR
 SYMBOL_LINK "map1_8_8_uc" 0 FORMAT "%.3" /end CHARACTERISTIC
/begin CHARACTERISTIC KF7 "8*8 BYTE memory layout MapV86ub, shared axis Curve1/Curve1" MAP 0x1C04D0 MapV86ub 0 KF7.CONVERSION 0 255
 /begin AXIS_DESCR COM_AXIS NO_INPUT_QUANTITY Curve1.CONVERSION 8 0 255 DEPOSIT ABSOLUTE FORMAT "%.3" AXIS_PTS_REF Curve1 /end AXIS_DESCR
 /begin AXIS_DESCR COM_AXIS NO_INPUT_QUANTITY Curve2.CONVERSION 8 0 255 DEPOSIT ABSOLUTE FORMAT "%.3" AXIS_PTS_REF Curve2 /end AXIS_DESCR
 SYMBOL_LINK "map2_8_8_uc" 0 FORMAT "%.3" /end CHARACTERISTIC
/begin CHARACTERISTIC KF8 "8*6 BYTE memory layout MapV86ub, fixed axis " MAP 0x1C0550 MapV86ub 0 KF8_Conversion 0 10
 /begin AXIS_DESCR FIX_AXIS NO_INPUT_QUANTITY KF8_Conversion 8 0 25.5 READ_ONLY FORMAT "%.1" FIX_AXIS_PAR_DIST 0 2 8 /end AXIS_DESCR
 /begin AXIS_DESCR FIX_AXIS NO_INPUT_QUANTITY KF8_Y_AXIS.CONVERSION 6 0 25.5 READ_ONLY FORMAT "%.1" FIX_AXIS_PAR_DIST 0 5 6 /end AXIS_DESCR
 SYMBOL_LINK "map3_8_8_uc" 0 FORMAT "%.2" /end CHARACTERISTIC
/begin CHARACTERISTIC KL1 "16 BYTE curve" VAL_BLK 0x1C06F0 __UBYTE_Z 0 KL1.CONVERSION 0 255 MATRIX_DIM 16 SYMBOL_LINK "curve5_16_uc" 0 FORMAT "%.3" /end CHARACTERISTIC
/begin MEASUREMENT KL1Output "Value generated from curve KL1" UBYTE KL1Output.CONVERSION 0 0 0 255 ECU_ADDRESS 0x1BDDD2 FORMAT "%.3" SYMBOL_LINK "curveOutput" 0 /end MEASUREMENT
/begin CHARACTERISTIC KL2 "8 BYTE shared axis Curve2" CURVE 0x1C07E4 __UBYTE_Z 0 KL2.CONVERSION 0 255
 /begin AXIS_DESCR COM_AXIS NO_INPUT_QUANTITY Curve2.CONVERSION 8 0 255 DEPOSIT ABSOLUTE FORMAT "%.3" AXIS_PTS_REF Curve2 /end AXIS_DESCR
 SYMBOL_LINK "curve1_8_uc" 0 FORMAT "%.3" /end CHARACTERISTIC
/begin CHARACTERISTIC KL3 "8 BYTE CurveX8V8ub" CURVE 0x1C098C CurveX8V8ub 0 KL3.CONVERSION 0 255
 /begin AXIS_DESCR STD_AXIS NO_INPUT_QUANTITY KL3_X_AXIS.CONVERSION 8 0 255 DEPOSIT ABSOLUTE FORMAT "%.3" /end AXIS_DESCR
 SYMBOL_LINK "curve4_8_uc" 0 FORMAT "%.3" /end CHARACTERISTIC
/begin CHARACTERISTIC KL4 "8 BYTE CurveV8ub" VAL_BLK 0x1C098C CurveV8ub 0 KL4.CONVERSION 0 255 MATRIX_DIM 8 SYMBOL_LINK "curve4_8_uc" 0 FORMAT "%.3" /end CHARACTERISTIC
/begin CHARACTERISTIC KL5 "8 BYTE CurveV8ub shared axis Curve2" CURVE 0x1C07E4 CurveV8ub 0 KL5.CONVERSION 0 255
 /begin AXIS_DESCR COM_AXIS NO_INPUT_QUANTITY Curve2.CONVERSION 8 0 255 DEPOSIT ABSOLUTE FORMAT "%.3" AXIS_PTS_REF Curve2 /end AXIS_DESCR
 SYMBOL_LINK "curve1_8_uc" 0 FORMAT "%.3" /end CHARACTERISTIC
/begin CHARACTERISTIC KL6 "8 BYTE CurveV8ub fixed axis" CURVE 0x1C097C CurveV8ub 0 KL6.CONVERSION 0 255
 /begin AXIS_DESCR FIX_AXIS NO_INPUT_QUANTITY KL6_X_AXIS.CONVERSION 8 0 255 READ_ONLY FORMAT "%.3" FIX_AXIS_PAR_DIST 0 8 8 /end AXIS_DESCR
 SYMBOL_LINK "curve3_8_uc" 0 FORMAT "%.3" /end CHARACTERISTIC
/begin CHARACTERISTIC KL7 "" CURVE 0x1C0770 CurveX8V8ubAlternate 0 Factor100 0 500
 /begin AXIS_DESCR STD_AXIS NO_INPUT_QUANTITY Factor100 8 0 655.35 DEPOSIT ABSOLUTE FORMAT "%.3" /end AXIS_DESCR
 SYMBOL_LINK "curve5_16_uc4" 0 FORMAT "%.3" /end CHARACTERISTIC
/begin CHARACTERISTIC KL8 "" MAP 0x1C0770 __UBYTE_Z 0 Factor100 0 655.35
 /begin AXIS_DESCR FIX_AXIS NO_INPUT_QUANTITY KL8_X_AXIS.CONVERSION 2 0 1 READ_ONLY FORMAT "%.0" FIX_AXIS_PAR_DIST 0 1 2 /end AXIS_DESCR
 /begin AXIS_DESCR FIX_AXIS NO_INPUT_QUANTITY KL8_Y_AXIS.CONVERSION 8 0 7 READ_ONLY FORMAT "%.0" FIX_AXIS_PAR_DIST 0 1 8 /end AXIS_DESCR
 SYMBOL_LINK "curve5_16_uc4" 0 FORMAT "%.3" /end CHARACTERISTIC
/begin MEASUREMENT PWM "Pulse width signal from PWM_level and Triangle" UBYTE HighLow 0 0 0 255 ECU_ADDRESS 0x1BDDDF FORMAT "%.0" SYMBOL_LINK "bytePWM" 0 /end MEASUREMENT
/begin MEASUREMENT PWMFiltered "Low pass filtered PWM signal" UBYTE PWMFiltered.CONVERSION 0 0 0 255 ECU_ADDRESS 0x1BDDE2 FORMAT "%.3" SYMBOL_LINK "bytePWMFiltered" 0 /end MEASUREMENT
/begin CHARACTERISTIC PWM_Level "" VALUE 0x1C00A2 __SBYTE_S 0 PWM_Level.CONVERSION -50 50 FORMAT "%.0" SYMBOL_LINK "sbytePWMLevel" 0 /end CHARACTERISTIC
/begin MEASUREMENT ShiftByte "" UBYTE ShiftByte.CONVERSION 0 0 0 255 ECU_ADDRESS 0x1BDCBF FORMAT "%.3" SYMBOL_LINK "byteShift" 0 /end MEASUREMENT
/begin MEASUREMENT Shifter_B0 "Single bit demo signal (bit from a byte shifting)" UBYTE HighLow 0 0 0 1 READ_WRITE BIT_MASK 0x1 ECU_ADDRESS 0x1BDCBF FORMAT "%.3" SYMBOL_LINK "byteShift" 0 /end MEASUREMENT
/begin MEASUREMENT Shifter_B1 "Single bit demo signal (bit from a byte shifting)" UBYTE HighLow 0 0 0 1 READ_WRITE BIT_MASK 0x2 ECU_ADDRESS 0x1BDCBF FORMAT "%.3" SYMBOL_LINK "byteShift" 0 /end MEASUREMENT
/begin MEASUREMENT Shifter_B2 "Single bit demo signal (bit from a byte shifting)" UBYTE HighLow 0 0 0 1 READ_WRITE BIT_MASK 0x4 ECU_ADDRESS 0x1BDCBF FORMAT "%.3" SYMBOL_LINK "byteShift" 0 /end MEASUREMENT
/begin MEASUREMENT Shifter_B3 "Single bit demo signal (bit from a byte shifting)" UBYTE HighLow 0 0 0 1 READ_WRITE BIT_MASK 0x8 ECU_ADDRESS 0x1BDCBF FORMAT "%.3" SYMBOL_LINK "byteShift" 0 /end MEASUREMENT
/begin CHARACTERISTIC Simulator_concept "" VALUE 0x1C6000 __SLONG_S 0 Simulator_concept.CONVERSION -2147483648 2147483647 FORMAT "%.15" /end CHARACTERISTIC
/begin MEASUREMENT TestByte_000 "" UBYTE TestByte_000.CONVERSION 0 0 0 255 ECU_ADDRESS 0x1BE11C FORMAT "%.0" SYMBOL_LINK "testByte000" 4 /end MEASUREMENT
/begin MEASUREMENT TestByte_015 "" UBYTE TestByte_015.CONVERSION 0 0 0 255 ECU_ADDRESS 0x1BE158 FORMAT "%.0" SYMBOL_LINK "testByte000" 64 /end MEASUREMENT
/begin MEASUREMENT TestByte_016 "" UBYTE TestByte_016.CONVERSION 0 0 0 255 ECU_ADDRESS 0x1BE15C FORMAT "%.0" SYMBOL_LINK "testByte000" 68 /end MEASUREMENT
/begin MEASUREMENT TestByte_023 "" UBYTE TestByte_023.CONVERSION 0 0 0 255 ECU_ADDRESS 0x1BE178 FORMAT "%.0" SYMBOL_LINK "testByte000" 96 /end MEASUREMENT
/begin MEASUREMENT TestByte_024 "" UBYTE TestByte_024.CONVERSION 0 0 0 255 ECU_ADDRESS 0x1BE17C FORMAT "%.0" SYMBOL_LINK "testByte000" 100 /end MEASUREMENT
/begin MEASUREMENT TestByte_034 "" UBYTE TestByte_034.CONVERSION 0 0 0 255 ECU_ADDRESS 0x1BE1A4 FORMAT "%.0" SYMBOL_LINK "testByte000" 140 /end MEASUREMENT
/begin MEASUREMENT TestByte_059 "" UBYTE TestByte_059.CONVERSION 0 0 0 255 ECU_ADDRESS 0x1BE208 FORMAT "%.0" SYMBOL_LINK "testByte000" 240 /end MEASUREMENT
/begin MEASUREMENT TestByte_061 "" UBYTE TestByte_061.CONVERSION 0 0 0 255 ECU_ADDRESS 0x1BE210 FORMAT "%.0" SYMBOL_LINK "testByte000" 248 /end MEASUREMENT
/begin MEASUREMENT TestByte_063 "" UBYTE TestByte_063.CONVERSION 0 0 0 255 ECU_ADDRESS 0x1BE218 FORMAT "%.0" SYMBOL_LINK "testByte000" 256 /end MEASUREMENT
/begin MEASUREMENT TestByte_064 "" UBYTE TestByte_064.CONVERSION 0 0 0 255 ECU_ADDRESS 0x1BE21C FORMAT "%.0" SYMBOL_LINK "testByte000" 260 /end MEASUREMENT
/begin MEASUREMENT TestByte_097 "" UBYTE TestByte_097.CONVERSION 0 0 0 255 ECU_ADDRESS 0x1BE2A0 FORMAT "%.0" SYMBOL_LINK "testByte000" 392 /end MEASUREMENT
/begin MEASUREMENT TestByte_107 "" UBYTE TestByte_107.CONVERSION 0 0 0 255 ECU_ADDRESS 0x1BE2C8 FORMAT "%.0" SYMBOL_LINK "testByte000" 432 /end MEASUREMENT
/begin MEASUREMENT TestByte_131 "" UBYTE TestByte_131.CONVERSION 0 0 0 255 ECU_ADDRESS 0x1BE328 FORMAT "%.0" SYMBOL_LINK "testByte000" 528 /end MEASUREMENT
/begin MEASUREMENT TestByte_156 "" UBYTE TestByte_156.CONVERSION 0 0 0 255 ECU_ADDRESS 0x1BE38C FORMAT "%.0" SYMBOL_LINK "testByte000" 628 /end MEASUREMENT
/begin MEASUREMENT TestByte_159 "" UBYTE TestByte_159.CONVERSION 0 0 0 255 ECU_ADDRESS 0x1BE398 FORMAT "%.0" SYMBOL_LINK "testByte000" 640 /end MEASUREMENT
/begin MEASUREMENT TestByte_182 "" UBYTE TestByte_182.CONVERSION 0 0 0 255 ECU_ADDRESS 0x1BE3F4 FORMAT "%.0" SYMBOL_LINK "testByte000" 732 /end MEASUREMENT
/begin MEASUREMENT TestByte_183 "" UBYTE TestByte_183.CONVERSION 0 0 0 255 ECU_ADDRESS 0x1BE3F8 FORMAT "%.0" SYMBOL_LINK "testByte000" 736 /end MEASUREMENT
/begin MEASUREMENT TestByte_189 "" UBYTE TestByte_189.CONVERSION 0 0 0 255 ECU_ADDRESS 0x1BE410 FORMAT "%.0" SYMBOL_LINK "testByte000" 760 /end MEASUREMENT
/begin MEASUREMENT TestByte_195 "" UBYTE TestByte_195.CONVERSION 0 0 0 255 ECU_ADDRESS 0x1BE428 FORMAT "%.0" SYMBOL_LINK "testByte000" 784 /end MEASUREMENT
/begin MEASUREMENT TestByte_216 "" UBYTE TestByte_216.CONVERSION 0 0 0 255 ECU_ADDRESS 0x1BE47C FORMAT "%.0" SYMBOL_LINK "testByte000" 868 /end MEASUREMENT
/begin MEASUREMENT TestByte_218 "" UBYTE TestByte_218.CONVERSION 0 0 0 255 ECU_ADDRESS 0x1BE484 FORMAT "%.0" SYMBOL_LINK "testByte000" 876 /end MEASUREMENT
/begin MEASUREMENT TestByte_221 "" UBYTE TestByte_221.CONVERSION 0 0 0 255 ECU_ADDRESS 0x1BE490 FORMAT "%.0" SYMBOL_LINK "testByte000" 888 /end MEASUREMENT
/begin MEASUREMENT TestByte_251 "" UBYTE TestByte_251.CONVERSION 0 0 0 255 ECU_ADDRESS 0x1BE508 FORMAT "%.0" SYMBOL_LINK "testByte000" 1008 /end MEASUREMENT
/begin MEASUREMENT TestByte_263 "" UBYTE TestByte_263.CONVERSION 0 0 0 255 ECU_ADDRESS 0x1BE538 FORMAT "%.0" SYMBOL_LINK "testByte000" 1056 /end MEASUREMENT
/begin MEASUREMENT TestByte_276 "" UBYTE TestByte_276.CONVERSION 0 0 0 255 ECU_ADDRESS 0x1BE56C FORMAT "%.0" SYMBOL_LINK "testByte000" 1108 /end MEASUREMENT
/begin MEASUREMENT TestByte_277 "" UBYTE TestByte_277.CONVERSION 0 0 0 255 ECU_ADDRESS 0x1BE570 FORMAT "%.0" SYMBOL_LINK "testByte000" 1112 /end MEASUREMENT
/begin MEASUREMENT TestByte_297 "" UBYTE TestByte_297.CONVERSION 0 0 0 255 ECU_ADDRESS 0x1BE5C0 FORMAT "%.0" SYMBOL_LINK "testByte000" 1192 /end MEASUREMENT
/begin MEASUREMENT TestByte_302 "" UBYTE TestByte_302.CONVERSION 0 0 0 255 ECU_ADDRESS 0x1BE5D4 FORMAT "%.0" SYMBOL_LINK "testByte000" 1212 /end MEASUREMENT
/begin MEASUREMENT TestByte_324 "" UBYTE TestByte_324.CONVERSION 0 0 0 255 ECU_ADDRESS 0x1BE62C FORMAT "%.0" SYMBOL_LINK "testByte000" 1300 /end MEASUREMENT
/begin MEASUREMENT TestByte_344 "" UBYTE TestByte_344.CONVERSION 0 0 0 255 ECU_ADDRESS 0x1BE67C FORMAT "%.0" SYMBOL_LINK "testByte000" 1380 /end MEASUREMENT
/begin MEASUREMENT TestByte_346 "" UBYTE TestByte_346.CONVERSION 0 0 0 255 ECU_ADDRESS 0x1BE684 FORMAT "%.0" SYMBOL_LINK "testByte000" 1388 /end MEASUREMENT
/begin MEASUREMENT TestByte_354 "" UBYTE TestByte_354.CONVERSION 0 0 0 255 ECU_ADDRESS 0x1BE6A4 FORMAT "%.0" SYMBOL_LINK "testByte000" 1420 /end MEASUREMENT
/begin MEASUREMENT TestByte_359 "" UBYTE TestByte_359.CONVERSION 0 0 0 255 ECU_ADDRESS 0x1BE6B8 FORMAT "%.0" SYMBOL_LINK "testByte000" 1440 /end MEASUREMENT
/begin MEASUREMENT TestByte_378 "" UBYTE TestByte_378.CONVERSION 0 0 0 255 ECU_ADDRESS 0x1BE704 FORMAT "%.0" SYMBOL_LINK "testByte000" 1516 /end MEASUREMENT
/begin MEASUREMENT TestByte_402 "" UBYTE TestByte_402.CONVERSION 0 0 0 255 ECU_ADDRESS 0x1BE764 FORMAT "%.0" SYMBOL_LINK "testByte000" 1612 /end MEASUREMENT
/begin MEASUREMENT TestByte_403 "" UBYTE TestByte_403.CONVERSION 0 0 0 255 ECU_ADDRESS 0x1BE768 FORMAT "%.0" SYMBOL_LINK "testByte000" 1616 /end MEASUREMENT
/begin MEASUREMENT TestByte_406 "" UBYTE TestByte_406.CONVERSION 0 0 0 255 ECU_ADDRESS 0x1BE774 FORMAT "%.0" SYMBOL_LINK "testByte000" 1628 /end MEASUREMENT
/begin MEASUREMENT TestByte_413 "" UBYTE TestByte_413.CONVERSION 0 0 0 255 ECU_ADDRESS 0x1BE790 FORMAT "%.0" SYMBOL_LINK "testByte000" 1656 /end MEASUREMENT
/begin MEASUREMENT TestByte_414 "" UBYTE TestByte_414.CONVERSION 0 0 0 255 ECU_ADDRESS 0x1BE794 FORMAT "%.0" SYMBOL_LINK "testByte000" 1660 /end MEASUREMENT
/begin MEASUREMENT TestByte_415 "" UBYTE TestByte_415.CONVERSION 0 0 0 255 ECU_ADDRESS 0x1BE798 FORMAT "%.0" SYMBOL_LINK "testByte000" 1664 /end MEASUREMENT
/begin MEASUREMENT TestByte_427 "" UBYTE TestByte_427.CONVERSION 0 0 0 255 ECU_ADDRESS 0x1BE7C8 FORMAT "%.0" SYMBOL_LINK "testByte000" 1712 /end MEASUREMENT
/begin MEASUREMENT TestByte_438 "" UBYTE TestByte_438.CONVERSION 0 0 0 255 ECU_ADDRESS 0x1BE7F4 FORMAT "%.0" SYMBOL_LINK "testByte000" 1756 /end MEASUREMENT
/begin MEASUREMENT TestByte_446 "" UBYTE TestByte_446.CONVERSION 0 0 0 255 ECU_ADDRESS 0x1BE814 FORMAT "%.0" SYMBOL_LINK "testByte000" 1788 /end MEASUREMENT
/begin MEASUREMENT TestByte_448 "" UBYTE TestByte_448.CONVERSION 0 0 0 255 ECU_ADDRESS 0x1BE81C FORMAT "%.0" SYMBOL_LINK "testByte000" 1796 /end MEASUREMENT
/begin MEASUREMENT TestByte_451 "" UBYTE TestByte_451.CONVERSION 0 0 0 255 ECU_ADDRESS 0x1BE828 FORMAT "%.0" SYMBOL_LINK "testByte000" 1808 /end MEASUREMENT
/begin MEASUREMENT TestByte_462 "" UBYTE TestByte_462.CONVERSION 0 0 0 255 ECU_ADDRESS 0x1BE854 FORMAT "%.0" SYMBOL_LINK "testByte000" 1852 /end MEASUREMENT
/begin MEASUREMENT TestByte_466 "" UBYTE TestByte_466.CONVERSION 0 0 0 255 ECU_ADDRESS 0x1BE864 FORMAT "%.0" SYMBOL_LINK "testByte000" 1868 /end MEASUREMENT
/begin MEASUREMENT TestByte_469 "" UBYTE TestByte_469.CONVERSION 0 0 0 255 ECU_ADDRESS 0x1BE870 FORMAT "%.0" SYMBOL_LINK "testByte000" 1880 /end MEASUREMENT
/begin MEASUREMENT TestByte_486 "" UBYTE TestByte_486.CONVERSION 0 0 0 255 ECU_ADDRESS 0x1BE8B4 FORMAT "%.0" SYMBOL_LINK "testByte000" 1948 /end MEASUREMENT
/begin MEASUREMENT TestByte_494 "" UBYTE TestByte_494.CONVERSION 0 0 0 255 ECU_ADDRESS 0x1BE8D4 FORMAT "%.0" SYMBOL_LINK "testByte000" 1980 /end MEASUREMENT
/begin MEASUREMENT TestByte_500 "" UBYTE TestByte_500.CONVERSION 0 0 0 255 ECU_ADDRESS 0x1BE8EC FORMAT "%.0" SYMBOL_LINK "testByte000" 2004 /end MEASUREMENT
/begin MEASUREMENT TestByte_527 "" UBYTE TestByte_527.CONVERSION 0 0 0 255 ECU_ADDRESS 0x1BE958 FORMAT "%.0" SYMBOL_LINK "testByte000" 2112 /end MEASUREMENT
/begin MEASUREMENT TestByte_530 "" UBYTE TestByte_530.CONVERSION 0 0 0 255 ECU_ADDRESS 0x1BE964 FORMAT "%.0" SYMBOL_LINK "testByte000" 2124 /end MEASUREMENT
/begin MEASUREMENT TestByte_533 "" UBYTE TestByte_533.CONVERSION 0 0 0 255 ECU_ADDRESS 0x1BE970 FORMAT "%.0" SYMBOL_LINK "testByte000" 2136 /end MEASUREMENT
/begin MEASUREMENT TestByte_556 "" UBYTE TestByte_556.CONVERSION 0 0 0 255 ECU_ADDRESS 0x1BE9CC FORMAT "%.0" SYMBOL_LINK "testByte000" 2228 /end MEASUREMENT
/begin MEASUREMENT TestByte_589 "" UBYTE TestByte_589.CONVERSION 0 0 0 255 ECU_ADDRESS 0x1BEA50 FORMAT "%.0" SYMBOL_LINK "testByte000" 2360 /end MEASUREMENT
/begin MEASUREMENT TestByte_590 "" UBYTE TestByte_590.CONVERSION 0 0 0 255 ECU_ADDRESS 0x1BEA54 FORMAT "%.0" SYMBOL_LINK "testByte000" 2364 /end MEASUREMENT
/begin MEASUREMENT TestByte_591 "" UBYTE TestByte_591.CONVERSION 0 0 0 255 ECU_ADDRESS 0x1BEA58 FORMAT "%.0" SYMBOL_LINK "testByte000" 2368 /end MEASUREMENT
/begin MEASUREMENT TestByte_592 "" UBYTE TestByte_592.CONVERSION 0 0 0 255 ECU_ADDRESS 0x1BEA5C FORMAT "%.0" SYMBOL_LINK "testByte000" 2372 /end MEASUREMENT
/begin MEASUREMENT TestByte_598 "" UBYTE TestByte_598.CONVERSION 0 0 0 255 ECU_ADDRESS 0x1BEA74 FORMAT "%.0" SYMBOL_LINK "testByte000" 2396 /end MEASUREMENT
/begin MEASUREMENT TestByte_606 "" UBYTE TestByte_606.CONVERSION 0 0 0 255 ECU_ADDRESS 0x1BEA94 FORMAT "%.0" SYMBOL_LINK "testByte000" 2428 /end MEASUREMENT
/begin MEASUREMENT TestByte_608 "" UBYTE TestByte_608.CONVERSION 0 0 0 255 ECU_ADDRESS 0x1BEA9C FORMAT "%.0" SYMBOL_LINK "testByte000" 2436 /end MEASUREMENT
/begin MEASUREMENT TestByte_618 "" UBYTE TestByte_618.CONVERSION 0 0 0 255 ECU_ADDRESS 0x1BEAC4 FORMAT "%.0" SYMBOL_LINK "testByte000" 2476 /end MEASUREMENT
/begin MEASUREMENT TestByte_621 "" UBYTE TestByte_621.CONVERSION 0 0 0 255 ECU_ADDRESS 0x1BEAD0 FORMAT "%.0" SYMBOL_LINK "testByte000" 2488 /end MEASUREMENT
/begin MEASUREMENT TestByte_627 "" UBYTE TestByte_627.CONVERSION 0 0 0 255 ECU_ADDRESS 0x1BEAE8 FORMAT "%.0" SYMBOL_LINK "testByte000" 2512 /end MEASUREMENT
/begin MEASUREMENT TestByte_638 "" UBYTE TestByte_638.CONVERSION 0 0 0 255 ECU_ADDRESS 0x1BEB14 FORMAT "%.0" SYMBOL_LINK "testByte000" 2556 /end MEASUREMENT
/begin MEASUREMENT TestByte_644 "" UBYTE TestByte_644.CONVERSION 0 0 0 255 ECU_ADDRESS 0x1BEB2C FORMAT "%.0" SYMBOL_LINK "testByte000" 2580 /end MEASUREMENT
/begin MEASUREMENT TestByte_647 "" UBYTE TestByte_647.CONVERSION 0 0 0 255 ECU_ADDRESS 0x1BEB38 FORMAT "%.0" SYMBOL_LINK "testByte000" 2592 /end MEASUREMENT
/begin MEASUREMENT TestByte_648 "" UBYTE TestByte_648.CONVERSION 0 0 0 255 ECU_ADDRESS 0x1BEB3C FORMAT "%.0" SYMBOL_LINK "testByte000" 2596 /end MEASUREMENT
/begin MEASUREMENT TestByte_659 "" UBYTE TestByte_659.CONVERSION 0 0 0 255 ECU_ADDRESS 0x1BEB68 FORMAT "%.0" SYMBOL_LINK "testByte000" 2640 /end MEASUREMENT
/begin MEASUREMENT TestByte_668 "" UBYTE TestByte_668.CONVERSION 0 0 0 255 ECU_ADDRESS 0x1BEB8C FORMAT "%.0" SYMBOL_LINK "testByte000" 2676 /end MEASUREMENT
/begin MEASUREMENT TestByte_700 "" UBYTE TestByte_700.CONVERSION 0 0 0 255 ECU_ADDRESS 0x1BEC0C FORMAT "%.0" SYMBOL_LINK "testByte000" 2804 /end MEASUREMENT
/begin MEASUREMENT TestByte_711 "" UBYTE TestByte_711.CONVERSION 0 0 0 255 ECU_ADDRESS 0x1BEC38 FORMAT "%.0" SYMBOL_LINK "testByte000" 2848 /end MEASUREMENT
/begin MEASUREMENT TestByte_715 "" UBYTE TestByte_715.CONVERSION 0 0 0 255 ECU_ADDRESS 0x1BEC48 FORMAT "%.0" SYMBOL_LINK "testByte000" 2864 /end MEASUREMENT
/begin MEASUREMENT TestByte_728 "" UBYTE TestByte_728.CONVERSION 0 0 0 255 ECU_ADDRESS 0x1BEC7C FORMAT "%.0" SYMBOL_LINK "testByte000" 2916 /end MEASUREMENT
/begin MEASUREMENT TestByte_731 "" UBYTE TestByte_731.CONVERSION 0 0 0 255 ECU_ADDRESS 0x1BEC88 FORMAT "%.0" SYMBOL_LINK "testByte000" 2928 /end MEASUREMENT
/begin MEASUREMENT TestByte_732 "" UBYTE TestByte_732.CONVERSION 0 0 0 255 ECU_ADDRESS 0x1BEC8C FORMAT "%.0" SYMBOL_LINK "testByte000" 2932 /end MEASUREMENT
/begin MEASUREMENT TestByte_738 "" UBYTE TestByte_738.CONVERSION 0 0 0 255 ECU_ADDRESS 0x1BECA4 FORMAT "%.0" SYMBOL_LINK "testByte000" 2956 /end MEASUREMENT
/begin MEASUREMENT TestByte_746 "" UBYTE TestByte_746.CONVERSION 0 0 0 255 ECU_ADDRESS 0x1BECC4 FORMAT "%.0" SYMBOL_LINK "testByte000" 2988 /end MEASUREMENT
/begin MEASUREMENT TestByte_752 "" UBYTE TestByte_752.CONVERSION 0 0 0 255 ECU_ADDRESS 0x1BECDC FORMAT "%.0" SYMBOL_LINK "testByte000" 3012 /end MEASUREMENT
/begin MEASUREMENT TestByte_774 "" UBYTE TestByte_774.CONVERSION 0 0 0 255 ECU_ADDRESS 0x1BED34 FORMAT "%.0" SYMBOL_LINK "testByte000" 3100 /end MEASUREMENT
/begin MEASUREMENT TestByte_777 "" UBYTE TestByte_777.CONVERSION 0 0 0 255 ECU_ADDRESS 0x1BED40 FORMAT "%.0" SYMBOL_LINK "testByte000" 3112 /end MEASUREMENT
/begin MEASUREMENT TestByte_778 "" UBYTE TestByte_778.CONVERSION 0 0 0 255 ECU_ADDRESS 0x1BED44 FORMAT "%.0" SYMBOL_LINK "testByte000" 3116 /end MEASUREMENT
/begin MEASUREMENT TestByte_784 "" UBYTE TestByte_784.CONVERSION 0 0 0 255 ECU_ADDRESS 0x1BED5C FORMAT "%.0" SYMBOL_LINK "testByte000" 3140 /end MEASUREMENT
/begin MEASUREMENT TestByte_786 "" UBYTE TestByte_786.CONVERSION 0 0 0 255 ECU_ADDRESS 0x1BED64 FORMAT "%.0" SYMBOL_LINK "testByte000" 3148 /end MEASUREMENT
/begin MEASUREMENT TestByte_789 "" UBYTE TestByte_789.CONVERSION 0 0 0 255 ECU_ADDRESS 0x1BED70 FORMAT "%.0" SYMBOL_LINK "testByte000" 3160 /end MEASUREMENT
/begin MEASUREMENT TestByte_793 "" UBYTE TestByte_793.CONVERSION 0 0 0 255 ECU_ADDRESS 0x1BED80 FORMAT "%.0" SYMBOL_LINK "testByte000" 3176 /end MEASUREMENT
/begin MEASUREMENT TestByte_798 "" UBYTE TestByte_798.CONVERSION 0 0 0 255 ECU_ADDRESS 0x1BED94 FORMAT "%.0" SYMBOL_LINK "testByte000" 3196 /end MEASUREMENT
/begin MEASUREMENT TestByte_855 "" UBYTE TestByte_855.CONVERSION 0 0 0 255 ECU_ADDRESS 0x1BEE78 FORMAT "%.0" SYMBOL_LINK "testByte000" 3424 /end MEASUREMENT
/begin MEASUREMENT TestByte_857 "" UBYTE TestByte_857.CONVERSION 0 0 0 255 ECU_ADDRESS 0x1BEE80 FORMAT "%.0" SYMBOL_LINK "testByte000" 3432 /end MEASUREMENT
/begin MEASUREMENT TestByte_861 "" UBYTE TestByte_861.CONVERSION 0 0 0 255 ECU_ADDRESS 0x1BEE90 FORMAT "%.0" SYMBOL_LINK "testByte000" 3448 /end MEASUREMENT
/begin MEASUREMENT TestByte_865 "" UBYTE TestByte_865.CONVERSION 0 0 0 255 ECU_ADDRESS 0x1BEEA0 FORMAT "%.0" SYMBOL_LINK "testByte000" 3464 /end MEASUREMENT
/begin MEASUREMENT TestByte_880 "" UBYTE TestByte_880.CONVERSION 0 0 0 255 ECU_ADDRESS 0x1BEEDC FORMAT "%.0" SYMBOL_LINK "testByte000" 3524 /end MEASUREMENT
/begin MEASUREMENT TestByte_902 "" UBYTE TestByte_902.CONVERSION 0 0 0 255 ECU_ADDRESS 0x1BEF34 FORMAT "%.0" SYMBOL_LINK "testByte000" 3612 /end MEASUREMENT
/begin MEASUREMENT TestByte_905 "" UBYTE TestByte_905.CONVERSION 0 0 0 255 ECU_ADDRESS 0x1BEF40 FORMAT "%.0" SYMBOL_LINK "testByte000" 3624 /end MEASUREMENT
/begin MEASUREMENT TestByte_934 "" UBYTE TestByte_934.CONVERSION 0 0 0 255 ECU_ADDRESS 0x1BEFB4 FORMAT "%.0" SYMBOL_LINK "testByte000" 3740 /end MEASUREMENT
/begin MEASUREMENT TestByte_938 "" UBYTE TestByte_938.CONVERSION 0 0 0 255 ECU_ADDRESS 0x1BEFC4 FORMAT "%.0" SYMBOL_LINK "testByte000" 3756 /end MEASUREMENT
/begin MEASUREMENT TestByte_947 "" UBYTE TestByte_947.CONVERSION 0 0 0 255 ECU_ADDRESS 0x1BEFE8 FORMAT "%.0" SYMBOL_LINK "testByte000" 3792 /end MEASUREMENT
/begin MEASUREMENT TestByte_951 "" UBYTE TestByte_951.CONVERSION 0 0 0 255 ECU_ADDRESS 0x1BEFF8 FORMAT "%.0" SYMBOL_LINK "testByte000" 3808 /end MEASUREMENT
/begin MEASUREMENT TestByte_961 "" UBYTE TestByte_961.CONVERSION 0 0 0 255 ECU_ADDRESS 0x1BF020 FORMAT "%.0" SYMBOL_LINK "testByte000" 3848 /end MEASUREMENT
/begin MEASUREMENT TestByte_965 "" UBYTE TestByte_965.CONVERSION 0 0 0 255 ECU_ADDRESS 0x1BF030 FORMAT "%.0" SYMBOL_LINK "testByte000" 3864 /end MEASUREMENT
/begin MEASUREMENT TestByte_974 "" UBYTE TestByte_974.CONVERSION 0 0 0 255 ECU_ADDRESS 0x1BF054 FORMAT "%.0" SYMBOL_LINK "testByte000" 3900 /end MEASUREMENT
/begin MEASUREMENT TestByte_976 "" UBYTE TestByte_976.CONVERSION 0 0 0 255 ECU_ADDRESS 0x1BF05C FORMAT "%.0" SYMBOL_LINK "testByte000" 3908 /end MEASUREMENT
/begin MEASUREMENT TestByte_981 "" UBYTE TestByte_981.CONVERSION 0 0 0 255 ECU_ADDRESS 0x1BF070 FORMAT "%.0" SYMBOL_LINK "testByte000" 3928 /end MEASUREMENT
/begin MEASUREMENT TestByte_983 "" UBYTE TestByte_983.CONVERSION 0 0 0 255 ECU_ADDRESS 0x1BF078 FORMAT "%.0" SYMBOL_LINK "testByte000" 3936 /end MEASUREMENT
/begin MEASUREMENT TestByte_993 "" UBYTE TestByte_993.CONVERSION 0 0 0 255 ECU_ADDRESS 0x1BF0A0 FORMAT "%.0" SYMBOL_LINK "testByte000" 3976 /end MEASUREMENT
/begin MEASUREMENT TestDWord_002 "" ULONG TestDWord_002.CONVERSION 0 0 0 255 ECU_ADDRESS 0x1BE124 FORMAT "%.0" SYMBOL_LINK "testByte000" 12 /end MEASUREMENT
/begin MEASUREMENT TestDWord_010 "" ULONG TestDWord_010.CONVERSION 0 0 0 255 ECU_ADDRESS 0x1BE144 FORMAT "%.0" SYMBOL_LINK "testByte000" 44 /end MEASUREMENT
/begin MEASUREMENT TestDWord_018 "" ULONG TestDWord_018.CONVERSION 0 0 0 255 ECU_ADDRESS 0x1BE164 FORMAT "%.0" SYMBOL_LINK "testByte000" 76 /end MEASUREMENT
/begin MEASUREMENT TestDWord_019 "" ULONG TestDWord_019.CONVERSION 0 0 0 255 ECU_ADDRESS 0x1BE168 FORMAT "%.0" SYMBOL_LINK "testByte000" 80 /end MEASUREMENT
/begin MEASUREMENT TestDWord_022 "" ULONG TestDWord_022.CONVERSION 0 0 0 255 ECU_ADDRESS 0x1BE174 FORMAT "%.0" SYMBOL_LINK "testByte000" 92 /end MEASUREMENT
/begin MEASUREMENT TestDWord_030 "" ULONG TestDWord_030.CONVERSION 0 0 0 255 ECU_ADDRESS 0x1BE194 FORMAT "%.0" SYMBOL_LINK "testByte000" 124 /end MEASUREMENT
/begin MEASUREMENT TestDWord_045 "" ULONG TestDWord_045.CONVERSION 0 0 0 255 ECU_ADDRESS 0x1BE1D0 FORMAT "%.0" SYMBOL_LINK "testByte000" 184 /end MEASUREMENT
/begin MEASUREMENT TestDWord_047 "" ULONG TestDWord_047.CONVERSION 0 0 0 255 ECU_ADDRESS 0x1BE1D8 FORMAT "%.0" SYMBOL_LINK "testByte000" 192 /end MEASUREMENT
/begin MEASUREMENT TestDWord_049 "" ULONG TestDWord_049.CONVERSION 0 0 0 255 ECU_ADDRESS 0x1BE1E0 FORMAT "%.0" SYMBOL_LINK "testByte000" 200 /end MEASUREMENT
/begin MEASUREMENT TestDWord_056 "" ULONG TestDWord_056.CONVERSION 0 0 0 255 ECU_ADDRESS 0x1BE1FC FORMAT "%.0" SYMBOL_LINK "testByte000" 228 /end MEASUREMENT
/begin MEASUREMENT TestDWord_057 "" ULONG TestDWord_057.CONVERSION 0 0 0 255 ECU_ADDRESS 0x1BE200 FORMAT "%.0" SYMBOL_LINK "testByte000" 232 /end MEASUREMENT
/begin MEASUREMENT TestDWord_066 "" ULONG TestDWord_066.CONVERSION 0 0 0 255 ECU_ADDRESS 0x1BE224 FORMAT "%.0" SYMBOL_LINK "testByte000" 268 /end MEASUREMENT
/begin MEASUREMENT TestDWord_067 "" ULONG TestDWord_067.CONVERSION 0 0 0 255 ECU_ADDRESS 0x1BE228 FORMAT "%.0" SYMBOL_LINK "testByte000" 272 /end MEASUREMENT
/begin MEASUREMENT TestDWord_073 "" ULONG TestDWord_073.CONVERSION 0 0 0 255 ECU_ADDRESS 0x1BE240 FORMAT "%.0" SYMBOL_LINK "testByte000" 296 /end MEASUREMENT
/begin MEASUREMENT TestDWord_079 "" ULONG TestDWord_079.CONVERSION 0 0 0 255 ECU_ADDRESS 0x1BE258 FORMAT "%.0" SYMBOL_LINK "testByte000" 320 /end MEASUREMENT
/begin MEASUREMENT TestDWord_086 "" ULONG TestDWord_086.CONVERSION 0 0 0 255 ECU_ADDRESS 0x1BE274 FORMAT "%.0" SYMBOL_LINK "testByte000" 348 /end MEASUREMENT
/begin MEASUREMENT TestDWord_087 "" ULONG TestDWord_087.CONVERSION 0 0 0 255 ECU_ADDRESS 0x1BE278 FORMAT "%.0" SYMBOL_LINK "testByte000" 352 /end MEASUREMENT
/begin MEASUREMENT TestDWord_094 "" ULONG TestDWord_094.CONVERSION 0 0 0 255 ECU_ADDRESS 0x1BE294 FORMAT "%.0" SYMBOL_LINK "testByte000" 380 /end MEASUREMENT
/begin MEASUREMENT TestDWord_100 "" ULONG TestDWord_100.CONVERSION 0 0 0 255 ECU_ADDRESS 0x1BE2AC FORMAT "%.0" SYMBOL_LINK "testByte000" 404 /end MEASUREMENT
/begin MEASUREMENT TestDWord_102 "" ULONG TestDWord_102.CONVERSION 0 0 0 255 ECU_ADDRESS 0x1BE2B4 FORMAT "%.0" SYMBOL_LINK "testByte000" 412 /end MEASUREMENT
/begin MEASUREMENT TestDWord_110 "" ULONG TestDWord_110.CONVERSION 0 0 0 255 ECU_ADDRESS 0x1BE2D4 FORMAT "%.0" SYMBOL_LINK "testByte000" 444 /end MEASUREMENT
/begin MEASUREMENT TestDWord_114 "" ULONG TestDWord_114.CONVERSION 0 0 0 255 ECU_ADDRESS 0x1BE2E4 FORMAT "%.0" SYMBOL_LINK "testByte000" 460 /end MEASUREMENT
/begin MEASUREMENT TestDWord_115 "" ULONG TestDWord_115.CONVERSION 0 0 0 255 ECU_ADDRESS 0x1BE2E8 FORMAT "%.0" SYMBOL_LINK "testByte000" 464 /end MEASUREMENT
/begin MEASUREMENT TestDWord_118 "" ULONG TestDWord_118.CONVERSION 0 0 0 255 ECU_ADDRESS 0x1BE2F4 FORMAT "%.0" SYMBOL_LINK "testByte000" 476 /end MEASUREMENT
/begin MEASUREMENT TestDWord_122 "" ULONG TestDWord_122.CONVERSION 0 0 0 255 ECU_ADDRESS 0x1BE304 FORMAT "%.0" SYMBOL_LINK "testByte000" 492 /end MEASUREMENT
/begin MEASUREMENT TestDWord_128 "" ULONG TestDWord_128.CONVERSION 0 0 0 255 ECU_ADDRESS 0x1BE31C FORMAT "%.0" SYMBOL_LINK "testByte000" 516 /end MEASUREMENT
/begin MEASUREMENT TestDWord_135 "" ULONG TestDWord_135.CONVERSION 0 0 0 255 ECU_ADDRESS 0x1BE338 FORMAT "%.0" SYMBOL_LINK "testByte000" 544 /end MEASUREMENT
/begin MEASUREMENT TestDWord_145 "" ULONG TestDWord_145.CONVERSION 0 0 0 255 ECU_ADDRESS 0x1BE360 FORMAT "%.0" SYMBOL_LINK "testByte000" 584 /end MEASUREMENT
/begin MEASUREMENT TestDWord_147 "" ULONG TestDWord_147.CONVERSION 0 0 0 255 ECU_ADDRESS 0x1BE368 FORMAT "%.0" SYMBOL_LINK "testByte000" 592 /end MEASUREMENT
/begin MEASUREMENT TestDWord_150 "" ULONG TestDWord_150.CONVERSION 0 0 0 255 ECU_ADDRESS 0x1BE374 FORMAT "%.0" SYMBOL_LINK "testByte000" 604 /end MEASUREMENT
/begin MEASUREMENT TestDWord_161 "" ULONG TestDWord_161.CONVERSION 0 0 0 255 ECU_ADDRESS 0x1BE3A0 FORMAT "%.0" SYMBOL_LINK "testByte000" 648 /end MEASUREMENT
/begin MEASUREMENT TestDWord_165 "" ULONG TestDWord_165.CONVERSION 0 0 0 255 ECU_ADDRESS 0x1BE3B0 FORMAT "%.0" SYMBOL_LINK "testByte000" 664 /end MEASUREMENT
/begin MEASUREMENT TestDWord_167 "" ULONG TestDWord_167.CONVERSION 0 0 0 255 ECU_ADDRESS 0x1BE3B8 FORMAT "%.0" SYMBOL_LINK "testByte000" 672 /end MEASUREMENT
/begin MEASUREMENT TestDWord_168 "" ULONG TestDWord_168.CONVERSION 0 0 0 255 ECU_ADDRESS 0x1BE3BC FORMAT "%.0" SYMBOL_LINK "testByte000" 676 /end MEASUREMENT
/begin MEASUREMENT TestDWord_172 "" ULONG TestDWord_172.CONVERSION 0 0 0 255 ECU_ADDRESS 0x1BE3CC FORMAT "%.0" SYMBOL_LINK "testByte000" 692 /end MEASUREMENT
/begin MEASUREMENT TestDWord_174 "" ULONG TestDWord_174.CONVERSION 0 0 0 255 ECU_ADDRESS 0x1BE3D4 FORMAT "%.0" SYMBOL_LINK "testByte000" 700 /end MEASUREMENT
/begin MEASUREMENT TestDWord_180 "" ULONG TestDWord_180.CONVERSION 0 0 0 255 ECU_ADDRESS 0x1BE3EC FORMAT "%.0" SYMBOL_LINK "testByte000" 724 /end MEASUREMENT
/begin MEASUREMENT TestDWord_181 "" ULONG TestDWord_181.CONVERSION 0 0 0 255 ECU_ADDRESS 0x1BE3F0 FORMAT "%.0" SYMBOL_LINK "testByte000" 728 /end MEASUREMENT
/begin MEASUREMENT TestDWord_186 "" ULONG TestDWord_186.CONVERSION 0 0 0 255 ECU_ADDRESS 0x1BE404 FORMAT "%.0" SYMBOL_LINK "testByte000" 748 /end MEASUREMENT
/begin MEASUREMENT TestDWord_187 "" ULONG TestDWord_187.CONVERSION 0 0 0 255 ECU_ADDRESS 0x1BE408 FORMAT "%.0" SYMBOL_LINK "testByte000" 752 /end MEASUREMENT
/begin MEASUREMENT TestDWord_190 "" ULONG TestDWord_190.CONVERSION 0 0 0 255 ECU_ADDRESS 0x1BE414 FORMAT "%.0" SYMBOL_LINK "testByte000" 764 /end MEASUREMENT
/begin MEASUREMENT TestDWord_197 "" ULONG TestDWord_197.CONVERSION 0 0 0 255 ECU_ADDRESS 0x1BE430 FORMAT "%.0" SYMBOL_LINK "testByte000" 792 /end MEASUREMENT
/begin MEASUREMENT TestDWord_199 "" ULONG TestDWord_199.CONVERSION 0 0 0 255 ECU_ADDRESS 0x1BE438 FORMAT "%.0" SYMBOL_LINK "testByte000" 800 /end MEASUREMENT
/begin MEASUREMENT TestDWord_201 "" ULONG TestDWord_201.CONVERSION 0 0 0 255 ECU_ADDRESS 0x1BE440 FORMAT "%.0" SYMBOL_LINK "testByte000" 808 /end MEASUREMENT
/begin MEASUREMENT TestDWord_205 "" ULONG TestDWord_205.CONVERSION 0 0 0 255 ECU_ADDRESS 0x1BE450 FORMAT "%.0" SYMBOL_LINK "testByte000" 824 /end MEASUREMENT
/begin MEASUREMENT TestDWord_210 "" ULONG TestDWord_210.CONVERSION 0 0 0 255 ECU_ADDRESS 0x1BE464 FORMAT "%.0" SYMBOL_LINK "testByte000" 844 /end MEASUREMENT
/begin MEASUREMENT TestDWord_212 "" ULONG TestDWord_212.CONVERSION 0 0 0 255 ECU_ADDRESS 0x1BE46C FORMAT "%.0" SYMBOL_LINK "testByte000" 852 /end MEASUREMENT
/begin MEASUREMENT TestDWord_223 "" ULONG TestDWord_223.CONVERSION 0 0 0 255 ECU_ADDRESS 0x1BE498 FORMAT "%.0" SYMBOL_LINK "testByte000" 896 /end MEASUREMENT
/begin MEASUREMENT TestDWord_224 "" ULONG TestDWord_224.CONVERSION 0 0 0 255 ECU_ADDRESS 0x1BE49C FORMAT "%.0" SYMBOL_LINK "testByte000" 900 /end MEASUREMENT
/begin MEASUREMENT TestDWord_227 "" ULONG TestDWord_227.CONVERSION 0 0 0 255 ECU_ADDRESS 0x1BE4A8 FORMAT "%.0" SYMBOL_LINK "testByte000" 912 /end MEASUREMENT
/begin MEASUREMENT TestDWord_240 "" ULONG TestDWord_240.CONVERSION 0 0 0 255 ECU_ADDRESS 0x1BE4DC FORMAT "%.0" SYMBOL_LINK "testByte000" 964 /end MEASUREMENT
/begin MEASUREMENT TestDWord_244 "" ULONG TestDWord_244.CONVERSION 0 0 0 255 ECU_ADDRESS 0x1BE4EC FORMAT "%.0" SYMBOL_LINK "testByte000" 980 /end MEASUREMENT
/begin MEASUREMENT TestDWord_245 "" ULONG TestDWord_245.CONVERSION 0 0 0 255 ECU_ADDRESS 0x1BE4F0 FORMAT "%.0" SYMBOL_LINK "testByte000" 984 /end MEASUREMENT
/begin MEASUREMENT TestDWord_257 "" ULONG TestDWord_257.CONVERSION 0 0 0 255 ECU_ADDRESS 0x1BE520 FORMAT "%.0" SYMBOL_LINK "testByte000" 1032 /end MEASUREMENT
/begin MEASUREMENT TestDWord_269 "" ULONG TestDWord_269.CONVERSION 0 0 0 255 ECU_ADDRESS 0x1BE550 FORMAT "%.0" SYMBOL_LINK "testByte000" 1080 /end MEASUREMENT
/begin MEASUREMENT TestDWord_270 "" ULONG TestDWord_270.CONVERSION 0 0 0 255 ECU_ADDRESS 0x1BE554 FORMAT "%.0" SYMBOL_LINK "testByte000" 1084 /end MEASUREMENT
/begin MEASUREMENT TestDWord_274 "" ULONG TestDWord_274.CONVERSION 0 0 0 255 ECU_ADDRESS 0x1BE564 FORMAT "%.0" SYMBOL_LINK "testByte000" 1100 /end MEASUREMENT
/begin MEASUREMENT TestDWord_283 "" ULONG TestDWord_283.CONVERSION 0 0 0 255 ECU_ADDRESS 0x1BE588 FORMAT "%.0" SYMBOL_LINK "testByte000" 1136 /end MEASUREMENT
/begin MEASUREMENT TestDWord_286 "" ULONG TestDWord_286.CONVERSION 0 0 0 255 ECU_ADDRESS 0x1BE594 FORMAT "%.0" SYMBOL_LINK "testByte000" 1148 /end MEASUREMENT
/begin MEASUREMENT TestDWord_296 "" ULONG TestDWord_296.CONVERSION 0 0 0 255 ECU_ADDRESS 0x1BE5BC FORMAT "%.0" SYMBOL_LINK "testByte000" 1188 /end MEASUREMENT
/begin MEASUREMENT TestDWord_306 "" ULONG TestDWord_306.CONVERSION 0 0 0 255 ECU_ADDRESS 0x1BE5E4 FORMAT "%.0" SYMBOL_LINK "testByte000" 1228 /end MEASUREMENT
/begin MEASUREMENT TestDWord_308 "" ULONG TestDWord_308.CONVERSION 0 0 0 255 ECU_ADDRESS 0x1BE5EC FORMAT "%.0" SYMBOL_LINK "testByte000" 1236 /end MEASUREMENT
/begin MEASUREMENT TestDWord_309 "" ULONG TestDWord_309.CONVERSION 0 0 0 255 ECU_ADDRESS 0x1BE5F0 FORMAT "%.0" SYMBOL_LINK "testByte000" 1240 /end MEASUREMENT
/begin MEASUREMENT TestDWord_313 "" ULONG TestDWord_313.CONVERSION 0 0 0 255 ECU_ADDRESS 0x1BE600 FORMAT "%.0" SYMBOL_LINK "testByte000" 1256 /end MEASUREMENT
/begin MEASUREMENT TestDWord_326 "" ULONG TestDWord_326.CONVERSION 0 0 0 255 ECU_ADDRESS 0x1BE634 FORMAT "%.0" SYMBOL_LINK "testByte000" 1308 /end MEASUREMENT
/begin MEASUREMENT TestDWord_338 "" ULONG TestDWord_338.CONVERSION 0 0 0 255 ECU_ADDRESS 0x1BE664 FORMAT "%.0" SYMBOL_LINK "testByte000" 1356 /end MEASUREMENT
/begin MEASUREMENT TestDWord_340 "" ULONG TestDWord_340.CONVERSION 0 0 0 255 ECU_ADDRESS 0x1BE66C FORMAT "%.0" SYMBOL_LINK "testByte000" 1364 /end MEASUREMENT
/begin MEASUREMENT TestDWord_348 "" ULONG TestDWord_348.CONVERSION 0 0 0 255 ECU_ADDRESS 0x1BE68C FORMAT "%.0" SYMBOL_LINK "testByte000" 1396 /end MEASUREMENT
/begin MEASUREMENT TestDWord_355 "" ULONG TestDWord_355.CONVERSION 0 0 0 255 ECU_ADDRESS 0x1BE6A8 FORMAT "%.0" SYMBOL_LINK "testByte000" 1424 /end MEASUREMENT
/begin MEASUREMENT TestDWord_358 "" ULONG TestDWord_358.CONVERSION 0 0 0 255 ECU_ADDRESS 0x1BE6B4 FORMAT "%.0" SYMBOL_LINK "testByte000" 1436 /end MEASUREMENT
/begin MEASUREMENT TestDWord_360 "" ULONG TestDWord_360.CONVERSION 0 0 0 255 ECU_ADDRESS 0x1BE6BC FORMAT "%.0" SYMBOL_LINK "testByte000" 1444 /end MEASUREMENT
/begin MEASUREMENT TestDWord_372 "" ULONG TestDWord_372.CONVERSION 0 0 0 255 ECU_ADDRESS 0x1BE6EC FORMAT "%.0" SYMBOL_LINK "testByte000" 1492 /end MEASUREMENT
/begin MEASUREMENT TestDWord_375 "" ULONG TestDWord_375.CONVERSION 0 0 0 255 ECU_ADDRESS 0x1BE6F8 FORMAT "%.0" SYMBOL_LINK "testByte000" 1504 /end MEASUREMENT
/begin MEASUREMENT TestDWord_376 "" ULONG TestDWord_376.CONVERSION 0 0 0 255 ECU_ADDRESS 0x1BE6FC FORMAT "%.0" SYMBOL_LINK "testByte000" 1508 /end MEASUREMENT
/begin MEASUREMENT TestDWord_383 "" ULONG TestDWord_383.CONVERSION 0 0 0 255 ECU_ADDRESS 0x1BE718 FORMAT "%.0" SYMBOL_LINK "testByte000" 1536 /end MEASUREMENT
/begin MEASUREMENT TestDWord_385 "" ULONG TestDWord_385.CONVERSION 0 0 0 255 ECU_ADDRESS 0x1BE720 FORMAT "%.0" SYMBOL_LINK "testByte000" 1544 /end MEASUREMENT
/begin MEASUREMENT TestDWord_387 "" ULONG TestDWord_387.CONVERSION 0 0 0 255 ECU_ADDRESS 0x1BE728 FORMAT "%.0" SYMBOL_LINK "testByte000" 1552 /end MEASUREMENT
/begin MEASUREMENT TestDWord_388 "" ULONG TestDWord_388.CONVERSION 0 0 0 255 ECU_ADDRESS 0x1BE72C FORMAT "%.0" SYMBOL_LINK "testByte000" 1556 /end MEASUREMENT
/begin MEASUREMENT TestDWord_396 "" ULONG TestDWord_396.CONVERSION 0 0 0 255 ECU_ADDRESS 0x1BE74C FORMAT "%.0" SYMBOL_LINK "testByte000" 1588 /end MEASUREMENT
/begin MEASUREMENT TestDWord_398 "" ULONG TestDWord_398.CONVERSION 0 0 0 255 ECU_ADDRESS 0x1BE754 FORMAT "%.0" SYMBOL_LINK "testByte000" 1596 /end MEASUREMENT
/begin MEASUREMENT TestDWord_399 "" ULONG TestDWord_399.CONVERSION 0 0 0 255 ECU_ADDRESS 0x1BE758 FORMAT "%.0" SYMBOL_LINK "testByte000" 1600 /end MEASUREMENT
/begin MEASUREMENT TestDWord_407 "" ULONG TestDWord_407.CONVERSION 0 0 0 255 ECU_ADDRESS 0x1BE778 FORMAT "%.0" SYMBOL_LINK "testByte000" 1632 /end MEASUREMENT
/begin MEASUREMENT TestDWord_409 "" ULONG TestDWord_409.CONVERSION 0 0 0 255 ECU_ADDRESS 0x1BE780 FORMAT "%.0" SYMBOL_LINK "testByte000" 1640 /end MEASUREMENT
/begin MEASUREMENT TestDWord_410 "" ULONG TestDWord_410.CONVERSION 0 0 0 255 ECU_ADDRESS 0x1BE784 FORMAT "%.0" SYMBOL_LINK "testByte000" 1644 /end MEASUREMENT
/begin MEASUREMENT TestDWord_411 "" ULONG TestDWord_411.CONVERSION 0 0 0 255 ECU_ADDRESS 0x1BE788 FORMAT "%.0" SYMBOL_LINK "testByte000" 1648 /end MEASUREMENT
/begin MEASUREMENT TestDWord_426 "" ULONG TestDWord_426.CONVERSION 0 0 0 255 ECU_ADDRESS 0x1BE7C4 FORMAT "%.0" SYMBOL_LINK "testByte000" 1708 /end MEASUREMENT
/begin MEASUREMENT TestDWord_431 "" ULONG TestDWord_431.CONVERSION 0 0 0 255 ECU_ADDRESS 0x1BE7D8 FORMAT "%.0" SYMBOL_LINK "testByte000" 1728 /end MEASUREMENT
/begin MEASUREMENT TestDWord_433 "" ULONG TestDWord_433.CONVERSION 0 0 0 255 ECU_ADDRESS 0x1BE7E0 FORMAT "%.0" SYMBOL_LINK "testByte000" 1736 /end MEASUREMENT
/begin MEASUREMENT TestDWord_443 "" ULONG TestDWord_443.CONVERSION 0 0 0 255 ECU_ADDRESS 0x1BE808 FORMAT "%.0" SYMBOL_LINK "testByte000" 1776 /end MEASUREMENT
/begin MEASUREMENT TestDWord_444 "" ULONG TestDWord_444.CONVERSION 0 0 0 255 ECU_ADDRESS 0x1BE80C FORMAT "%.0" SYMBOL_LINK "testByte000" 1780 /end MEASUREMENT
/begin MEASUREMENT TestDWord_458 "" ULONG TestDWord_458.CONVERSION 0 0 0 255 ECU_ADDRESS 0x1BE844 FORMAT "%.0" SYMBOL_LINK "testByte000" 1836 /end MEASUREMENT
/begin MEASUREMENT TestDWord_470 "" ULONG TestDWord_470.CONVERSION 0 0 0 255 ECU_ADDRESS 0x1BE874 FORMAT "%.0" SYMBOL_LINK "testByte000" 1884 /end MEASUREMENT
/begin MEASUREMENT TestDWord_471 "" ULONG TestDWord_471.CONVERSION 0 0 0 255 ECU_ADDRESS 0x1BE878 FORMAT "%.0" SYMBOL_LINK "testByte000" 1888 /end MEASUREMENT
/begin MEASUREMENT TestDWord_474 "" ULONG TestDWord_474.CONVERSION 0 0 0 255 ECU_ADDRESS 0x1BE884 FORMAT "%.0" SYMBOL_LINK "testByte000" 1900 /end MEASUREMENT
/begin MEASUREMENT TestDWord_478 "" ULONG TestDWord_478.CONVERSION 0 0 0 255 ECU_ADDRESS 0x1BE894 FORMAT "%.0" SYMBOL_LINK "testByte000" 1916 /end MEASUREMENT
/begin MEASUREMENT TestDWord_479 "" ULONG TestDWord_479.CONVERSION 0 0 0 255 ECU_ADDRESS 0x1BE898 FORMAT "%.0" SYMBOL_LINK "testByte000" 1920 /end MEASUREMENT
/begin MEASUREMENT TestDWord_480 "" ULONG TestDWord_480.CONVERSION 0 0 0 255 ECU_ADDRESS 0x1BE89C FORMAT "%.0" SYMBOL_LINK "testByte000" 1924 /end MEASUREMENT
/begin MEASUREMENT TestDWord_483 "" ULONG TestDWord_483.CONVERSION 0 0 0 255 ECU_ADDRESS 0x1BE8A8 FORMAT "%.0" SYMBOL_LINK "testByte000" 1936 /end MEASUREMENT
/begin MEASUREMENT TestDWord_488 "" ULONG TestDWord_488.CONVERSION 0 0 0 255 ECU_ADDRESS 0x1BE8BC FORMAT "%.0" SYMBOL_LINK "testByte000" 1956 /end MEASUREMENT
/begin MEASUREMENT TestDWord_492 "" ULONG TestDWord_492.CONVERSION 0 0 0 255 ECU_ADDRESS 0x1BE8CC FORMAT "%.0" SYMBOL_LINK "testByte000" 1972 /end MEASUREMENT
/begin MEASUREMENT TestDWord_496 "" ULONG TestDWord_496.CONVERSION 0 0 0 255 ECU_ADDRESS 0x1BE8DC FORMAT "%.0" SYMBOL_LINK "testByte000" 1988 /end MEASUREMENT
/begin MEASUREMENT TestDWord_501 "" ULONG TestDWord_501.CONVERSION 0 0 0 255 ECU_ADDRESS 0x1BE8F0 FORMAT "%.0" SYMBOL_LINK "testByte000" 2008 /end MEASUREMENT
/begin MEASUREMENT TestDWord_502 "" ULONG TestDWord_502.CONVERSION 0 0 0 255 ECU_ADDRESS 0x1BE8F4 FORMAT "%.0" SYMBOL_LINK "testByte000" 2012 /end MEASUREMENT
/begin MEASUREMENT TestDWord_503 "" ULONG TestDWord_503.CONVERSION 0 0 0 255 ECU_ADDRESS 0x1BE8F8 FORMAT "%.0" SYMBOL_LINK "testByte000" 2016 /end MEASUREMENT
/begin MEASUREMENT TestDWord_504 "" ULONG TestDWord_504.CONVERSION 0 0 0 255 ECU_ADDRESS 0x1BE8FC FORMAT "%.0" SYMBOL_LINK "testByte000" 2020 /end MEASUREMENT
/begin MEASUREMENT TestDWord_508 "" ULONG TestDWord_508.CONVERSION 0 0 0 255 ECU_ADDRESS 0x1BE90C FORMAT "%.0" SYMBOL_LINK "testByte000" 2036 /end MEASUREMENT
/begin MEASUREMENT TestDWord_516 "" ULONG TestDWord_516.CONVERSION 0 0 0 255 ECU_ADDRESS 0x1BE92C FORMAT "%.0" SYMBOL_LINK "testByte000" 2068 /end MEASUREMENT
/begin MEASUREMENT TestDWord_524 "" ULONG TestDWord_524.CONVERSION 0 0 0 255 ECU_ADDRESS 0x1BE94C FORMAT "%.0" SYMBOL_LINK "testByte000" 2100 /end MEASUREMENT
/begin MEASUREMENT TestDWord_529 "" ULONG TestDWord_529.CONVERSION 0 0 0 255 ECU_ADDRESS 0x1BE960 FORMAT "%.0" SYMBOL_LINK "testByte000" 2120 /end MEASUREMENT
/begin MEASUREMENT TestDWord_534 "" ULONG TestDWord_534.CONVERSION 0 0 0 255 ECU_ADDRESS 0x1BE974 FORMAT "%.0" SYMBOL_LINK "testByte000" 2140 /end MEASUREMENT
/begin MEASUREMENT TestDWord_535 "" ULONG TestDWord_535.CONVERSION 0 0 0 255 ECU_ADDRESS 0x1BE978 FORMAT "%.0" SYMBOL_LINK "testByte000" 2144 /end MEASUREMENT
/begin MEASUREMENT TestDWord_545 "" ULONG TestDWord_545.CONVERSION 0 0 0 255 ECU_ADDRESS 0x1BE9A0 FORMAT "%.0" SYMBOL_LINK "testByte000" 2184 /end MEASUREMENT
/begin MEASUREMENT TestDWord_550 "" ULONG TestDWord_550.CONVERSION 0 0 0 255 ECU_ADDRESS 0x1BE9B4 FORMAT "%.0" SYMBOL_LINK "testByte000" 2204 /end MEASUREMENT
/begin MEASUREMENT TestDWord_557 "" ULONG TestDWord_557.CONVERSION 0 0 0 255 ECU_ADDRESS 0x1BE9D0 FORMAT "%.0" SYMBOL_LINK "testByte000" 2232 /end MEASUREMENT
/begin MEASUREMENT TestDWord_558 "" ULONG TestDWord_558.CONVERSION 0 0 0 255 ECU_ADDRESS 0x1BE9D4 FORMAT "%.0" SYMBOL_LINK "testByte000" 2236 /end MEASUREMENT
/begin MEASUREMENT TestDWord_575 "" ULONG TestDWord_575.CONVERSION 0 0 0 255 ECU_ADDRESS 0x1BEA18 FORMAT "%.0" SYMBOL_LINK "testByte000" 2304 /end MEASUREMENT
/begin MEASUREMENT TestDWord_576 "" ULONG TestDWord_576.CONVERSION 0 0 0 255 ECU_ADDRESS 0x1BEA1C FORMAT "%.0" SYMBOL_LINK "testByte000" 2308 /end MEASUREMENT
/begin MEASUREMENT TestDWord_577 "" ULONG TestDWord_577.CONVERSION 0 0 0 255 ECU_ADDRESS 0x1BEA20 FORMAT "%.0" SYMBOL_LINK "testByte000" 2312 /end MEASUREMENT
/begin MEASUREMENT TestDWord_582 "" ULONG TestDWord_582.CONVERSION 0 0 0 255 ECU_ADDRESS 0x1BEA34 FORMAT "%.0" SYMBOL_LINK "testByte000" 2332 /end MEASUREMENT
/begin MEASUREMENT TestDWord_584 "" ULONG TestDWord_584.CONVERSION 0 0 0 255 ECU_ADDRESS 0x1BEA3C FORMAT "%.0" SYMBOL_LINK "testByte000" 2340 /end MEASUREMENT
/begin MEASUREMENT TestDWord_596 "" ULONG TestDWord_596.CONVERSION 0 0 0 255 ECU_ADDRESS 0x1BEA6C FORMAT "%.0" SYMBOL_LINK "testByte000" 2388 /end MEASUREMENT
/begin MEASUREMENT TestDWord_601 "" ULONG TestDWord_601.CONVERSION 0 0 0 255 ECU_ADDRESS 0x1BEA80 FORMAT "%.0" SYMBOL_LINK "testByte000" 2408 /end MEASUREMENT
/begin MEASUREMENT TestDWord_620 "" ULONG TestDWord_620.CONVERSION 0 0 0 255 ECU_ADDRESS 0x1BEACC FORMAT "%.0" SYMBOL_LINK "testByte000" 2484 /end MEASUREMENT
/begin MEASUREMENT TestDWord_624 "" ULONG TestDWord_624.CONVERSION 0 0 0 255 ECU_ADDRESS 0x1BEADC FORMAT "%.0" SYMBOL_LINK "testByte000" 2500 /end MEASUREMENT
/begin MEASUREMENT TestDWord_643 "" ULONG TestDWord_643.CONVERSION 0 0 0 255 ECU_ADDRESS 0x1BEB28 FORMAT "%.0" SYMBOL_LINK "testByte000" 2576 /end MEASUREMENT
/begin MEASUREMENT TestDWord_669 "" ULONG TestDWord_669.CONVERSION 0 0 0 255 ECU_ADDRESS 0x1BEB90 FORMAT "%.0" SYMBOL_LINK "testByte000" 2680 /end MEASUREMENT
/begin MEASUREMENT TestDWord_671 "" ULONG TestDWord_671.CONVERSION 0 0 0 255 ECU_ADDRESS 0x1BEB98 FORMAT "%.0" SYMBOL_LINK "testByte000" 2688 /end MEASUREMENT
/begin MEASUREMENT TestDWord_675 "" ULONG TestDWord_675.CONVERSION 0 0 0 255 ECU_ADDRESS 0x1BEBA8 FORMAT "%.0" SYMBOL_LINK "testByte000" 2704 /end MEASUREMENT
/begin MEASUREMENT TestDWord_679 "" ULONG TestDWord_679.CONVERSION 0 0 0 255 ECU_ADDRESS 0x1BEBB8 FORMAT "%.0" SYMBOL_LINK "testByte000" 2720 /end MEASUREMENT
/begin MEASUREMENT TestDWord_684 "" ULONG TestDWord_684.CONVERSION 0 0 0 255 ECU_ADDRESS 0x1BEBCC FORMAT "%.0" SYMBOL_LINK "testByte000" 2740 /end MEASUREMENT
/begin MEASUREMENT TestDWord_691 "" ULONG TestDWord_691.CONVERSION 0 0 0 255 ECU_ADDRESS 0x1BEBE8 FORMAT "%.0" SYMBOL_LINK "testByte000" 2768 /end MEASUREMENT
/begin MEASUREMENT TestDWord_693 "" ULONG TestDWord_693.CONVERSION 0 0 0 255 ECU_ADDRESS 0x1BEBF0 FORMAT "%.0" SYMBOL_LINK "testByte000" 2776 /end MEASUREMENT
/begin MEASUREMENT TestDWord_694 "" ULONG TestDWord_694.CONVERSION 0 0 0 255 ECU_ADDRESS 0x1BEBF4 FORMAT "%.0" SYMBOL_LINK "testByte000" 2780 /end MEASUREMENT
/begin MEASUREMENT TestDWord_697 "" ULONG TestDWord_697.CONVERSION 0 0 0 255 ECU_ADDRESS 0x1BEC00 FORMAT "%.0" SYMBOL_LINK "testByte000" 2792 /end MEASUREMENT
/begin MEASUREMENT TestDWord_703 "" ULONG TestDWord_703.CONVERSION 0 0 0 255 ECU_ADDRESS 0x1BEC18 FORMAT "%.0" SYMBOL_LINK "testByte000" 2816 /end MEASUREMENT
/begin MEASUREMENT TestDWord_708 "" ULONG TestDWord_708.CONVERSION 0 0 0 255 ECU_ADDRESS 0x1BEC2C FORMAT "%.0" SYMBOL_LINK "testByte000" 2836 /end MEASUREMENT
/begin MEASUREMENT TestDWord_714 "" ULONG TestDWord_714.CONVERSION 0 0 0 255 ECU_ADDRESS 0x1BEC44 FORMAT "%.0" SYMBOL_LINK "testByte000" 2860 /end MEASUREMENT
/begin MEASUREMENT TestDWord_716 "" ULONG TestDWord_716.CONVERSION 0 0 0 255 ECU_ADDRESS 0x1BEC4C FORMAT "%.0" SYMBOL_LINK "testByte000" 2868 /end MEASUREMENT
/begin MEASUREMENT TestDWord_722 "" ULONG TestDWord_722.CONVERSION 0 0 0 255 ECU_ADDRESS 0x1BEC64 FORMAT "%.0" SYMBOL_LINK "testByte000" 2892 /end MEASUREMENT
/begin MEASUREMENT TestDWord_724 "" ULONG TestDWord_724.CONVERSION 0 0 0 255 ECU_ADDRESS 0x1BEC6C FORMAT "%.0" SYMBOL_LINK "testByte000" 2900 /end MEASUREMENT
/begin MEASUREMENT TestDWord_725 "" ULONG TestDWord_725.CONVERSION 0 0 0 255 ECU_ADDRESS 0x1BEC70 FORMAT "%.0" SYMBOL_LINK "testByte000" 2904 /end MEASUREMENT
/begin MEASUREMENT TestDWord_727 "" ULONG TestDWord_727.CONVERSION 0 0 0 255 ECU_ADDRESS 0x1BEC78 FORMAT "%.0" SYMBOL_LINK "testByte000" 2912 /end MEASUREMENT
/begin MEASUREMENT TestDWord_730 "" ULONG TestDWord_730.CONVERSION 0 0 0 255 ECU_ADDRESS 0x1BEC84 FORMAT "%.0" SYMBOL_LINK "testByte000" 2924 /end MEASUREMENT
/begin MEASUREMENT TestDWord_748 "" ULONG TestDWord_748.CONVERSION 0 0 0 255 ECU_ADDRESS 0x1BECCC FORMAT "%.0" SYMBOL_LINK "testByte000" 2996 /end MEASUREMENT
/begin MEASUREMENT TestDWord_758 "" ULONG TestDWord_758.CONVERSION 0 0 0 255 ECU_ADDRESS 0x1BECF4 FORMAT "%.0" SYMBOL_LINK "testByte000" 3036 /end MEASUREMENT
/begin MEASUREMENT TestDWord_769 "" ULONG TestDWord_769.CONVERSION 0 0 0 255 ECU_ADDRESS 0x1BED20 FORMAT "%.0" SYMBOL_LINK "testByte000" 3080 /end MEASUREMENT
/begin MEASUREMENT TestDWord_773 "" ULONG TestDWord_773.CONVERSION 0 0 0 255 ECU_ADDRESS 0x1BED30 FORMAT "%.0" SYMBOL_LINK "testByte000" 3096 /end MEASUREMENT
/begin MEASUREMENT TestDWord_782 "" ULONG TestDWord_782.CONVERSION 0 0 0 255 ECU_ADDRESS 0x1BED54 FORMAT "%.0" SYMBOL_LINK "testByte000" 3132 /end MEASUREMENT
/begin MEASUREMENT TestDWord_783 "" ULONG TestDWord_783.CONVERSION 0 0 0 255 ECU_ADDRESS 0x1BED58 FORMAT "%.0" SYMBOL_LINK "testByte000" 3136 /end MEASUREMENT
/begin MEASUREMENT TestDWord_794 "" ULONG TestDWord_794.CONVERSION 0 0 0 255 ECU_ADDRESS 0x1BED84 FORMAT "%.0" SYMBOL_LINK "testByte000" 3180 /end MEASUREMENT
/begin MEASUREMENT TestDWord_800 "" ULONG TestDWord_800.CONVERSION 0 0 0 255 ECU_ADDRESS 0x1BED9C FORMAT "%.0" SYMBOL_LINK "testByte000" 3204 /end MEASUREMENT
/begin MEASUREMENT TestDWord_805 "" ULONG TestDWord_805.CONVERSION 0 0 0 255 ECU_ADDRESS 0x1BEDB0 FORMAT "%.0" SYMBOL_LINK "testByte000" 3224 /end MEASUREMENT
/begin MEASUREMENT TestDWord_811 "" ULONG TestDWord_811.CONVERSION 0 0 0 255 ECU_ADDRESS 0x1BEDC8 FORMAT "%.0" SYMBOL_LINK "testByte000" 3248 /end MEASUREMENT
/begin MEASUREMENT TestDWord_814 "" ULONG TestDWord_814.CONVERSION 0 0 0 255 ECU_ADDRESS 0x1BEDD4 FORMAT "%.0" SYMBOL_LINK "testByte000" 3260 /end MEASUREMENT
/begin MEASUREMENT TestDWord_823 "" ULONG TestDWord_823.CONVERSION 0 0 0 255 ECU_ADDRESS 0x1BEDF8 FORMAT "%.0" SYMBOL_LINK "testByte000" 3296 /end MEASUREMENT
/begin MEASUREMENT TestDWord_825 "" ULONG TestDWord_825.CONVERSION 0 0 0 255 ECU_ADDRESS 0x1BEE00 FORMAT "%.0" SYMBOL_LINK "testByte000" 3304 /end MEASUREMENT
/begin MEASUREMENT TestDWord_828 "" ULONG TestDWord_828.CONVERSION 0 0 0 255 ECU_ADDRESS 0x1BEE0C FORMAT "%.0" SYMBOL_LINK "testByte000" 3316 /end MEASUREMENT
/begin MEASUREMENT TestDWord_839 "" ULONG TestDWord_839.CONVERSION 0 0 0 255 ECU_ADDRESS 0x1BEE38 FORMAT "%.0" SYMBOL_LINK "testByte000" 3360 /end MEASUREMENT
/begin MEASUREMENT TestDWord_849 "" ULONG TestDWord_849.CONVERSION 0 0 0 255 ECU_ADDRESS 0x1BEE60 FORMAT "%.0" SYMBOL_LINK "testByte000" 3400 /end MEASUREMENT
/begin MEASUREMENT TestDWord_850 "" ULONG TestDWord_850.CONVERSION 0 0 0 255 ECU_ADDRESS 0x1BEE64 FORMAT "%.0" SYMBOL_LINK "testByte000" 3404 /end MEASUREMENT
/begin MEASUREMENT TestDWord_851 "" ULONG TestDWord_851.CONVERSION 0 0 0 255 ECU_ADDRESS 0x1BEE68 FORMAT "%.0" SYMBOL_LINK "testByte000" 3408 /end MEASUREMENT
/begin MEASUREMENT TestDWord_863 "" ULONG TestDWord_863.CONVERSION 0 0 0 255 ECU_ADDRESS 0x1BEE98 FORMAT "%.0" SYMBOL_LINK "testByte000" 3456 /end MEASUREMENT
/begin MEASUREMENT TestDWord_866 "" ULONG TestDWord_866.CONVERSION 0 0 0 255 ECU_ADDRESS 0x1BEEA4 FORMAT "%.0" SYMBOL_LINK "testByte000" 3468 /end MEASUREMENT
/begin MEASUREMENT TestDWord_873 "" ULONG TestDWord_873.CONVERSION 0 0 0 255 ECU_ADDRESS 0x1BEEC0 FORMAT "%.0" SYMBOL_LINK "testByte000" 3496 /end MEASUREMENT
/begin MEASUREMENT TestDWord_875 "" ULONG TestDWord_875.CONVERSION 0 0 0 255 ECU_ADDRESS 0x1BEEC8 FORMAT "%.0" SYMBOL_LINK "testByte000" 3504 /end MEASUREMENT
/begin MEASUREMENT TestDWord_883 "" ULONG TestDWord_883.CONVERSION 0 0 0 255 ECU_ADDRESS 0x1BEEE8 FORMAT "%.0" SYMBOL_LINK "testByte000" 3536 /end MEASUREMENT
/begin MEASUREMENT TestDWord_895 "" ULONG TestDWord_895.CONVERSION 0 0 0 255 ECU_ADDRESS 0x1BEF18 FORMAT "%.0" SYMBOL_LINK "testByte000" 3584 /end MEASUREMENT
/begin MEASUREMENT TestDWord_899 "" ULONG TestDWord_899.CONVERSION 0 0 0 255 ECU_ADDRESS 0x1BEF28 FORMAT "%.0" SYMBOL_LINK "testByte000" 3600 /end MEASUREMENT
/begin MEASUREMENT TestDWord_906 "" ULONG TestDWord_906.CONVERSION 0 0 0 255 ECU_ADDRESS 0x1BEF44 FORMAT "%.0" SYMBOL_LINK "testByte000" 3628 /end MEASUREMENT
/begin MEASUREMENT TestDWord_907 "" ULONG TestDWord_907.CONVERSION 0 0 0 255 ECU_ADDRESS 0x1BEF48 FORMAT "%.0" SYMBOL_LINK "testByte000" 3632 /end MEASUREMENT
/begin MEASUREMENT TestDWord_908 "" ULONG TestDWord_908.CONVERSION 0 0 0 255 ECU_ADDRESS 0x1BEF4C FORMAT "%.0" SYMBOL_LINK "testByte000" 3636 /end MEASUREMENT
/begin MEASUREMENT TestDWord_910 "" ULONG TestDWord_910.CONVERSION 0 0 0 255 ECU_ADDRESS 0x1BEF54 FORMAT "%.0" SYMBOL_LINK "testByte000" 3644 /end MEASUREMENT
/begin MEASUREMENT TestDWord_917 "" ULONG TestDWord_917.CONVERSION 0 0 0 255 ECU_ADDRESS 0x1BEF70 FORMAT "%.0" SYMBOL_LINK "testByte000" 3672 /end MEASUREMENT
/begin MEASUREMENT TestDWord_922 "" ULONG TestDWord_922.CONVERSION 0 0 0 255 ECU_ADDRESS 0x1BEF84 FORMAT "%.0" SYMBOL_LINK "testByte000" 3692 /end MEASUREMENT
/begin MEASUREMENT TestDWord_923 "" ULONG TestDWord_923.CONVERSION 0 0 0 255 ECU_ADDRESS 0x1BEF88 FORMAT "%.0" SYMBOL_LINK "testByte000" 3696 /end MEASUREMENT
/begin MEASUREMENT TestDWord_925 "" ULONG TestDWord_925.CONVERSION 0 0 0 255 ECU_ADDRESS 0x1BEF90 FORMAT "%.0" SYMBOL_LINK "testByte000" 3704 /end MEASUREMENT
/begin MEASUREMENT TestDWord_927 "" ULONG TestDWord_927.CONVERSION 0 0 0 255 ECU_ADDRESS 0x1BEF98 FORMAT "%.0" SYMBOL_LINK "testByte000" 3712 /end MEASUREMENT
/begin MEASUREMENT TestDWord_929 "" ULONG TestDWord_929.CONVERSION 0 0 0 255 ECU_ADDRESS 0x1BEFA0 FORMAT "%.0" SYMBOL_LINK "testByte000" 3720 /end MEASUREMENT
/begin MEASUREMENT TestDWord_932 "" ULONG TestDWord_932.CONVERSION 0 0 0 255 ECU_ADDRESS 0x1BEFAC FORMAT "%.0" SYMBOL_LINK "testByte000" 3732 /end MEASUREMENT
/begin MEASUREMENT TestDWord_933 "" ULONG TestDWord_933.CONVERSION 0 0 0 255 ECU_ADDRESS 0x1BEFB0 FORMAT "%.0" SYMBOL_LINK "testByte000" 3736 /end MEASUREMENT
/begin MEASUREMENT TestDWord_945 "" ULONG TestDWord_945.CONVERSION 0 0 0 255 ECU_ADDRESS 0x1BEFE0 FORMAT "%.0" SYMBOL_LINK "testByte000" 3784 /end MEASUREMENT
/begin MEASUREMENT TestDWord_956 "" ULONG TestDWord_956.CONVERSION 0 0 0 255 ECU_ADDRESS 0x1BF00C FORMAT "%.0" SYMBOL_LINK "testByte000" 3828 /end MEASUREMENT
/begin MEASUREMENT TestDWord_959 "" ULONG TestDWord_959.CONVERSION 0 0 0 255 ECU_ADDRESS 0x1BF018 FORMAT "%.0" SYMBOL_LINK "testByte000" 3840 /end MEASUREMENT
/begin MEASUREMENT TestDWord_979 "" ULONG TestDWord_979.CONVERSION 0 0 0 255 ECU_ADDRESS 0x1BF068 FORMAT "%.0" SYMBOL_LINK "testByte000" 3920 /end MEASUREMENT
/begin MEASUREMENT TestDWord_980 "" ULONG TestDWord_980.CONVERSION 0 0 0 255 ECU_ADDRESS 0x1BF06C FORMAT "%.0" SYMBOL_LINK "testByte000" 3924 /end MEASUREMENT
/begin MEASUREMENT TestDWord_990 "" ULONG TestDWord_990.CONVERSION 0 0 0 255 ECU_ADDRESS 0x1BF094 FORMAT "%.0" SYMBOL_LINK "testByte000" 3964 /end MEASUREMENT
/begin MEASUREMENT TestDWord_994 "" ULONG TestDWord_994.CONVERSION 0 0 0 255 ECU_ADDRESS 0x1BF0A4 FORMAT "%.0" SYMBOL_LINK "testByte000" 3980 /end MEASUREMENT
/begin MEASUREMENT TestDWord_995 "" ULONG TestDWord_995.CONVERSION 0 0 0 255 ECU_ADDRESS 0x1BF0A8 FORMAT "%.0" SYMBOL_LINK "testByte000" 3984 /end MEASUREMENT
/begin MEASUREMENT TestDWord_996 "" ULONG TestDWord_996.CONVERSION 0 0 0 255 ECU_ADDRESS 0x1BF0AC FORMAT "%.0" SYMBOL_LINK "testByte000" 3988 /end MEASUREMENT
/begin CHARACTERISTIC TestKennfeld "" MAP 0x1C1210 MapNxNyXYVsb 0 TestKennfeld.CONVERSION 0 255
 /begin AXIS_DESCR STD_AXIS NO_INPUT_QUANTITY TestKennfeld_X_AXIS.CONVERSION 10 0 255 DEPOSIT ABSOLUTE FORMAT "%.3" /end AXIS_DESCR
 /begin AXIS_DESCR STD_AXIS NO_INPUT_QUANTITY TestKennfeld_Y_AXIS.CONVERSION 10 0 255 DEPOSIT ABSOLUTE FORMAT "%.3" /end AXIS_DESCR
 SYMBOL_LINK "TestArray_Max_10_10" 0 FORMAT "%.3" /end CHARACTERISTIC
/begin MEASUREMENT TestStatus "2 bit demo signal with symbolic conversion formula" UBYTE TestStatus.CONVERSION 0 0 0 3 READ_WRITE BIT_MASK 0xC0 ECU_ADDRESS 0x1BDCB3 FORMAT "%.0" SYMBOL_LINK "byteCounter" 0 /end MEASUREMENT
/begin CHARACTERISTIC TestStruct1.s0 "" VALUE 0x1BE0C8 __ULONG_S 0 TestStruct1.s0.CONVERSION 0 4294967295 FORMAT "%.15" /end CHARACTERISTIC
/begin CHARACTERISTIC TestStruct1.s1 "" VALUE 0x1BE0D0 __FLOAT64_IEEE_S 0 TestStruct1.s1.CONVERSION -1.7e+308 1.7e+308 FORMAT "%.15" /end CHARACTERISTIC
/begin CHARACTERISTIC TestStruct2[000].s0 "" VALUE 0x1BE0D8 __ULONG_S 0 TestStruct2[000].s0.CONVERSION 0 4294967295 FORMAT "%.15" /end CHARACTERISTIC
/begin CHARACTERISTIC TestStruct2[000].s1 "" VALUE 0x1BE0E0 __FLOAT64_IEEE_S 0 TestStruct2[000].s1.CONVERSION -1.7e+308 1.7e+308 FORMAT "%.15" /end CHARACTERISTIC
/begin CHARACTERISTIC TestStruct2[001].s0 "" VALUE 0x1BE0E8 __ULONG_S 0 TestStruct2[001].s0.CONVERSION 0 4294967295 FORMAT "%.15" /end CHARACTERISTIC
/begin CHARACTERISTIC TestStruct2[001].s1 "" VALUE 0x1BE0F0 __FLOAT64_IEEE_S 0 TestStruct2[001].s1.CONVERSION -1.7e+308 1.7e+308 FORMAT "%.15" /end CHARACTERISTIC
/begin CHARACTERISTIC TestStructStruct1.TestStruct2.s0 "" VALUE 0x1BE108 __ULONG_S 0 TestStructStruct1.TestStruct2.s0.CONVERSION 0 4294967295 FORMAT "%.15" /end CHARACTERISTIC
/begin CHARACTERISTIC TestStructStruct1.TestStruct2.s1 "" VALUE 0x1BE110 __FLOAT64_IEEE_S 0 TestStructStruct1.TestStruct2.s1.CONVERSION -1.7e+308 1.7e+308 FORMAT "%.15" /end CHARACTERISTIC
/begin CHARACTERISTIC TestStructStruct1.doubles "" VALUE 0x1BE100 __FLOAT64_IEEE_S 0 TestStructStruct1.doubles.CONVERSION -1.7e+308 1.7e+308 FORMAT "%.15" /end CHARACTERISTIC
/begin CHARACTERISTIC TestStructStruct1.ints "" VALUE 0x1BE0F8 __ULONG_S 0 TestStructStruct1.ints.CONVERSION 0 4294967295 FORMAT "%.15" /end CHARACTERISTIC
/begin CHARACTERISTIC TestStructTypes.cTest "" VALUE 0x1BE098 __SBYTE_S 0 TestStructTypes.cTest.CONVERSION -128 127 FORMAT "%.15" /end CHARACTERISTIC
/begin CHARACTERISTIC TestStructTypes.dTest "" VALUE 0x1BE0B8 __FLOAT64_IEEE_S 0 TestStructTypes.dTest.CONVERSION -1.7e+308 1.7e+308 FORMAT "%.15" /end CHARACTERISTIC
/begin CHARACTERISTIC TestStructTypes.fTest "" VALUE 0x1BE0B0 __FLOAT32_IEEE_S 0 TestStructTypes.fTest.CONVERSION -3.4e+38 3.4e+38 FORMAT "%.15" /end CHARACTERISTIC
/begin CHARACTERISTIC TestStructTypes.iTest "" VALUE 0x1BE0A0 __SLONG_S 0 TestStructTypes.iTest.CONVERSION -2147483648 2147483647 FORMAT "%.15" /end CHARACTERISTIC
/begin CHARACTERISTIC TestStructTypes.lTest "" VALUE 0x1BE0A8 __SLONG_S 0 TestStructTypes.lTest.CONVERSION -2147483648 2147483647 FORMAT "%.15" /end CHARACTERISTIC
/begin CHARACTERISTIC TestStructTypes.sTest "" VALUE 0x1BE09A __SWORD_S 0 TestStructTypes.sTest.CONVERSION -32768 32767 FORMAT "%.15" /end CHARACTERISTIC
/begin CHARACTERISTIC TestStructTypes.ucTest "" VALUE 0x1BE099 __UBYTE_S 0 TestStructTypes.ucTest.CONVERSION 0 255 FORMAT "%.15" /end CHARACTERISTIC
/begin CHARACTERISTIC TestStructTypes.uiTest "" VALUE 0x1BE0A4 __ULONG_S 0 TestStructTypes.uiTest.CONVERSION 0 4294967295 FORMAT "%.15" /end CHARACTERISTIC
/begin CHARACTERISTIC TestStructTypes.ulTest "" VALUE 0x1BE0AC __ULONG_S 0 TestStructTypes.ulTest.CONVERSION 0 4294967295 FORMAT "%.15" /end CHARACTERISTIC
/begin CHARACTERISTIC TestStructTypes.usTest "" VALUE 0x1BE09C __UWORD_S 0 TestStructTypes.usTest.CONVERSION 0 65535 FORMAT "%.15" /end CHARACTERISTIC
/begin MEASUREMENT TestWord_001 "" UWORD TestWord_001.CONVERSION 0 0 0 255 ECU_ADDRESS 0x1BE120 FORMAT "%.0" SYMBOL_LINK "testByte000" 8 /end MEASUREMENT
/begin MEASUREMENT TestWord_003 "" UWORD TestWord_003.CONVERSION 0 0 0 255 ECU_ADDRESS 0x1BE128 FORMAT "%.0" SYMBOL_LINK "testByte000" 16 /end MEASUREMENT
/begin MEASUREMENT TestWord_004 "" UWORD TestWord_004.CONVERSION 0 0 0 255 ECU_ADDRESS 0x1BE12C FORMAT "%.0" SYMBOL_LINK "testByte000" 20 /end MEASUREMENT
/begin MEASUREMENT TestWord_005 "" UWORD TestWord_005.CONVERSION 0 0 0 255 ECU_ADDRESS 0x1BE130 FORMAT "%.0" SYMBOL_LINK "testByte000" 24 /end MEASUREMENT
/begin MEASUREMENT TestWord_006 "" UWORD TestWord_006.CONVERSION 0 0 0 255 ECU_ADDRESS 0x1BE134 FORMAT "%.0" SYMBOL_LINK "testByte000" 28 /end MEASUREMENT
/begin MEASUREMENT TestWord_007 "" UWORD TestWord_007.CONVERSION 0 0 0 255 ECU_ADDRESS 0x1BE138 FORMAT "%.0" SYMBOL_LINK "testByte000" 32 /end MEASUREMENT
/begin MEASUREMENT TestWord_008 "" UWORD TestWord_008.CONVERSION 0 0 0 255 ECU_ADDRESS 0x1BE13C FORMAT "%.0" SYMBOL_LINK "testByte000" 36 /end MEASUREMENT
/begin MEASUREMENT TestWord_009 "" UWORD TestWord_009.CONVERSION 0 0 0 255 ECU_ADDRESS 0x1BE140 FORMAT "%.0" SYMBOL_LINK "testByte000" 40 /end MEASUREMENT
/begin MEASUREMENT TestWord_011 "" UWORD TestWord_011.CONVERSION 0 0 0 255 ECU_ADDRESS 0x1BE148 FORMAT "%.0" SYMBOL_LINK "testByte000" 48 /end MEASUREMENT
/begin MEASUREMENT TestWord_012 "" UWORD TestWord_012.CONVERSION 0 0 0 255 ECU_ADDRESS 0x1BE14C FORMAT "%.0" SYMBOL_LINK "testByte000" 52 /end MEASUREMENT
/begin MEASUREMENT TestWord_013 "" UWORD TestWord_013.CONVERSION 0 0 0 255 ECU_ADDRESS 0x1BE150 FORMAT "%.0" SYMBOL_LINK "testByte000" 56 /end MEASUREMENT
/begin MEASUREMENT TestWord_014 "" UWORD TestWord_014.CONVERSION 0 0 0 255 ECU_ADDRESS 0x1BE154 FORMAT "%.0" SYMBOL_LINK "testByte000" 60 /end MEASUREMENT
/begin MEASUREMENT TestWord_017 "" UWORD TestWord_017.CONVERSION 0 0 0 255 ECU_ADDRESS 0x1BE160 FORMAT "%.0" SYMBOL_LINK "testByte000" 72 /end MEASUREMENT
/begin MEASUREMENT TestWord_020 "" UWORD TestWord_020.CONVERSION 0 0 0 255 ECU_ADDRESS 0x1BE16C FORMAT "%.0" SYMBOL_LINK "testByte000" 84 /end MEASUREMENT
/begin MEASUREMENT TestWord_021 "" UWORD TestWord_021.CONVERSION 0 0 0 255 ECU_ADDRESS 0x1BE170 FORMAT "%.0" SYMBOL_LINK "testByte000" 88 /end MEASUREMENT
/begin MEASUREMENT TestWord_025 "" UWORD TestWord_025.CONVERSION 0 0 0 255 ECU_ADDRESS 0x1BE180 FORMAT "%.0" SYMBOL_LINK "testByte000" 104 /end MEASUREMENT
/begin MEASUREMENT TestWord_026 "" UWORD TestWord_026.CONVERSION 0 0 0 255 ECU_ADDRESS 0x1BE184 FORMAT "%.0" SYMBOL_LINK "testByte000" 108 /end MEASUREMENT
/begin MEASUREMENT TestWord_027 "" UWORD TestWord_027.CONVERSION 0 0 0 255 ECU_ADDRESS 0x1BE188 FORMAT "%.0" SYMBOL_LINK "testByte000" 112 /end MEASUREMENT
/begin MEASUREMENT TestWord_028 "" UWORD TestWord_028.CONVERSION 0 0 0 255 ECU_ADDRESS 0x1BE18C FORMAT "%.0" SYMBOL_LINK "testByte000" 116 /end MEASUREMENT
/begin MEASUREMENT TestWord_029 "" UWORD TestWord_029.CONVERSION 0 0 0 255 ECU_ADDRESS 0x1BE190 FORMAT "%.0" SYMBOL_LINK "testByte000" 120 /end MEASUREMENT
/begin MEASUREMENT TestWord_031 "" UWORD TestWord_031.CONVERSION 0 0 0 255 ECU_ADDRESS 0x1BE198 FORMAT "%.0" SYMBOL_LINK "testByte000" 128 /end MEASUREMENT
/begin MEASUREMENT TestWord_032 "" UWORD TestWord_032.CONVERSION 0 0 0 255 ECU_ADDRESS 0x1BE19C FORMAT "%.0" SYMBOL_LINK "testByte000" 132 /end MEASUREMENT
/begin MEASUREMENT TestWord_033 "" UWORD TestWord_033.CONVERSION 0 0 0 255 ECU_ADDRESS 0x1BE1A0 FORMAT "%.0" SYMBOL_LINK "testByte000" 136 /end MEASUREMENT
/begin MEASUREMENT TestWord_035 "" UWORD TestWord_035.CONVERSION 0 0 0 255 ECU_ADDRESS 0x1BE1A8 FORMAT "%.0" SYMBOL_LINK "testByte000" 144 /end MEASUREMENT
/begin MEASUREMENT TestWord_036 "" UWORD TestWord_036.CONVERSION 0 0 0 255 ECU_ADDRESS 0x1BE1AC FORMAT "%.0" SYMBOL_LINK "testByte000" 148 /end MEASUREMENT
/begin MEASUREMENT TestWord_037 "" UWORD TestWord_037.CONVERSION 0 0 0 255 ECU_ADDRESS 0x1BE1B0 FORMAT "%.0" SYMBOL_LINK "testByte000" 152 /end MEASUREMENT
/begin MEASUREMENT TestWord_038 "" UWORD TestWord_038.CONVERSION 0 0 0 255 ECU_ADDRESS 0x1BE1B4 FORMAT "%.0" SYMBOL_LINK "testByte000" 156 /end MEASUREMENT
/begin MEASUREMENT TestWord_039 "" UWORD TestWord_039.CONVERSION 0 0 0 255 ECU_ADDRESS 0x1BE1B8 FORMAT "%.0" SYMBOL_LINK "testByte000" 160 /end MEASUREMENT
/begin MEASUREMENT TestWord_040 "" UWORD TestWord_040.CONVERSION 0 0 0 255 ECU_ADDRESS 0x1BE1BC FORMAT "%.0" SYMBOL_LINK "testByte000" 164 /end MEASUREMENT
/begin MEASUREMENT TestWord_041 "" UWORD TestWord_041.CONVERSION 0 0 0 255 ECU_ADDRESS 0x1BE1C0 FORMAT "%.0" SYMBOL_LINK "testByte000" 168 /end MEASUREMENT
/begin MEASUREMENT TestWord_042 "" UWORD TestWord_042.CONVERSION 0 0 0 255 ECU_ADDRESS 0x1BE1C4 FORMAT "%.0" SYMBOL_LINK "testByte000" 172 /end MEASUREMENT
/begin MEASUREMENT TestWord_043 "" UWORD TestWord_043.CONVERSION 0 0 0 255 ECU_ADDRESS 0x1BE1C8 FORMAT "%.0" SYMBOL_LINK "testByte000" 176 /end MEASUREMENT
/begin MEASUREMENT TestWord_044 "" UWORD TestWord_044.CONVERSION 0 0 0 255 ECU_ADDRESS 0x1BE1CC FORMAT "%.0" SYMBOL_LINK "testByte000" 180 /end MEASUREMENT
/begin MEASUREMENT TestWord_046 "" UWORD TestWord_046.CONVERSION 0 0 0 255 ECU_ADDRESS 0x1BE1D4 FORMAT "%.0" SYMBOL_LINK "testByte000" 188 /end MEASUREMENT
/begin MEASUREMENT TestWord_048 "" UWORD TestWord_048.CONVERSION 0 0 0 255 ECU_ADDRESS 0x1BE1DC FORMAT "%.0" SYMBOL_LINK "testByte000" 196 /end MEASUREMENT
/begin MEASUREMENT TestWord_050 "" UWORD TestWord_050.CONVERSION 0 0 0 255 ECU_ADDRESS 0x1BE1E4 FORMAT "%.0" SYMBOL_LINK "testByte000" 204 /end MEASUREMENT
/begin MEASUREMENT TestWord_051 "" UWORD TestWord_051.CONVERSION 0 0 0 255 ECU_ADDRESS 0x1BE1E8 FORMAT "%.0" SYMBOL_LINK "testByte000" 208 /end MEASUREMENT
/begin MEASUREMENT TestWord_052 "" UWORD TestWord_052.CONVERSION 0 0 0 255 ECU_ADDRESS 0x1BE1EC FORMAT "%.0" SYMBOL_LINK "testByte000" 212 /end MEASUREMENT
/begin MEASUREMENT TestWord_053 "" UWORD TestWord_053.CONVERSION 0 0 0 255 ECU_ADDRESS 0x1BE1F0 FORMAT "%.0" SYMBOL_LINK "testByte000" 216 /end MEASUREMENT
/begin MEASUREMENT TestWord_054 "" UWORD TestWord_054.CONVERSION 0 0 0 255 ECU_ADDRESS 0x1BE1F4 FORMAT "%.0" SYMBOL_LINK "testByte000" 220 /end MEASUREMENT
/begin MEASUREMENT TestWord_055 "" UWORD TestWord_055.CONVERSION 0 0 0 255 ECU_ADDRESS 0x1BE1F8 FORMAT "%.0" SYMBOL_LINK "testByte000" 224 /end MEASUREMENT
/begin MEASUREMENT TestWord_058 "" UWORD TestWord_058.CONVERSION 0 0 0 255 ECU_ADDRESS 0x1BE204 FORMAT "%.0" SYMBOL_LINK "testByte000" 236 /end MEASUREMENT
/begin MEASUREMENT TestWord_060 "" UWORD TestWord_060.CONVERSION 0 0 0 255 ECU_ADDRESS 0x1BE20C FORMAT "%.0" SYMBOL_LINK "testByte000" 244 /end MEASUREMENT
/begin MEASUREMENT TestWord_062 "" UWORD TestWord_062.CONVERSION 0 0 0 255 ECU_ADDRESS 0x1BE214 FORMAT "%.0" SYMBOL_LINK "testByte000" 252 /end MEASUREMENT
/begin MEASUREMENT TestWord_065 "" UWORD TestWord_065.CONVERSION 0 0 0 255 ECU_ADDRESS 0x1BE220 FORMAT "%.0" SYMBOL_LINK "testByte000" 264 /end MEASUREMENT
/begin MEASUREMENT TestWord_068 "" UWORD TestWord_068.CONVERSION 0 0 0 255 ECU_ADDRESS 0x1BE22C FORMAT "%.0" SYMBOL_LINK "testByte000" 276 /end MEASUREMENT
/begin MEASUREMENT TestWord_069 "" UWORD TestWord_069.CONVERSION 0 0 0 255 ECU_ADDRESS 0x1BE230 FORMAT "%.0" SYMBOL_LINK "testByte000" 280 /end MEASUREMENT
/begin MEASUREMENT TestWord_070 "" UWORD TestWord_070.CONVERSION 0 0 0 255 ECU_ADDRESS 0x1BE234 FORMAT "%.0" SYMBOL_LINK "testByte000" 284 /end MEASUREMENT
/begin MEASUREMENT TestWord_071 "" UWORD TestWord_071.CONVERSION 0 0 0 255 ECU_ADDRESS 0x1BE238 FORMAT "%.0" SYMBOL_LINK "testByte000" 288 /end MEASUREMENT
/begin MEASUREMENT TestWord_072 "" UWORD TestWord_072.CONVERSION 0 0 0 255 ECU_ADDRESS 0x1BE23C FORMAT "%.0" SYMBOL_LINK "testByte000" 292 /end MEASUREMENT
/begin MEASUREMENT TestWord_074 "" UWORD TestWord_074.CONVERSION 0 0 0 255 ECU_ADDRESS 0x1BE244 FORMAT "%.0" SYMBOL_LINK "testByte000" 300 /end MEASUREMENT
/begin MEASUREMENT TestWord_075 "" UWORD TestWord_075.CONVERSION 0 0 0 255 ECU_ADDRESS 0x1BE248 FORMAT "%.0" SYMBOL_LINK "testByte000" 304 /end MEASUREMENT
/begin MEASUREMENT TestWord_076 "" UWORD TestWord_076.CONVERSION 0 0 0 255 ECU_ADDRESS 0x1BE24C FORMAT "%.0" SYMBOL_LINK "testByte000" 308 /end MEASUREMENT
/begin MEASUREMENT TestWord_077 "" UWORD TestWord_077.CONVERSION 0 0 0 255 ECU_ADDRESS 0x1BE250 FORMAT "%.0" SYMBOL_LINK "testByte000" 312 /end MEASUREMENT
/begin MEASUREMENT TestWord_078 "" UWORD TestWord_078.CONVERSION 0 0 0 255 ECU_ADDRESS 0x1BE254 FORMAT "%.0" SYMBOL_LINK "testByte000" 316 /end MEASUREMENT
/begin MEASUREMENT TestWord_080 "" UWORD TestWord_080.CONVERSION 0 0 0 255 ECU_ADDRESS 0x1BE25C FORMAT "%.0" SYMBOL_LINK "testByte000" 324 /end MEASUREMENT
/begin MEASUREMENT TestWord_081 "" UWORD TestWord_081.CONVERSION 0 0 0 255 ECU_ADDRESS 0x1BE260 FORMAT "%.0" SYMBOL_LINK "testByte000" 328 /end MEASUREMENT
/begin MEASUREMENT TestWord_082 "" UWORD TestWord_082.CONVERSION 0 0 0 255 ECU_ADDRESS 0x1BE264 FORMAT "%.0" SYMBOL_LINK "testByte000" 332 /end MEASUREMENT
/begin MEASUREMENT TestWord_083 "" UWORD TestWord_083.CONVERSION 0 0 0 255 ECU_ADDRESS 0x1BE268 FORMAT "%.0" SYMBOL_LINK "testByte000" 336 /end MEASUREMENT
/begin MEASUREMENT TestWord_084 "" UWORD TestWord_084.CONVERSION 0 0 0 255 ECU_ADDRESS 0x1BE26C FORMAT "%.0" SYMBOL_LINK "testByte000" 340 /end MEASUREMENT
/begin MEASUREMENT TestWord_085 "" UWORD TestWord_085.CONVERSION 0 0 0 255 ECU_ADDRESS 0x1BE270 FORMAT "%.0" SYMBOL_LINK "testByte000" 344 /end MEASUREMENT
/begin MEASUREMENT TestWord_088 "" UWORD TestWord_088.CONVERSION 0 0 0 255 ECU_ADDRESS 0x1BE27C FORMAT "%.0" SYMBOL_LINK "testByte000" 356 /end MEASUREMENT
/begin MEASUREMENT TestWord_089 "" UWORD TestWord_089.CONVERSION 0 0 0 255 ECU_ADDRESS 0x1BE280 FORMAT "%.0" SYMBOL_LINK "testByte000" 360 /end MEASUREMENT
/begin MEASUREMENT TestWord_090 "" UWORD TestWord_090.CONVERSION 0 0 0 255 ECU_ADDRESS 0x1BE284 FORMAT "%.0" SYMBOL_LINK "testByte000" 364 /end MEASUREMENT
/begin MEASUREMENT TestWord_091 "" UWORD TestWord_091.CONVERSION 0 0 0 255 ECU_ADDRESS 0x1BE288 FORMAT "%.0" SYMBOL_LINK "testByte000" 368 /end MEASUREMENT
/begin MEASUREMENT TestWord_092 "" UWORD TestWord_092.CONVERSION 0 0 0 255 ECU_ADDRESS 0x1BE28C FORMAT "%.0" SYMBOL_LINK "testByte000" 372 /end MEASUREMENT
/begin MEASUREMENT TestWord_093 "" UWORD TestWord_093.CONVERSION 0 0 0 255 ECU_ADDRESS 0x1BE290 FORMAT "%.0" SYMBOL_LINK "testByte000" 376 /end MEASUREMENT
/begin MEASUREMENT Triangle "Triangle test signal used for PWM output PWM" SBYTE Triangle.CONVERSION 0 0 -50 50 ECU_ADDRESS 0x1BDDDE FORMAT "%.3" SYMBOL_LINK "sbyteTriangle" 0 /end MEASUREMENT
/begin CHARACTERISTIC a0 "Digital Filter v=(vin*a0+v*b0)/c0" VALUE 0x1C00A0 __UWORD_S 0 DigitalFilterConversion 0 1 FORMAT "%.3" SYMBOL_LINK "a" 0 /end CHARACTERISTIC
/begin CHARACTERISTIC ampl "Amplitude of channel 1-3 " VALUE 0x1C002C __FLOAT32_IEEE_S 0 ampl.CONVERSION 0 200 FORMAT "%.3" /end CHARACTERISTIC
/begin CHARACTERISTIC ampl_d "" VALUE 0x1C0058 __FLOAT64_IEEE_S 0 ampl_d.CONVERSION 0 100 FORMAT "%.12" /end CHARACTERISTIC
/begin CHARACTERISTIC b0 "Digital Filter v=(vin*a0+v*b0)/c0" VALUE 0x1C00A4 __UWORD_S 0 DigitalFilterConversion 0 1 FORMAT "%.3" SYMBOL_LINK "b" 0 /end CHARACTERISTIC
/begin MEASUREMENT bit12Counter "Demo signal (12 bit, incrementing)" UWORD bit12Counter.CONVERSION 0 0 0 4095 ECU_ADDRESS 0x1BE05C FORMAT "%.3" SYMBOL_LINK "wordCounter" 0 /end MEASUREMENT
/begin CHARACTERISTIC byte1 "Demo, read and write possible" VALUE 0x1C00A6 CurveVub 0 byte1.CONVERSION 0 255 FORMAT "%.3" /end CHARACTERISTIC
/begin CHARACTERISTIC byte2 "Demo, read and write possible" VALUE 0x1C00A7 CurveVub 0 byte2.CONVERSION 0 255 FORMAT "%.3" /end CHARACTERISTIC
/begin CHARACTERISTIC byte3 "Demo, read and write possible" VALUE 0x1C00AA CurveVub 0 byte3.CONVERSION 0 255 FORMAT "%.3" /end CHARACTERISTIC
/begin CHARACTERISTIC byte4 "Demo, read and write possible" VALUE 0x1C00AB CurveVub 0 byte4.CONVERSION 0 255 FORMAT "%.3" /end CHARACTERISTIC
/begin MEASUREMENT byteCounter "Demo signal (byte, incrementing)" UBYTE byteCounter.CONVERSION 0 0 0 255 ECU_ADDRESS 0x1BDCB3 FORMAT "%.3" /end MEASUREMENT
/begin CHARACTERISTIC bytePWMFilter "Filter constant for PWM filter" VALUE 0x1C00A3 CurveVub 0 bytePWMFilter.CONVERSION 0 100 FORMAT "%.3" /end CHARACTERISTIC
/begin CHARACTERISTIC c0 "Digital Filter v=(vin*a0+v*b0)/c0" VALUE 0x1C00A8 __UWORD_S 0 DigitalFilterConversion 0 1 FORMAT "%.3" SYMBOL_LINK "c" 0 /end CHARACTERISTIC
/begin MEASUREMENT channel1 "FLOAT demo signal (sine wave)" FLOAT32_IEEE channel1.CONVERSION 0 0 -1e+12 1e+12 ECU_ADDRESS 0x1BD004 FORMAT "%.3" /end MEASUREMENT
/begin MEASUREMENT channel2 "FLOAT demo signal (sine wave)" FLOAT32_IEEE channel2.CONVERSION 0 0 -1e+12 1e+12 ECU_ADDRESS 0x1BD008 FORMAT "%.3" /end MEASUREMENT
/begin MEASUREMENT channel3 "FLOAT demo signal (sine wave)" FLOAT32_IEEE channel3.CONVERSION 0 0 -100 100 ECU_ADDRESS 0x1BD00C FORMAT "%.3" /end MEASUREMENT
/begin MEASUREMENT channel_d "" FLOAT64_IEEE channel_d.CONVERSION 0 0 -100 100 ECU_ADDRESS 0x1BD028 FORMAT "%.12" /end MEASUREMENT
/begin CHARACTERISTIC curve_kl2 "" CURVE 0x1C09B0 __UBYTE_Z 0 NO_COMPU_METHOD 0 255
 /begin AXIS_DESCR FIX_AXIS NO_INPUT_QUANTITY NO_COMPU_METHOD 8 0 255 READ_ONLY FORMAT "%.15" FIX_AXIS_PAR_DIST 0 1 8 /end AXIS_DESCR
 FORMAT "%.15" /end CHARACTERISTIC
/begin MEASUREMENT dwordCounter "Demo signal (dword, incrementing)" ULONG dwordCounter.CONVERSION 0 0 0 255 ECU_ADDRESS 0x1BE060 FORMAT "%.3" /end MEASUREMENT
/begin MEASUREMENT floatTestParam1 "" FLOAT32_IEEE NO_COMPU_METHOD 0 0 -3.40282346639e+38 3.40282346639e+38 READ_WRITE ECU_ADDRESS 0x1BE034 FORMAT "%.15" /end MEASUREMENT
/begin MEASUREMENT floatTestParam1_mea "" FLOAT32_IEEE NO_COMPU_METHOD 0 0 -3.40282346639e+38 3.40282346639e+38 ECU_ADDRESS 0x1BE034 FORMAT "%.15" SYMBOL_LINK "floatTestParam1" 0 /end MEASUREMENT
/begin MEASUREMENT floatTestParam2 "" FLOAT32_IEEE NO_COMPU_METHOD 0 0 -3.40282346639e+38 3.40282346639e+38 READ_WRITE ECU_ADDRESS 0x1BE038 FORMAT "%.15" /end MEASUREMENT
/begin MEASUREMENT floatTestParam2_mea "" FLOAT32_IEEE NO_COMPU_METHOD 0 0 -3.40282346639e+38 3.40282346639e+38 ECU_ADDRESS 0x1BE038 FORMAT "%.15" SYMBOL_LINK "floatTestParam2" 0 /end MEASUREMENT
/begin MEASUREMENT int16TestParam1 "" SWORD NO_COMPU_METHOD 0 0 -32768 32767 READ_WRITE ECU_ADDRESS 0x1BE04C FORMAT "%.15" /end MEASUREMENT
/begin MEASUREMENT int16TestParam1_mea "" SWORD NO_COMPU_METHOD 0 0 -32768 32767 ECU_ADDRESS 0x1BE04C FORMAT "%.15" SYMBOL_LINK "int16TestParam1" 0 /end MEASUREMENT
/begin MEASUREMENT int16TestParam2 "" SWORD NO_COMPU_METHOD 0 0 -32768 32767 READ_WRITE ECU_ADDRESS 0x1BE050 FORMAT "%.15" /end MEASUREMENT
/begin MEASUREMENT int16TestParam2_mea "" SWORD NO_COMPU_METHOD 0 0 -32768 32767 ECU_ADDRESS 0x1BE050 FORMAT "%.15" SYMBOL_LINK "int16TestParam2" 0 /end MEASUREMENT
/begin MEASUREMENT int32TestParam1 "" SLONG NO_COMPU_METHOD 0 0 -2147483648 2147483647 READ_WRITE ECU_ADDRESS 0x1BE03C FORMAT "%.15" /end MEASUREMENT
/begin MEASUREMENT int32TestParam1_mea "" SLONG NO_COMPU_METHOD 0 0 -2147483648 2147483647 ECU_ADDRESS 0x1BE03C FORMAT "%.15" SYMBOL_LINK "int32TestParam1" 0 /end MEASUREMENT
/begin MEASUREMENT int32TestParam2 "" SLONG NO_COMPU_METHOD 0 0 -2147483648 2147483647 READ_WRITE ECU_ADDRESS 0x1BE040 FORMAT "%.15" /end MEASUREMENT
/begin MEASUREMENT int32TestParam2_mea "" SLONG NO_COMPU_METHOD 0 0 -2147483648 2147483647 ECU_ADDRESS 0x1BE040 FORMAT "%.15" SYMBOL_LINK "int32TestParam2" 0 /end MEASUREMENT
/begin CHARACTERISTIC limit "Limit for channel1" VALUE 0x1C0030 __FLOAT32_IEEE_S 0 limit.CONVERSION -1e+12 1e+12 FORMAT "%.3" /end CHARACTERISTIC
/begin CHARACTERISTIC map1_8_8_uc "" MAP 0x1C00D0 __UBYTE_Z 0 NO_COMPU_METHOD 0 255
 /begin AXIS_DESCR FIX_AXIS NO_INPUT_QUANTITY NO_COMPU_METHOD 8 0 255 READ_ONLY FORMAT "%.15" FIX_AXIS_PAR_DIST 0 1 8 /end AXIS_DESCR
 /begin AXIS_DESCR FIX_AXIS NO_INPUT_QUANTITY NO_COMPU_METHOD 8 0 255 READ_ONLY FORMAT "%.15" FIX_AXIS_PAR_DIST 0 1 8 /end AXIS_DESCR
 FORMAT "%.15" /end CHARACTERISTIC
/begin CHARACTERISTIC map1_8_8_uc_measure "8*8 fixed axis,  permanently morphing" MAP 0x1BD030 __UBYTE_Z 0 NO_COMPU_METHOD 0 255
 /begin AXIS_DESCR FIX_AXIS NO_INPUT_QUANTITY NO_COMPU_METHOD 8 0 255 READ_ONLY FORMAT "%.15" FIX_AXIS_PAR_DIST 0 1 8 /end AXIS_DESCR
 /begin AXIS_DESCR FIX_AXIS NO_INPUT_QUANTITY NO_COMPU_METHOD 8 0 255 READ_ONLY FORMAT "%.15" FIX_AXIS_PAR_DIST 0 1 8 /end AXIS_DESCR
 FORMAT "%.15" /end CHARACTERISTIC
/begin CHARACTERISTIC map4_80_uc "8*8 BYTE memory layout map4_80_uc" MAP 0x1C05D0 MapX8Y8V88ub 0 map4_80_uc.CONVERSION 0 255
 /begin AXIS_DESCR STD_AXIS NO_INPUT_QUANTITY map4_80_uc_X_AXIS.CONVERSION 8 0 255 DEPOSIT ABSOLUTE FORMAT "%.3" /end AXIS_DESCR
 /begin AXIS_DESCR STD_AXIS NO_INPUT_QUANTITY map4_80_uc_Y_AXIS.CONVERSION 8 0 255 DEPOSIT ABSOLUTE FORMAT "%.3" /end AXIS_DESCR
 FORMAT "%.3" /end CHARACTERISTIC
/begin CHARACTERISTIC map5_82_uc "8*8 BYTE memory layout MapNxX8NyY8V88uc" MAP 0x1C0790 MapNxXNyYVuc 0 map5_82_uc.CONVERSION 0 255
 /begin AXIS_DESCR STD_AXIS NO_INPUT_QUANTITY map5_82_uc_X_AXIS.CONVERSION 8 0 255 DEPOSIT ABSOLUTE FORMAT "%.3" /end AXIS_DESCR
 /begin AXIS_DESCR STD_AXIS NO_INPUT_QUANTITY map5_82_uc_Y_AXIS.CONVERSION 8 0 255 DEPOSIT ABSOLUTE FORMAT "%.3" /end AXIS_DESCR
 FORMAT "%.3" /end CHARACTERISTIC
/begin MEASUREMENT noise "Random numbers" FLOAT32_IEEE noise.CONVERSION 0 0 0 255 ECU_ADDRESS 0x1BD018 FORMAT "%.3" /end MEASUREMENT
/begin MEASUREMENT noiseSignal "White noise wave signal." FLOAT64_IEEE NO_COMPU_METHOD 0 0 -10 10 ECU_ADDRESS 0x1BD0A0 FORMAT "%.15"
 /begin IF_DATA XCP
  /begin DAQ_EVENT FIXED_EVENT_LIST EVENT 0x4 /end DAQ_EVENT
 /end IF_DATA
/end MEASUREMENT
/begin CHARACTERISTIC noiseSignalAmpl "Noise signal amplitude.\r\n" VALUE 0x1C0098 __FLOAT64_IEEE_S 0 NO_COMPU_METHOD -10 10 FORMAT "%.15" /end CHARACTERISTIC
/begin CHARACTERISTIC noise_ampl "" VALUE 0x1BD01C __FLOAT32_IEEE_S 0 noise_ampl.CONVERSION 0 5 FORMAT "%.2" /end CHARACTERISTIC
/begin CHARACTERISTIC offset "Offset for channel1" VALUE 0x1C0034 __FLOAT32_IEEE_S 0 offset.CONVERSION -1e+12 1e+12 FORMAT "%.3" /end CHARACTERISTIC
/begin CHARACTERISTIC period "Period of channel 1-3" VALUE 0x1C0028 __FLOAT32_IEEE_S 0 period.CONVERSION 0 100 FORMAT "%.3" /end CHARACTERISTIC
/begin CHARACTERISTIC period_d "" VALUE 0x1C0050 __FLOAT64_IEEE_S 0 period_d.CONVERSION 0 5 FORMAT "%.12" /end CHARACTERISTIC
/begin MEASUREMENT perlin_noise "Random numbers" FLOAT32_IEEE perlin_noise.CONVERSION 0 0 0 255 ECU_ADDRESS 0x1BD020 FORMAT "%.3" /end MEASUREMENT
/begin MEASUREMENT pulseSignal "Pulse wave signal.\r\nSample rate: 100Hz" FLOAT64_IEEE NO_COMPU_METHOD 0 0 -10 10 ECU_ADDRESS 0x1BD080 FORMAT "%.15"
 /begin IF_DATA XCP
  /begin DAQ_EVENT FIXED_EVENT_LIST EVENT 0x4 /end DAQ_EVENT
 /end IF_DATA
/end MEASUREMENT
/begin CHARACTERISTIC pulseSignalAmpl "Pulse wave signal amplitude.\r\n" VALUE 0x1C0078 __FLOAT64_IEEE_S 0 NO_COMPU_METHOD -10 10 FORMAT "%.15" /end CHARACTERISTIC
/begin CHARACTERISTIC pulseSignalFreq "Pulse wave signal frequency.\r\nLimited to half of the sampling rate (50Hz) due to Nyquist sampling criterion.\r\n" VALUE 0x1C0070 __FLOAT64_IEEE_S 0 NO_COMPU_METHOD 0 50 FORMAT "%.15" /end CHARACTERISTIC
/begin MEASUREMENT pulseSignalPhase "Phase of the pulse wave signal.\r\nSample rate: 100Hz" FLOAT64_IEEE NO_COMPU_METHOD 0 0 0 1 ECU_ADDRESS 0x1BD088 FORMAT "%.15"
 /begin IF_DATA XCP
  /begin DAQ_EVENT FIXED_EVENT_LIST EVENT 0x4 /end DAQ_EVENT
 /end IF_DATA
 SYMBOL_LINK "pulsePhase" 0 /end MEASUREMENT
/begin CHARACTERISTIC pulseSignalWidth "Pulse wave signal width\r\n" VALUE 0x1C0080 __FLOAT64_IEEE_S 0 NO_COMPU_METHOD 0 1 FORMAT "%.15" /end CHARACTERISTIC
/begin MEASUREMENT sineNoiseMixFilterSignal "Sine and noise mix filtered wave signal.\r\nSample rate: 100Hz" FLOAT64_IEEE NO_COMPU_METHOD 0 0 -10 10 READ_WRITE ECU_ADDRESS 0x1BD0B0 FORMAT "%.15"
 /begin IF_DATA XCP
  /begin DAQ_EVENT FIXED_EVENT_LIST EVENT 0x4 /end DAQ_EVENT
 /end IF_DATA
/end MEASUREMENT
/begin MEASUREMENT sineNoiseMixSignal "Sine and noise mix wave signal.\r\nSample rate: 100Hz" FLOAT64_IEEE NO_COMPU_METHOD 0 0 -10 10 ECU_ADDRESS 0x1BD0A8 FORMAT "%.15"
 /begin IF_DATA XCP
  /begin DAQ_EVENT FIXED_EVENT_LIST EVENT 0x4 /end DAQ_EVENT
 /end IF_DATA
/end MEASUREMENT
/begin MEASUREMENT sineSignal "Sine wave signal.\r\nSample rate: 100Hz" FLOAT64_IEEE NO_COMPU_METHOD 0 0 -10 10 ECU_ADDRESS 0x1BD070 FORMAT "%.15"
 /begin IF_DATA XCP
  /begin DAQ_EVENT FIXED_EVENT_LIST EVENT 0x4 /end DAQ_EVENT
 /end IF_DATA
/end MEASUREMENT
/begin CHARACTERISTIC sineSignalAmpl "Sine wave signal amplitude.\r\n" VALUE 0x1C0068 __FLOAT64_IEEE_S 0 NO_COMPU_METHOD -10 10 FORMAT "%.15" /end CHARACTERISTIC
/begin CHARACTERISTIC sineSignalFreq "Sine wave signal frequency.\r\nLimited to half of the sampling rate (50Hz) due to Nyquist sampling criterion.\r\n" VALUE 0x1C0060 __FLOAT64_IEEE_S 0 NO_COMPU_METHOD 0 50 FORMAT "%.15" /end CHARACTERISTIC
/begin MEASUREMENT sineSignalPhase "Phase of the sine wave signal.\r\nSample rate: 100Hz" FLOAT64_IEEE NO_COMPU_METHOD 0 0 0 1 ECU_ADDRESS 0x1BD078 FORMAT "%.15"
 /begin IF_DATA XCP
  /begin DAQ_EVENT FIXED_EVENT_LIST EVENT 0x4 /end DAQ_EVENT
 /end IF_DATA
 SYMBOL_LINK "sinePhase" 0 /end MEASUREMENT
/begin MEASUREMENT syncArrayStruct.mem_charArray[000] "" SBYTE NO_COMPU_METHOD 0 0 -128 127 ECU_ADDRESS 0x1BF48C FORMAT "%.15" /end MEASUREMENT
/begin MEASUREMENT syncArrayStruct.mem_charArray[001] "" SBYTE NO_COMPU_METHOD 0 0 -128 127 ECU_ADDRESS 0x1BF48D FORMAT "%.15" /end MEASUREMENT
/begin MEASUREMENT syncArrayStruct.mem_doubleArray[000] "" FLOAT64_IEEE NO_COMPU_METHOD 0 0 -1.7e+308 1.7e+308 ECU_ADDRESS 0x1BF470 FORMAT "%.15" /end MEASUREMENT
/begin MEASUREMENT syncArrayStruct.mem_doubleArray[001] "" FLOAT64_IEEE NO_COMPU_METHOD 0 0 -1.7e+308 1.7e+308 ECU_ADDRESS 0x1BF478 FORMAT "%.15" /end MEASUREMENT
/begin MEASUREMENT syncArrayStruct.mem_floatArray[000] "" FLOAT32_IEEE NO_COMPU_METHOD 0 0 -3.4e+38 3.4e+38 ECU_ADDRESS 0x1BF480 FORMAT "%.15" /end MEASUREMENT
/begin MEASUREMENT syncArrayStruct.mem_floatArray[001] "" FLOAT32_IEEE NO_COMPU_METHOD 0 0 -3.4e+38 3.4e+38 ECU_ADDRESS 0x1BF484 FORMAT "%.15" /end MEASUREMENT
/begin MEASUREMENT syncArrayStruct.mem_floatArray[002] "" FLOAT32_IEEE NO_COMPU_METHOD 0 0 -3.4e+38 3.4e+38 ECU_ADDRESS 0x1BF488 FORMAT "%.15" /end MEASUREMENT
/begin MEASUREMENT syncArrayStruct.mem_intArray[000] "" SLONG NO_COMPU_METHOD 0 0 -2147483648 2147483647 ECU_ADDRESS 0x1BF49C FORMAT "%.15" /end MEASUREMENT
/begin MEASUREMENT syncArrayStruct.mem_intArray[001] "" SLONG NO_COMPU_METHOD 0 0 -2147483648 2147483647 ECU_ADDRESS 0x1BF4A0 FORMAT "%.15" /end MEASUREMENT
/begin MEASUREMENT syncArrayStruct.mem_longArray[000] "" SLONG NO_COMPU_METHOD 0 0 -2147483648 2147483647 ECU_ADDRESS 0x1BF4B0 FORMAT "%.15" /end MEASUREMENT
/begin MEASUREMENT syncArrayStruct.mem_longArray[001] "" SLONG NO_COMPU_METHOD 0 0 -2147483648 2147483647 ECU_ADDRESS 0x1BF4B4 FORMAT "%.15" /end MEASUREMENT
/begin MEASUREMENT syncArrayStruct.mem_shortArray[000] "" SWORD NO_COMPU_METHOD 0 0 -32768 32767 ECU_ADDRESS 0x1BF492 FORMAT "%.15" /end MEASUREMENT
/begin MEASUREMENT syncArrayStruct.mem_shortArray[001] "" SWORD NO_COMPU_METHOD 0 0 -32768 32767 ECU_ADDRESS 0x1BF494 FORMAT "%.15" /end MEASUREMENT
/begin MEASUREMENT syncArrayStruct.mem_structArray[000].mem_int "" SLONG NO_COMPU_METHOD 0 0 -2147483648 2147483647 ECU_ADDRESS 0x1BF4C4 FORMAT "%.15" /end MEASUREMENT
/begin MEASUREMENT syncArrayStruct.mem_structArray[000].mem_uint "" ULONG NO_COMPU_METHOD 0 0 0 4294967295 ECU_ADDRESS 0x1BF4C8 FORMAT "%.15" /end MEASUREMENT
/begin MEASUREMENT syncArrayStruct.mem_structArray[001].mem_int "" SLONG NO_COMPU_METHOD 0 0 -2147483648 2147483647 ECU_ADDRESS 0x1BF4CC FORMAT "%.15" /end MEASUREMENT
/begin MEASUREMENT syncArrayStruct.mem_structArray[001].mem_uint "" ULONG NO_COMPU_METHOD 0 0 0 4294967295 ECU_ADDRESS 0x1BF4D0 FORMAT "%.15" /end MEASUREMENT
/begin MEASUREMENT syncArrayStruct.mem_ucharArray[000] "" UBYTE NO_COMPU_METHOD 0 0 0 255 ECU_ADDRESS 0x1BF48E FORMAT "%.15" /end MEASUREMENT
/begin MEASUREMENT syncArrayStruct.mem_ucharArray[001] "" UBYTE NO_COMPU_METHOD 0 0 0 255 ECU_ADDRESS 0x1BF48F FORMAT "%.15" /end MEASUREMENT
/begin MEASUREMENT syncArrayStruct.mem_ucharArray[002] "" UBYTE NO_COMPU_METHOD 0 0 0 255 ECU_ADDRESS 0x1BF490 FORMAT "%.15" /end MEASUREMENT
/begin MEASUREMENT syncArrayStruct.mem_uintArray[000] "" ULONG NO_COMPU_METHOD 0 0 0 4294967295 ECU_ADDRESS 0x1BF4A4 FORMAT "%.15" /end MEASUREMENT
/begin MEASUREMENT syncArrayStruct.mem_uintArray[001] "" ULONG NO_COMPU_METHOD 0 0 0 4294967295 ECU_ADDRESS 0x1BF4A8 FORMAT "%.15" /end MEASUREMENT
/begin MEASUREMENT syncArrayStruct.mem_uintArray[002] "" ULONG NO_COMPU_METHOD 0 0 0 4294967295 ECU_ADDRESS 0x1BF4AC FORMAT "%.15" /end MEASUREMENT
/begin MEASUREMENT syncArrayStruct.mem_ulongArray[000] "" ULONG NO_COMPU_METHOD 0 0 0 4294967295 ECU_ADDRESS 0x1BF4B8 FORMAT "%.15" /end MEASUREMENT
/begin MEASUREMENT syncArrayStruct.mem_ulongArray[001] "" ULONG NO_COMPU_METHOD 0 0 0 4294967295 ECU_ADDRESS 0x1BF4BC FORMAT "%.15" /end MEASUREMENT
/begin MEASUREMENT syncArrayStruct.mem_ulongArray[002] "" ULONG NO_COMPU_METHOD 0 0 0 4294967295 ECU_ADDRESS 0x1BF4C0 FORMAT "%.15" /end MEASUREMENT
/begin MEASUREMENT syncArrayStruct.mem_ushortArray[000] "" UWORD NO_COMPU_METHOD 0 0 0 65535 ECU_ADDRESS 0x1BF496 FORMAT "%.15" /end MEASUREMENT
/begin MEASUREMENT syncArrayStruct.mem_ushortArray[001] "" UWORD NO_COMPU_METHOD 0 0 0 65535 ECU_ADDRESS 0x1BF498 FORMAT "%.15" /end MEASUREMENT
/begin MEASUREMENT syncArrayStruct.mem_ushortArray[002] "" UWORD NO_COMPU_METHOD 0 0 0 65535 ECU_ADDRESS 0x1BF49A FORMAT "%.15" /end MEASUREMENT
/begin MEASUREMENT syncCounter_char "" SBYTE NO_COMPU_METHOD 0 0 -128 127 ECU_ADDRESS 0x1BDF17 FORMAT "%.15" /end MEASUREMENT
/begin MEASUREMENT syncCounter_double "" FLOAT64_IEEE NO_COMPU_METHOD 0 0 -1.7e+308 1.7e+308 ECU_ADDRESS 0x1BF440 FORMAT "%.15" /end MEASUREMENT
/begin MEASUREMENT syncCounter_float "" FLOAT32_IEEE NO_COMPU_METHOD 0 0 -3.4e+38 3.4e+38 ECU_ADDRESS 0x1BF448 FORMAT "%.15" /end MEASUREMENT
/begin MEASUREMENT syncCounter_int "" SLONG NO_COMPU_METHOD 0 0 -2147483648 2147483647 ECU_ADDRESS 0x1BF454 FORMAT "%.15" /end MEASUREMENT
/begin MEASUREMENT syncCounter_long "" SLONG NO_COMPU_METHOD 0 0 -2147483648 2147483647 ECU_ADDRESS 0x1BF45C FORMAT "%.15" /end MEASUREMENT
/begin MEASUREMENT syncCounter_short "" SWORD NO_COMPU_METHOD 0 0 -32768 32767 ECU_ADDRESS 0x1BF44C FORMAT "%.15" /end MEASUREMENT
/begin MEASUREMENT syncCounter_uchar "" UBYTE NO_COMPU_METHOD 0 0 0 255 ECU_ADDRESS 0x1BDF22 FORMAT "%.15" /end MEASUREMENT
/begin MEASUREMENT syncCounter_uint "" ULONG NO_COMPU_METHOD 0 0 0 4294967295 ECU_ADDRESS 0x1BF458 FORMAT "%.15" /end MEASUREMENT
/begin MEASUREMENT syncCounter_ulong "" ULONG NO_COMPU_METHOD 0 0 0 4294967295 ECU_ADDRESS 0x1BF460 FORMAT "%.15" /end MEASUREMENT
/begin MEASUREMENT syncCounter_ushort "" UWORD NO_COMPU_METHOD 0 0 0 65535 ECU_ADDRESS 0x1BF450 FORMAT "%.15" /end MEASUREMENT
/begin MEASUREMENT syncStructArray[000].mem_char "" SBYTE NO_COMPU_METHOD 0 0 -128 127 ECU_ADDRESS 0x1BF4E4 FORMAT "%.15" /end MEASUREMENT
/begin MEASUREMENT syncStructArray[000].mem_double "" FLOAT64_IEEE NO_COMPU_METHOD 0 0 -1.7e+308 1.7e+308 ECU_ADDRESS 0x1BF4D8 FORMAT "%.15" /end MEASUREMENT
/begin MEASUREMENT syncStructArray[000].mem_float "" FLOAT32_IEEE NO_COMPU_METHOD 0 0 -3.4e+38 3.4e+38 ECU_ADDRESS 0x1BF4E0 FORMAT "%.15" /end MEASUREMENT
/begin MEASUREMENT syncStructArray[000].mem_uchar "" UBYTE NO_COMPU_METHOD 0 0 0 255 ECU_ADDRESS 0x1BF4E5 FORMAT "%.15" /end MEASUREMENT
/begin MEASUREMENT syncStructArray[001].mem_char "" SBYTE NO_COMPU_METHOD 0 0 -128 127 ECU_ADDRESS 0x1BF4F4 FORMAT "%.15" /end MEASUREMENT
/begin MEASUREMENT syncStructArray[001].mem_double "" FLOAT64_IEEE NO_COMPU_METHOD 0 0 -1.7e+308 1.7e+308 ECU_ADDRESS 0x1BF4E8 FORMAT "%.15" /end MEASUREMENT
/begin MEASUREMENT syncStructArray[001].mem_float "" FLOAT32_IEEE NO_COMPU_METHOD 0 0 -3.4e+38 3.4e+38 ECU_ADDRESS 0x1BF4F0 FORMAT "%.15" /end MEASUREMENT
/begin MEASUREMENT syncStructArray[001].mem_uchar "" UBYTE NO_COMPU_METHOD 0 0 0 255 ECU_ADDRESS 0x1BF4F5 FORMAT "%.15" /end MEASUREMENT
/begin MEASUREMENT syncStructArray[002].mem_char "" SBYTE NO_COMPU_METHOD 0 0 -128 127 ECU_ADDRESS 0x1BF504 FORMAT "%.15" /end MEASUREMENT
/begin MEASUREMENT syncStructArray[002].mem_double "" FLOAT64_IEEE NO_COMPU_METHOD 0 0 -1.7e+308 1.7e+308 ECU_ADDRESS 0x1BF4F8 FORMAT "%.15" /end MEASUREMENT
/begin MEASUREMENT syncStructArray[002].mem_float "" FLOAT32_IEEE NO_COMPU_METHOD 0 0 -3.4e+38 3.4e+38 ECU_ADDRESS 0x1BF500 FORMAT "%.15" /end MEASUREMENT
/begin MEASUREMENT syncStructArray[002].mem_uchar "" UBYTE NO_COMPU_METHOD 0 0 0 255 ECU_ADDRESS 0x1BF505 FORMAT "%.15" /end MEASUREMENT
/begin MEASUREMENT syncStructArray[003].mem_char "" SBYTE NO_COMPU_METHOD 0 0 -128 127 ECU_ADDRESS 0x1BF514 FORMAT "%.15" /end MEASUREMENT
/begin MEASUREMENT syncStructArray[003].mem_double "" FLOAT64_IEEE NO_COMPU_METHOD 0 0 -1.7e+308 1.7e+308 ECU_ADDRESS 0x1BF508 FORMAT "%.15" /end MEASUREMENT
/begin MEASUREMENT syncStructArray[003].mem_float "" FLOAT32_IEEE NO_COMPU_METHOD 0 0 -3.4e+38 3.4e+38 ECU_ADDRESS 0x1BF510 FORMAT "%.15" /end MEASUREMENT
/begin MEASUREMENT syncStructArray[003].mem_uchar "" UBYTE NO_COMPU_METHOD 0 0 0 255 ECU_ADDRESS 0x1BF515 FORMAT "%.15" /end MEASUREMENT
/begin MEASUREMENT tcp_ctr_rx "" UWORD NO_COMPU_METHOD 0 0 -3.4e+38 3.4e+38 ECU_ADDRESS 0x1C10CC FORMAT "%.15" /end MEASUREMENT
/begin CHARACTERISTIC testByte "" VAL_BLK 0x1BE118 __UBYTE_Z 0 NO_COMPU_METHOD 0 255 MATRIX_DIM 8 SYMBOL_LINK "testByte000" 0 FORMAT "%.15" /end CHARACTERISTIC
/begin CHARACTERISTIC testByte000 "" VALUE 0x1BE118 __UBYTE_S 0 testByte000.CONVERSION 0 255 FORMAT "%.15" /end CHARACTERISTIC
/begin CHARACTERISTIC testByte000[000] "" VALUE 0x1BE118 __UBYTE_S 0 testByte000[000].CONVERSION 0 255 FORMAT "%.15" /end CHARACTERISTIC
/begin CHARACTERISTIC testByte000[001] "" VALUE 0x1BE119 __UBYTE_S 0 testByte000[001].CONVERSION 0 255 FORMAT "%.15" /end CHARACTERISTIC
/begin CHARACTERISTIC testByte000[002] "" VALUE 0x1BE11A __UBYTE_S 0 testByte000[002].CONVERSION 0 255 FORMAT "%.15" /end CHARACTERISTIC
/begin CHARACTERISTIC testByte000[003] "" VALUE 0x1BE11B __UBYTE_S 0 testByte000[003].CONVERSION 0 255 FORMAT "%.15" /end CHARACTERISTIC
/begin CHARACTERISTIC testByte000[004] "" VALUE 0x1BE11C __UBYTE_S 0 testByte000[004].CONVERSION 0 255 FORMAT "%.15" /end CHARACTERISTIC
/begin CHARACTERISTIC testByte000[005] "" VALUE 0x1BE11D __UBYTE_S 0 testByte000[005].CONVERSION 0 255 FORMAT "%.15" /end CHARACTERISTIC
/begin CHARACTERISTIC testByte000[006] "" VALUE 0x1BE11E __UBYTE_S 0 testByte000[006].CONVERSION 0 255 FORMAT "%.15" /end CHARACTERISTIC
/begin CHARACTERISTIC testByte000[007] "" VALUE 0x1BE11F __UBYTE_S 0 testByte000[007].CONVERSION 0 255 FORMAT "%.15" /end CHARACTERISTIC
/begin CHARACTERISTIC testbit0 "" VALUE 0x1C0C58 CurveVub 0 testbit0.CONVERSION 0 1 BIT_MASK 0x1 FORMAT "%.3" SYMBOL_LINK "calram" 0 /end CHARACTERISTIC
/begin CHARACTERISTIC testbit1 "" VALUE 0x1C0C58 CurveVub 0 testbit1.CONVERSION 0 1 BIT_MASK 0x2 FORMAT "%.3" SYMBOL_LINK "calram" 0 /end CHARACTERISTIC
/begin CHARACTERISTIC testbit2 "" VALUE 0x1C0C58 CurveVub 0 testbit2.CONVERSION 0 1 BIT_MASK 0x4 FORMAT "%.3" SYMBOL_LINK "calram" 0 /end CHARACTERISTIC
/begin CHARACTERISTIC testbit3 "" VALUE 0x1C0C58 CurveVub 0 testbit3.CONVERSION 0 1 BIT_MASK 0x8 FORMAT "%.3" SYMBOL_LINK "calram" 0 /end CHARACTERISTIC
/begin CHARACTERISTIC testbit4 "" VALUE 0x1C0C58 CurveVub 0 testbit4.CONVERSION 0 1 BIT_MASK 0x10 FORMAT "%.3" SYMBOL_LINK "calram" 0 /end CHARACTERISTIC
/begin CHARACTERISTIC testbit5 "" VALUE 0x1C0C58 CurveVub 0 testbit5.CONVERSION 0 1 BIT_MASK 0x20 FORMAT "%.3" SYMBOL_LINK "calram" 0 /end CHARACTERISTIC
/begin CHARACTERISTIC testbit6 "" VALUE 0x1C0C58 CurveVub 0 testbit6.CONVERSION 0 1 BIT_MASK 0x40 FORMAT "%.3" SYMBOL_LINK "calram" 0 /end CHARACTERISTIC
/begin CHARACTERISTIC testbit7 "" VALUE 0x1C0C58 CurveVub 0 testbit7.CONVERSION 0 1 BIT_MASK 0x80 FORMAT "%.3" SYMBOL_LINK "calram" 0 /end CHARACTERISTIC
/begin CHARACTERISTIC testbitslice0 "" VALUE 0x1C0C58 CurveVub 0 testbitslice0.CONVERSION -16 15 BIT_MASK 0x1F FORMAT "%.3" SYMBOL_LINK "calram" 0 /end CHARACTERISTIC
/begin CHARACTERISTIC testbitslice1 "" VALUE 0x1C0C58 CurveVub 0 testbitslice1.CONVERSION -16 15 BIT_MASK 0x3E0 FORMAT "%.3" SYMBOL_LINK "calram" 0 /end CHARACTERISTIC
/begin CHARACTERISTIC testbitslice2 "" VALUE 0x1C0C59 CurveVub 0 testbitslice2.CONVERSION -32 31 BIT_MASK 0xFC FORMAT "%.3" SYMBOL_LINK "calram" 1 /end CHARACTERISTIC
/begin CHARACTERISTIC testbyte0 "" VALUE 0x1C0C58 CurveVub 0 testbyte0.CONVERSION -128 127 FORMAT "%.3" SYMBOL_LINK "calram" 0 /end CHARACTERISTIC
/begin CHARACTERISTIC testbyte1 "" VALUE 0x1C0C59 CurveVub 0 testbyte1.CONVERSION -128 127 FORMAT "%.3" SYMBOL_LINK "calram" 1 /end CHARACTERISTIC
/begin CHARACTERISTIC testbyte2 "" VALUE 0x1C0C5A CurveVub 0 testbyte2.CONVERSION -128 127 FORMAT "%.3" SYMBOL_LINK "calram" 2 /end CHARACTERISTIC
/begin CHARACTERISTIC testbyte3 "" VALUE 0x1C0C5B CurveVub 0 testbyte3.CONVERSION -128 127 FORMAT "%.3" SYMBOL_LINK "calram" 3 /end CHARACTERISTIC
/begin CHARACTERISTIC testbyte4 "" VALUE 0x1C0C5C CurveVub 0 testbyte4.CONVERSION -128 127 FORMAT "%.3" SYMBOL_LINK "calram" 4 /end CHARACTERISTIC
/begin CHARACTERISTIC testbyte5 "" VALUE 0x1C0C5D CurveVub 0 testbyte5.CONVERSION -128 127 FORMAT "%.3" SYMBOL_LINK "calram" 5 /end CHARACTERISTIC
/begin CHARACTERISTIC testbyte6 "" VALUE 0x1C0C5E CurveVub 0 testbyte6.CONVERSION -128 127 FORMAT "%.3" SYMBOL_LINK "calram" 6 /end CHARACTERISTIC
/begin CHARACTERISTIC testbyte7 "" VALUE 0x1C0C5F CurveVub 0 testbyte7.CONVERSION -128 127 FORMAT "%.3" SYMBOL_LINK "calram" 7 /end CHARACTERISTIC
/begin CHARACTERISTIC testdword0 "" VALUE 0x1C0C58 CurveVub 0 testdword0.CONVERSION -2147480000 2147480000 FORMAT "%.3" SYMBOL_LINK "calram" 0 /end CHARACTERISTIC
/begin CHARACTERISTIC testdword1 "" VALUE 0x1C0C5C CurveVub 0 testdword1.CONVERSION -2147480000 2147480000 FORMAT "%.3" SYMBOL_LINK "calram" 4 /end CHARACTERISTIC
/begin CHARACTERISTIC testubitslice0 "" VALUE 0x1C0C58 CurveVub 0 testubitslice0.CONVERSION 0 31 BIT_MASK 0x1F FORMAT "%.3" SYMBOL_LINK "calram" 0 /end CHARACTERISTIC
/begin CHARACTERISTIC testubitslice1 "" VALUE 0x1C0C58 CurveVub 0 testubitslice1.CONVERSION 0 31 BIT_MASK 0x3E0 FORMAT "%.3" SYMBOL_LINK "calram" 0 /end CHARACTERISTIC
/begin CHARACTERISTIC testubitslice2 "" VALUE 0x1C0C59 CurveVub 0 testubitslice2.CONVERSION 0 63 BIT_MASK 0xFC FORMAT "%.3" SYMBOL_LINK "calram" 1 /end CHARACTERISTIC
/begin CHARACTERISTIC testubyte0 "" VALUE 0x1C0C58 CurveVub 0 testubyte0.CONVERSION 0 255 FORMAT "%.3" SYMBOL_LINK "calram" 0 /end CHARACTERISTIC
/begin CHARACTERISTIC testubyte1 "" VALUE 0x1C0C59 CurveVub 0 testubyte1.CONVERSION 0 255 FORMAT "%.3" SYMBOL_LINK "calram" 1 /end CHARACTERISTIC
/begin CHARACTERISTIC testubyte2 "" VALUE 0x1C0C5A CurveVub 0 testubyte2.CONVERSION 0 255 FORMAT "%.3" SYMBOL_LINK "calram" 2 /end CHARACTERISTIC
/begin CHARACTERISTIC testubyte3 "" VALUE 0x1C0C5B CurveVub 0 testubyte3.CONVERSION 0 255 FORMAT "%.3" SYMBOL_LINK "calram" 3 /end CHARACTERISTIC
/begin CHARACTERISTIC testubyte4 "" VALUE 0x1C0C5C CurveVub 0 testubyte4.CONVERSION 0 255 FORMAT "%.3" SYMBOL_LINK "calram" 4 /end CHARACTERISTIC
/begin CHARACTERISTIC testubyte5 "" VALUE 0x1C0C5D CurveVub 0 testubyte5.CONVERSION 0 255 FORMAT "%.3" SYMBOL_LINK "calram" 5 /end CHARACTERISTIC
/begin CHARACTERISTIC testubyte6 "" VALUE 0x1C0C5E CurveVub 0 testubyte6.CONVERSION 0 255 FORMAT "%.3" SYMBOL_LINK "calram" 6 /end CHARACTERISTIC
/begin CHARACTERISTIC testubyte7 "" VALUE 0x1C0C5F CurveVub 0 testubyte7.CONVERSION 0 255 FORMAT "%.3" SYMBOL_LINK "calram" 7 /end CHARACTERISTIC
/begin CHARACTERISTIC testudword0 "" VALUE 0x1C0C58 __ULONG_S 0 testudword0.CONVERSION 0 4294970000 FORMAT "%.3" SYMBOL_LINK "calram" 0 /end CHARACTERISTIC
/begin CHARACTERISTIC testudword1 "" VALUE 0x1C0C5C __ULONG_S 0 testudword1.CONVERSION 0 4294970000 FORMAT "%.3" SYMBOL_LINK "calram" 4 /end CHARACTERISTIC
/begin CHARACTERISTIC testuword0 "" VALUE 0x1C0C58 MapColRowuw 0 testuword0.CONVERSION 0 65536 FORMAT "%.3" SYMBOL_LINK "calram" 0 /end CHARACTERISTIC
/begin CHARACTERISTIC testuword1 "" VALUE 0x1C0C5A MapColRowuw 0 testuword1.CONVERSION 0 65536 FORMAT "%.3" SYMBOL_LINK "calram" 2 /end CHARACTERISTIC
/begin CHARACTERISTIC testuword2 "" VALUE 0x1C0C5C MapColRowuw 0 testuword2.CONVERSION 0 65536 FORMAT "%.3" SYMBOL_LINK "calram" 4 /end CHARACTERISTIC
/begin CHARACTERISTIC testuword3 "" VALUE 0x1C0C5E MapColRowuw 0 testuword3.CONVERSION 0 65536 FORMAT "%.3" SYMBOL_LINK "calram" 6 /end CHARACTERISTIC
/begin CHARACTERISTIC testword0 "" VALUE 0x1C0C58 __SWORD_S 0 testword0.CONVERSION -32768 32767 FORMAT "%.3" SYMBOL_LINK "calram" 0 /end CHARACTERISTIC
/begin CHARACTERISTIC testword1 "" VALUE 0x1C0C5A __SWORD_S 0 testword1.CONVERSION -32768 32767 FORMAT "%.3" SYMBOL_LINK "calram" 2 /end CHARACTERISTIC
/begin CHARACTERISTIC testword2 "" VALUE 0x1C0C5C __SWORD_S 0 testword2.CONVERSION -32768 32767 FORMAT "%.3" SYMBOL_LINK "calram" 4 /end CHARACTERISTIC
/begin CHARACTERISTIC testword3 "" VALUE 0x1C0C5E __SWORD_S 0 testword3.CONVERSION -32768 32767 FORMAT "%.3" SYMBOL_LINK "calram" 6 /end CHARACTERISTIC
/begin MEASUREMENT triangleSignal "Triangle wave signal.\r\nSample rate: 100Hz" FLOAT64_IEEE NO_COMPU_METHOD 0 0 -10 10 ECU_ADDRESS 0x1BD090 FORMAT "%.15"
 /begin IF_DATA XCP
  /begin DAQ_EVENT FIXED_EVENT_LIST EVENT 0x4 /end DAQ_EVENT
 /end IF_DATA
/end MEASUREMENT
/begin CHARACTERISTIC triangleSignalAmpl "Triangle wave signal amplitude.\r\n" VALUE 0x1C0090 __FLOAT64_IEEE_S 0 NO_COMPU_METHOD -10 10 FORMAT "%.15" /end CHARACTERISTIC
/begin CHARACTERISTIC triangleSignalFreq "Triangle wave signal frequency.\r\nLimited to half of the sampling rate (50Hz) due to Nyquist sampling criterion.\r\n" VALUE 0x1C0088 __FLOAT64_IEEE_S 0 NO_COMPU_METHOD 0 50 FORMAT "%.15" /end CHARACTERISTIC
/begin MEASUREMENT triangleSignalPhase "Phase of the triangle wave signal.\r\nSample rate: 100Hz" FLOAT64_IEEE NO_COMPU_METHOD 0 0 0 1 ECU_ADDRESS 0x1BD098 FORMAT "%.15"
 /begin IF_DATA XCP
  /begin DAQ_EVENT FIXED_EVENT_LIST EVENT 0x4 /end DAQ_EVENT
 /end IF_DATA
 SYMBOL_LINK "trianglePhase" 0 /end MEASUREMENT
/begin MEASUREMENT uint16TestParam1 "" UWORD NO_COMPU_METHOD 0 0 0 65535 READ_WRITE ECU_ADDRESS 0x1BE054 FORMAT "%.15" /end MEASUREMENT
/begin MEASUREMENT uint16TestParam1_mea "" UWORD NO_COMPU_METHOD 0 0 0 65535 ECU_ADDRESS 0x1BE054 FORMAT "%.15" SYMBOL_LINK "uint16TestParam1" 0 /end MEASUREMENT
/begin MEASUREMENT uint16TestParam2 "" UWORD NO_COMPU_METHOD 0 0 0 65535 READ_WRITE ECU_ADDRESS 0x1BE058 FORMAT "%.15" /end MEASUREMENT
/begin MEASUREMENT uint16TestParam2_mea "" UWORD NO_COMPU_METHOD 0 0 0 65535 ECU_ADDRESS 0x1BE058 FORMAT "%.15" SYMBOL_LINK "uint16TestParam2" 0 /end MEASUREMENT
/begin MEASUREMENT uint32TestParam1 "" ULONG NO_COMPU_METHOD 0 0 0 4294967295 READ_WRITE ECU_ADDRESS 0x1BE044 FORMAT "%.15" /end MEASUREMENT
/begin MEASUREMENT uint32TestParam1_mea "" ULONG NO_COMPU_METHOD 0 0 0 4294967295 ECU_ADDRESS 0x1BE044 FORMAT "%.15" SYMBOL_LINK "uint32TestParam1" 0 /end MEASUREMENT
/begin MEASUREMENT uint32TestParam2 "" ULONG NO_COMPU_METHOD 0 0 0 4294967295 READ_WRITE ECU_ADDRESS 0x1BE048 FORMAT "%.15" /end MEASUREMENT
/begin MEASUREMENT uint32TestParam2_mea "" ULONG NO_COMPU_METHOD 0 0 0 4294967295 ECU_ADDRESS 0x1BE048 FORMAT "%.15" SYMBOL_LINK "uint32TestParam2" 0 /end MEASUREMENT
/begin MEASUREMENT v "Digital Filter Outputvalue" UWORD DigitalFilterConversion 0 0 0 1 READ_WRITE ECU_ADDRESS 0x1BE074 FORMAT "%.3" /end MEASUREMENT
/begin MEASUREMENT vin "Digital Filter Inputvalue" UWORD DigitalFilterConversion 0 0 0 1 READ_WRITE ECU_ADDRESS 0x1BE070 FORMAT "%.3" /end MEASUREMENT
/begin MEASUREMENT wordCounter "Demo signal (word, incrementing)" UWORD wordCounter.CONVERSION 0 0 0 65535 ECU_ADDRESS 0x1BE05C FORMAT "%.3" /end MEASUREMENT
/begin GROUP Arrays "Kommentar" ROOT
 /begin REF_CHARACTERISTIC testByte testByte000 testByte000[000] testByte000[001] testByte000[002] testByte000[003] testByte000[004] testByte000[005] testByte000[006] testByte000[007] /end REF_CHARACTERISTIC
/end GROUP
/begin GROUP Axis "Shared Axis for Calibration Maps" ROOT /begin REF_CHARACTERISTIC Curve1 Curve2 Curve3 /end REF_CHARACTERISTIC /end GROUP
/begin GROUP Bits "Single Bit Values"
 /begin REF_MEASUREMENT Counter_B4 Counter_B5 Counter_B6 Counter_B7 ShiftByte Shifter_B0 Shifter_B1 Shifter_B2 Shifter_B3 /end REF_MEASUREMENT
/end GROUP
/begin GROUP Bitslices "Multibit Values" /begin REF_MEASUREMENT BitSlice BitSlice0 BitSlice1 BitSlice2 TestStatus /end REF_MEASUREMENT /end GROUP
/begin GROUP BypassParameters "Test parameters for bypassing"
 /begin REF_MEASUREMENT floatTestParam1 floatTestParam1_mea floatTestParam2 floatTestParam2_mea int16TestParam1 int16TestParam1_mea int16TestParam2 int16TestParam2_mea int32TestParam1 int32TestParam1_mea int32TestParam2 int32TestParam2_mea uint16TestParam1 uint16TestParam1_mea uint16TestParam2 uint16TestParam2_mea uint32TestParam1 uint32TestParam1_mea uint32TestParam2 uint32TestParam2_mea /end REF_MEASUREMENT
/end GROUP
/begin GROUP Counters "Counter test signals" /end GROUP
/begin GROUP Curves "Calibration Curves" ROOT /begin REF_CHARACTERISTIC KL1 KL2 KL3 KL4 KL5 KL6 KL7 KL8 curve_kl2 /end REF_CHARACTERISTIC /end GROUP
/begin GROUP Example_Bypass "Test signals and parameters for bypassing" ROOT /begin SUB_GROUP BypassParameters Counters /end SUB_GROUP
 /begin REF_CHARACTERISTIC noiseSignalAmpl pulseSignalAmpl pulseSignalFreq pulseSignalWidth sineSignalAmpl sineSignalFreq triangleSignalAmpl triangleSignalFreq /end REF_CHARACTERISTIC
 /begin REF_MEASUREMENT noiseSignal pulseSignal pulseSignalPhase sineNoiseMixFilterSignal sineNoiseMixSignal sineSignal sineSignalPhase triangleSignal triangleSignalPhase /end REF_MEASUREMENT
/end GROUP
/begin GROUP Example_Double "Kommentar" ROOT /begin REF_CHARACTERISTIC ampl_d period_d /end REF_CHARACTERISTIC /begin REF_MEASUREMENT channel_d syncCounter_uint /end REF_MEASUREMENT /end GROUP
/begin GROUP Example_Filter "Digital Filter v=(vin*a0+v*b0)/c0" ROOT /begin REF_CHARACTERISTIC a0 b0 c0 /end REF_CHARACTERISTIC
 /begin REF_MEASUREMENT syncCounter_double syncCounter_ulong syncCounter_ushort v vin /end REF_MEASUREMENT
/end GROUP
/begin GROUP Example_PWM "Generator for a PWM Signal" ROOT /begin SUB_GROUP PWM_Parameters PWM_Signals /end SUB_GROUP
 /begin REF_MEASUREMENT syncArrayStruct.mem_charArray[000] syncArrayStruct.mem_charArray[001] syncArrayStruct.mem_doubleArray[000] syncArrayStruct.mem_doubleArray[001] syncArrayStruct.mem_floatArray[000] syncArrayStruct.mem_floatArray[001] syncArrayStruct.mem_floatArray[002] syncArrayStruct.mem_intArray[000] syncArrayStruct.mem_intArray[001] syncArrayStruct.mem_longArray[000] syncArrayStruct.mem_longArray[001] syncArrayStruct.mem_shortArray[000] syncArrayStruct.mem_shortArray[001] syncArrayStruct.mem_structArray[000].mem_int syncArrayStruct.mem_structArray[000].mem_uint syncArrayStruct.mem_structArray[001].mem_int syncArrayStruct.mem_structArray[001].mem_uint syncArrayStruct.mem_ucharArray[000] syncArrayStruct.mem_ucharArray[001] syncArrayStruct.mem_ucharArray[002] syncArrayStruct.mem_uintArray[000] syncArrayStruct.mem_uintArray[001] syncArrayStruct.mem_uintArray[002] syncArrayStruct.mem_ulongArray[000] syncArrayStruct.mem_ulongArray[001] syncArrayStruct.mem_ulongArray[002] syncArrayStruct.mem_ushortArray[000] syncArrayStruct.mem_ushortArray[001] syncArrayStruct.mem_ushortArray[002] syncCounter_long syncCounter_uchar /end REF_MEASUREMENT
/end GROUP
/begin GROUP Lost_Found "" ROOT /end GROUP
/begin GROUP Maps "Calibration Maps" ROOT /begin SUB_GROUP WorkingPoint /end SUB_GROUP
 /begin REF_CHARACTERISTIC KF1 KF2 KF3 KF4 KF5 KF6 KF7 KF8 TestKennfeld map1_8_8_uc map1_8_8_uc_measure map4_80_uc map5_82_uc /end REF_CHARACTERISTIC
/end GROUP
/begin GROUP Measure "Measurement Values" ROOT /begin SUB_GROUP Bits Bitslices Sync_Measure Test_Signals /end SUB_GROUP /begin REF_MEASUREMENT channel1 channel2 channel3 noise perlin_noise /end REF_MEASUREMENT /end GROUP
/begin GROUP Parameters "Calibration Parameters" ROOT /begin SUB_GROUP Test_Parameters /end SUB_GROUP /begin REF_CHARACTERISTIC ampl limit noise_ampl offset period /end REF_CHARACTERISTIC /end GROUP
/begin GROUP PWM_Parameters "Parametes for PWM Example" /begin REF_CHARACTERISTIC FW1 PWM_Level bytePWMFilter /end REF_CHARACTERISTIC
 /begin REF_MEASUREMENT syncCounter_char syncCounter_short syncStructArray[000].mem_char syncStructArray[000].mem_double syncStructArray[000].mem_float syncStructArray[000].mem_uchar syncStructArray[001].mem_char syncStructArray[001].mem_double syncStructArray[001].mem_float syncStructArray[001].mem_uchar syncStructArray[002].mem_char syncStructArray[002].mem_double syncStructArray[002].mem_float syncStructArray[002].mem_uchar syncStructArray[003].mem_char syncStructArray[003].mem_double syncStructArray[003].mem_float syncStructArray[003].mem_uchar /end REF_MEASUREMENT
/end GROUP
/begin GROUP PWM_Signals "Measurement Signals from PWM" /begin REF_MEASUREMENT PWM PWMFiltered Triangle syncCounter_float syncCounter_int /end REF_MEASUREMENT /end GROUP
/begin GROUP Simulator_Behavior "" ROOT /begin REF_CHARACTERISTIC Simulator_concept /end REF_CHARACTERISTIC /end GROUP
/begin GROUP Structure_in_Structure "Kommentar"
 /begin REF_CHARACTERISTIC TestStruct1.s0 TestStruct1.s1 TestStruct2[000].s0 TestStruct2[000].s1 TestStruct2[001].s0 TestStruct2[001].s1 TestStructStruct1.TestStruct2.s0 TestStructStruct1.TestStruct2.s1 TestStructStruct1.doubles TestStructStruct1.ints /end REF_CHARACTERISTIC
/end GROUP
/begin GROUP Structures "Examples for structures" ROOT /begin SUB_GROUP Structure_in_Structure /end SUB_GROUP
 /begin REF_CHARACTERISTIC TestStructTypes.cTest TestStructTypes.dTest TestStructTypes.fTest TestStructTypes.iTest TestStructTypes.lTest TestStructTypes.sTest TestStructTypes.ucTest TestStructTypes.uiTest TestStructTypes.ulTest TestStructTypes.usTest /end REF_CHARACTERISTIC
/end GROUP
/begin GROUP Sync_Measure "Measures which start at value zero at start of measurement"
 /begin REF_MEASUREMENT syncArrayStruct.mem_charArray[000] syncArrayStruct.mem_charArray[001] syncArrayStruct.mem_doubleArray[000] syncArrayStruct.mem_doubleArray[001] syncArrayStruct.mem_floatArray[000] syncArrayStruct.mem_floatArray[001] syncArrayStruct.mem_floatArray[002] syncArrayStruct.mem_intArray[000] syncArrayStruct.mem_intArray[001] syncArrayStruct.mem_longArray[000] syncArrayStruct.mem_longArray[001] syncArrayStruct.mem_shortArray[000] syncArrayStruct.mem_shortArray[001] syncArrayStruct.mem_structArray[000].mem_int syncArrayStruct.mem_structArray[000].mem_uint syncArrayStruct.mem_structArray[001].mem_int syncArrayStruct.mem_structArray[001].mem_uint syncArrayStruct.mem_ucharArray[000] syncArrayStruct.mem_ucharArray[001] syncArrayStruct.mem_ucharArray[002] syncArrayStruct.mem_uintArray[000] syncArrayStruct.mem_uintArray[001] syncArrayStruct.mem_uintArray[002] syncArrayStruct.mem_ulongArray[000] syncArrayStruct.mem_ulongArray[001] syncArrayStruct.mem_ulongArray[002] syncArrayStruct.mem_ushortArray[000] syncArrayStruct.mem_ushortArray[001] syncArrayStruct.mem_ushortArray[002] syncCounter_char syncCounter_double syncCounter_float syncCounter_int syncCounter_long syncCounter_short syncCounter_uchar syncCounter_uint syncCounter_ulong syncCounter_ushort syncStructArray[000].mem_char syncStructArray[000].mem_double syncStructArray[000].mem_float syncStructArray[000].mem_uchar syncStructArray[001].mem_char syncStructArray[001].mem_double syncStructArray[001].mem_float syncStructArray[001].mem_uchar syncStructArray[002].mem_char syncStructArray[002].mem_double syncStructArray[002].mem_float syncStructArray[002].mem_uchar syncStructArray[003].mem_char syncStructArray[003].mem_double syncStructArray[003].mem_float syncStructArray[003].mem_uchar /end REF_MEASUREMENT
/end GROUP
/begin GROUP Test_Parameters "Test Parameters, BYTE"
 /begin REF_CHARACTERISTIC testbit0 testbit1 testbit2 testbit3 testbit4 testbit5 testbit6 testbit7 testbitslice0 testbitslice1 testbitslice2 testbyte0 testbyte1 testbyte2 testbyte3 testbyte4 testbyte5 testbyte6 testbyte7 testdword0 testdword1 testubitslice0 testubitslice1 testubitslice2 testubyte0 testubyte1 testubyte2 testubyte3 testubyte4 testubyte5 testubyte6 testubyte7 testudword0 testudword1 testuword0 testuword1 testuword2 testuword3 testword0 testword1 testword2 testword3 /end REF_CHARACTERISTIC
 /begin REF_MEASUREMENT tcp_ctr_rx /end REF_MEASUREMENT
/end GROUP
/begin GROUP Test_Signals "Test Signals" /begin REF_CHARACTERISTIC byte1 byte2 byte3 byte4 /end REF_CHARACTERISTIC
 /begin REF_MEASUREMENT KL1Output bit12Counter byteCounter dwordCounter wordCounter /end REF_MEASUREMENT
/end GROUP
/begin GROUP TestData "Kommentar" ROOT
 /begin REF_MEASUREMENT TestByte_000 TestByte_015 TestByte_016 TestByte_023 TestByte_024 TestByte_034 TestByte_059 TestByte_061 TestByte_063 TestByte_064 TestByte_097 TestByte_107 TestByte_131 TestByte_156 TestByte_159 TestByte_182 TestByte_183 TestByte_189 TestByte_195 TestByte_216 TestByte_218 TestByte_221 TestByte_251 TestByte_263 TestByte_276 TestByte_277 TestByte_297 TestByte_302 TestByte_324 TestByte_344 TestByte_346 TestByte_354 TestByte_359 TestByte_378 TestByte_402 TestByte_403 TestByte_406 TestByte_413 TestByte_414 TestByte_415 TestByte_427 TestByte_438 TestByte_446 TestByte_448 TestByte_451 TestByte_462 TestByte_466 TestByte_469 TestByte_486 TestByte_494 TestByte_500 TestByte_527 TestByte_530 TestByte_533 TestByte_556 TestByte_589 TestByte_590 TestByte_591 TestByte_592 TestByte_598 TestByte_606 TestByte_608 TestByte_618 TestByte_621 TestByte_627 TestByte_638 TestByte_644 TestByte_647 TestByte_648 TestByte_659 TestByte_668 TestByte_700 TestByte_711 TestByte_715 TestByte_728 TestByte_731 TestByte_732 TestByte_738 TestByte_746 TestByte_752 TestByte_774 TestByte_777 TestByte_778 TestByte_784 TestByte_786 TestByte_789 TestByte_793 TestByte_798 TestByte_855 TestByte_857 TestByte_861 TestByte_865 TestByte_880 TestByte_902 TestByte_905 TestByte_934 TestByte_938 TestByte_947 TestByte_951 TestByte_961 TestByte_965 TestByte_974 TestByte_976 TestByte_981 TestByte_983 TestByte_993 TestDWord_002 TestDWord_010 TestDWord_018 TestDWord_019 TestDWord_022 TestDWord_030 TestDWord_045 TestDWord_047 TestDWord_049 TestDWord_056 TestDWord_057 TestDWord_066 TestDWord_067 TestDWord_073 TestDWord_079 TestDWord_086 TestDWord_087 TestDWord_094 TestDWord_100 TestDWord_102 TestDWord_110 TestDWord_114 TestDWord_115 TestDWord_118 TestDWord_122 TestDWord_128 TestDWord_135 TestDWord_145 TestDWord_147 TestDWord_150 TestDWord_161 TestDWord_165 TestDWord_167 TestDWord_168 TestDWord_172 TestDWord_174 TestDWord_180 TestDWord_181 TestDWord_186 TestDWord_187 TestDWord_190 TestDWord_197 TestDWord_199 TestDWord_201 TestDWord_205 TestDWord_210 TestDWord_212 TestDWord_223 TestDWord_224 TestDWord_227 TestDWord_240 TestDWord_244 TestDWord_245 TestDWord_257 TestDWord_269 TestDWord_270 TestDWord_274 TestDWord_283 TestDWord_286 TestDWord_296 TestDWord_306 TestDWord_308 TestDWord_309 TestDWord_313 TestDWord_326 TestDWord_338 TestDWord_340 TestDWord_348 TestDWord_355 TestDWord_358 TestDWord_360 TestDWord_372 TestDWord_375 TestDWord_376 TestDWord_383 TestDWord_385 TestDWord_387 TestDWord_388 TestDWord_396 TestDWord_398 TestDWord_399 TestDWord_407 TestDWord_409 TestDWord_410 TestDWord_411 TestDWord_426 TestDWord_431 TestDWord_433 TestDWord_443 TestDWord_444 TestDWord_458 TestDWord_470 TestDWord_471 TestDWord_474 TestDWord_478 TestDWord_479 TestDWord_480 TestDWord_483 TestDWord_488 TestDWord_492 TestDWord_496 TestDWord_501 TestDWord_502 TestDWord_503 TestDWord_504 TestDWord_508 TestDWord_516 TestDWord_524 TestDWord_529 TestDWord_534 TestDWord_535 TestDWord_545 TestDWord_550 TestDWord_557 TestDWord_558 TestDWord_575 TestDWord_576 TestDWord_577 TestDWord_582 TestDWord_584 TestDWord_596 TestDWord_601 TestDWord_620 TestDWord_624 TestDWord_643 TestDWord_669 TestDWord_671 TestDWord_675 TestDWord_679 TestDWord_684 TestDWord_691 TestDWord_693 TestDWord_694 TestDWord_697 TestDWord_703 TestDWord_708 TestDWord_714 TestDWord_716 TestDWord_722 TestDWord_724 TestDWord_725 TestDWord_727 TestDWord_730 TestDWord_748 TestDWord_758 TestDWord_769 TestDWord_773 TestDWord_782 TestDWord_783 TestDWord_794 TestDWord_800 TestDWord_805 TestDWord_811 TestDWord_814 TestDWord_823 TestDWord_825 TestDWord_828 TestDWord_839 TestDWord_849 TestDWord_850 TestDWord_851 TestDWord_863 TestDWord_866 TestDWord_873 TestDWord_875 TestDWord_883 TestDWord_895 TestDWord_899 TestDWord_906 TestDWord_907 TestDWord_908 TestDWord_910 TestDWord_917 TestDWord_922 TestDWord_923 TestDWord_925 TestDWord_927 TestDWord_929 TestDWord_932 TestDWord_933 TestDWord_945 TestDWord_956 TestDWord_959 TestDWord_979 TestDWord_980 TestDWord_990 TestDWord_994 TestDWord_995 TestDWord_996 TestWord_001 TestWord_003 TestWord_004 TestWord_005 TestWord_006 TestWord_007 TestWord_008 TestWord_009 TestWord_011 TestWord_012 TestWord_013 TestWord_014 TestWord_017 TestWord_020 TestWord_021 TestWord_025 TestWord_026 TestWord_027 TestWord_028 TestWord_029 TestWord_031 TestWord_032 TestWord_033 TestWord_035 TestWord_036 TestWord_037 TestWord_038 TestWord_039 TestWord_040 TestWord_041 TestWord_042 TestWord_043 TestWord_044 TestWord_046 TestWord_048 TestWord_050 TestWord_051 TestWord_052 TestWord_053 TestWord_054 TestWord_055 TestWord_058 TestWord_060 TestWord_062 TestWord_065 TestWord_068 TestWord_069 TestWord_070 TestWord_071 TestWord_072 TestWord_074 TestWord_075 TestWord_076 TestWord_077 TestWord_078 TestWord_080 TestWord_081 TestWord_082 TestWord_083 TestWord_084 TestWord_085 TestWord_088 TestWord_089 TestWord_090 TestWord_091 TestWord_092 TestWord_093 /end REF_MEASUREMENT
/end GROUP
/begin RECORD_LAYOUT CurveNxVub AXIS_PTS_X 1 UBYTE INDEX_INCR DIRECT FNC_VALUES 2 UBYTE ROW_DIR DIRECT /end RECORD_LAYOUT
/begin RECORD_LAYOUT CurveNxXVub AXIS_PTS_X 2 UBYTE INDEX_INCR DIRECT FNC_VALUES 3 UBYTE ROW_DIR DIRECT NO_AXIS_PTS_X 1 UBYTE /end RECORD_LAYOUT
/begin RECORD_LAYOUT CurveV8ub FIX_NO_AXIS_PTS_X 8 FNC_VALUES 1 UBYTE ROW_DIR DIRECT /end RECORD_LAYOUT
/begin RECORD_LAYOUT CurveVub FNC_VALUES 1 UBYTE ROW_DIR DIRECT /end RECORD_LAYOUT
/begin RECORD_LAYOUT CurveX8ub AXIS_PTS_X 1 UBYTE INDEX_INCR DIRECT FIX_NO_AXIS_PTS_X 8 /end RECORD_LAYOUT
/begin RECORD_LAYOUT CurveX8V8ub AXIS_PTS_X 1 UBYTE INDEX_INCR DIRECT FIX_NO_AXIS_PTS_X 8 FNC_VALUES 2 UBYTE ROW_DIR DIRECT /end RECORD_LAYOUT
/begin RECORD_LAYOUT CurveX8V8ubAlternate AXIS_PTS_X 1 UWORD INDEX_INCR DIRECT FIX_NO_AXIS_PTS_X 8 FNC_VALUES 2 UWORD ALTERNATE_WITH_X DIRECT /end RECORD_LAYOUT
/begin RECORD_LAYOUT MapColRowuw FNC_VALUES 1 UWORD COLUMN_DIR DIRECT /end RECORD_LAYOUT
/begin RECORD_LAYOUT MapNxNyVub FNC_VALUES 3 UBYTE ROW_DIR DIRECT NO_AXIS_PTS_X 1 UBYTE NO_AXIS_PTS_Y 2 UBYTE /end RECORD_LAYOUT
/begin RECORD_LAYOUT MapNxNyXYVsb ALIGNMENT_BYTE 1 ALIGNMENT_FLOAT32_IEEE 1 ALIGNMENT_FLOAT64_IEEE 1 ALIGNMENT_LONG 1 ALIGNMENT_WORD 1 AXIS_PTS_X 3 SBYTE INDEX_INCR DIRECT AXIS_PTS_Y 4 SBYTE INDEX_INCR DIRECT FNC_VALUES 5 SBYTE ROW_DIR DIRECT NO_AXIS_PTS_X 1 SBYTE NO_AXIS_PTS_Y 2 SBYTE /end RECORD_LAYOUT
/begin RECORD_LAYOUT MapNxNyXYVub AXIS_PTS_X 3 UBYTE INDEX_INCR DIRECT AXIS_PTS_Y 4 UBYTE INDEX_INCR DIRECT FNC_VALUES 5 UBYTE ROW_DIR DIRECT NO_AXIS_PTS_X 1 UBYTE NO_AXIS_PTS_Y 2 UBYTE /end RECORD_LAYOUT
/begin RECORD_LAYOUT MapNxXNyYVuc AXIS_PTS_X 2 UBYTE INDEX_INCR DIRECT AXIS_PTS_Y 4 UBYTE INDEX_INCR DIRECT FNC_VALUES 5 UBYTE ROW_DIR DIRECT NO_AXIS_PTS_X 1 UBYTE NO_AXIS_PTS_Y 3 UBYTE /end RECORD_LAYOUT
/begin RECORD_LAYOUT MapRowColub FNC_VALUES 1 UBYTE ROW_DIR DIRECT /end RECORD_LAYOUT
/begin RECORD_LAYOUT MapV86ub FIX_NO_AXIS_PTS_X 8 FIX_NO_AXIS_PTS_Y 6 FNC_VALUES 1 UBYTE ROW_DIR DIRECT /end RECORD_LAYOUT
/begin RECORD_LAYOUT MapX8Y6V86ub AXIS_PTS_X 1 UBYTE INDEX_INCR DIRECT AXIS_PTS_Y 2 UBYTE INDEX_INCR DIRECT FIX_NO_AXIS_PTS_X 8 FIX_NO_AXIS_PTS_Y 6 FNC_VALUES 3 UBYTE ROW_DIR DIRECT /end RECORD_LAYOUT
/begin RECORD_LAYOUT MapX8Y8V88ub AXIS_PTS_X 1 UBYTE INDEX_INCR DIRECT AXIS_PTS_Y 2 UBYTE INDEX_INCR DIRECT FIX_NO_AXIS_PTS_X 8 FIX_NO_AXIS_PTS_Y 8 FNC_VALUES 3 UBYTE ROW_DIR DIRECT /end RECORD_LAYOUT
/begin RECORD_LAYOUT MapXYVub AXIS_PTS_X 1 UBYTE INDEX_INCR DIRECT AXIS_PTS_Y 2 UBYTE INDEX_INCR DIRECT FNC_VALUES 3 UBYTE ROW_DIR DIRECT /end RECORD_LAYOUT
/begin RECORD_LAYOUT __UBYTE_Z FNC_VALUES 1 UBYTE ROW_DIR DIRECT /end RECORD_LAYOUT
/begin RECORD_LAYOUT __UWORD_Z FNC_VALUES 1 UWORD ROW_DIR DIRECT /end RECORD_LAYOUT
/begin RECORD_LAYOUT __SBYTE_Z FNC_VALUES 1 SBYTE ROW_DIR DIRECT /end RECORD_LAYOUT
/begin RECORD_LAYOUT __SWORD_Z FNC_VALUES 1 SWORD ROW_DIR DIRECT /end RECORD_LAYOUT
/begin RECORD_LAYOUT __SLONG_Z FNC_VALUES 1 SLONG ROW_DIR DIRECT /end RECORD_LAYOUT
/begin RECORD_LAYOUT __FLOAT32_IEEE_Z FNC_VALUES 1 FLOAT32_IEEE ROW_DIR DIRECT /end RECORD_LAYOUT
/begin RECORD_LAYOUT __FLOAT64_IEEE_Z FNC_VALUES 1 FLOAT64_IEEE ROW_DIR DIRECT /end RECORD_LAYOUT
/begin RECORD_LAYOUT __UBYTE_S FNC_VALUES 1 UBYTE COLUMN_DIR DIRECT /end RECORD_LAYOUT
/begin RECORD_LAYOUT __UWORD_S FNC_VALUES 1 UWORD COLUMN_DIR DIRECT /end RECORD_LAYOUT
/begin RECORD_LAYOUT __ULONG_S FNC_VALUES 1 ULONG COLUMN_DIR DIRECT /end RECORD_LAYOUT
/begin RECORD_LAYOUT __SBYTE_S FNC_VALUES 1 SBYTE COLUMN_DIR DIRECT /end RECORD_LAYOUT
/begin RECORD_LAYOUT __SWORD_S FNC_VALUES 1 SWORD COLUMN_DIR DIRECT /end RECORD_LAYOUT
/begin RECORD_LAYOUT __SLONG_S FNC_VALUES 1 SLONG COLUMN_DIR DIRECT /end RECORD_LAYOUT
/begin RECORD_LAYOUT __FLOAT32_IEEE_S FNC_VALUES 1 FLOAT32_IEEE COLUMN_DIR DIRECT /end RECORD_LAYOUT
/begin RECORD_LAYOUT __FLOAT64_IEEE_S FNC_VALUES 1 FLOAT64_IEEE COLUMN_DIR DIRECT /end RECORD_LAYOUT
/begin RECORD_LAYOUT SSV__UBYTE_S AXIS_PTS_X 1 UBYTE INDEX_INCR DIRECT /end RECORD_LAYOUT
/begin RECORD_LAYOUT SSV__UWORD_S AXIS_PTS_X 1 UWORD INDEX_INCR DIRECT /end RECORD_LAYOUT
/begin RECORD_LAYOUT SSV__ULONG_S AXIS_PTS_X 1 ULONG INDEX_INCR DIRECT /end RECORD_LAYOUT
/end MODULE
/end PROJECT
