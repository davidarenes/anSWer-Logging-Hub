/*@!Encoding:1252*/
includes
{
  #include "libs\CCP_cfg.can"
}
variables
{
  
  int CCP_PrmIndex=0;
  byte CCP_Start_Flag = 0;
  byte CCP_BlkID_Counter = 1;
  byte CCP_BlkID_Max_Value = 72;
}

on key ','
{
  CCP_Start_Flag = 1;
  @Volvo_VCORE_var::CCP_Flag=1;
  Write("Send valid CCP values");
}

on key '.'
{
  CCP_Start_Flag = 1;
  @Volvo_VCORE_var::CCP_Flag=2;
  Write("Send invalid CCP values");
}

on key '/'
{
  CCP_Start_Flag = 0;
  @Volvo_VCORE_var::CCP_Flag=0;
  Write("Stop sending CCP values");
}


void set_signals_value()
{
  if( @Volvo_VCORE_var::CCP_Flag==1)    //Valid CCP
  {
    $CEMBackBoneSignalIpdu04::VehCfgPrmBlk  = CCP_BlkID_Counter ;
    $CEMBackBoneSignalIpdu04::VehCfgPrmVal1 = CCP_Valid_Value_Parameters[CCP_PrmIndex++] ;
    $CEMBackBoneSignalIpdu04::VehCfgPrmVal2 = CCP_Valid_Value_Parameters[CCP_PrmIndex++] ;
    $CEMBackBoneSignalIpdu04::VehCfgPrmVal3 = CCP_Valid_Value_Parameters[CCP_PrmIndex++] ;
    $CEMBackBoneSignalIpdu04::VehCfgPrmVal4 = CCP_Valid_Value_Parameters[CCP_PrmIndex++] ;
    $CEMBackBoneSignalIpdu04::VehCfgPrmVal5 = CCP_Valid_Value_Parameters[CCP_PrmIndex++] ;
    $CEMBackBoneSignalIpdu04::VehCfgPrmVal6 = CCP_Valid_Value_Parameters[CCP_PrmIndex++] ;
    $CEMBackBoneSignalIpdu04::VehCfgPrmVal7 = CCP_Valid_Value_Parameters[CCP_PrmIndex++] ;
  }
  else if( @Volvo_VCORE_var::CCP_Flag==2)   //Invalid CCP
  {
    $CEMBackBoneSignalIpdu04::VehCfgPrmBlk  = CCP_BlkID_Counter ;
    $CEMBackBoneSignalIpdu04::VehCfgPrmVal1 = CCP_InValid_Value_Parameters[CCP_PrmIndex++] ;
    $CEMBackBoneSignalIpdu04::VehCfgPrmVal2 = CCP_InValid_Value_Parameters[CCP_PrmIndex++] ;
    $CEMBackBoneSignalIpdu04::VehCfgPrmVal3 = CCP_InValid_Value_Parameters[CCP_PrmIndex++] ;
    $CEMBackBoneSignalIpdu04::VehCfgPrmVal4 = CCP_InValid_Value_Parameters[CCP_PrmIndex++] ;
    $CEMBackBoneSignalIpdu04::VehCfgPrmVal5 = CCP_InValid_Value_Parameters[CCP_PrmIndex++] ;
    $CEMBackBoneSignalIpdu04::VehCfgPrmVal6 = CCP_InValid_Value_Parameters[CCP_PrmIndex++] ;
    $CEMBackBoneSignalIpdu04::VehCfgPrmVal7 = CCP_InValid_Value_Parameters[CCP_PrmIndex++] ;
  }
  else  //Stop sending CCP values
  {
    $CEMBackBoneSignalIpdu04::VehCfgPrmBlk  = 0;
    $CEMBackBoneSignalIpdu04::VehCfgPrmVal1 = 0;
    $CEMBackBoneSignalIpdu04::VehCfgPrmVal1 = 0;
    $CEMBackBoneSignalIpdu04::VehCfgPrmVal1 = 0;
    $CEMBackBoneSignalIpdu04::VehCfgPrmVal1 = 0;
    $CEMBackBoneSignalIpdu04::VehCfgPrmVal1 = 0;
    $CEMBackBoneSignalIpdu04::VehCfgPrmVal1 = 0;
    $CEMBackBoneSignalIpdu04::VehCfgPrmVal1 = 0;
  }
  $CEMBackBoneSignalIpdu04::VehCfgPrm_UB =1;
  Write("CCP_BlkID_Counter = %d",CCP_BlkID_Counter);
  
}

on frFrame CemBackBoneFr05
{
  if ( CCP_Start_Flag  )
  {
    set_signals_value();
    if( CCP_BlkID_Counter==CCP_BlkID_Max_Value )
    {
      CCP_BlkID_Counter = 1;
      CCP_PrmIndex=0;
    }
    else
    {
      CCP_BlkID_Counter++;
    }
  }
  else
  {
    CCP_BlkID_Counter = 1;
    CCP_PrmIndex=0;
  }
}
