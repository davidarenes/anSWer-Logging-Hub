includes
{
  // Import required CAPL include files
  //--- begin generated part --- Block start #Hdr_Includes#; do not delete this line and do not add application code in this code block!
  /* #ChannelStart# |CAN4| #BusStart# |ASDM4CANFD| */
  /* #ChannelEnd# |CAN4| #BusEnd# |ASDM4CANFD| */
  //--- end generated part --- Block end #Hdr_Includes#; do not delete this line! Add application code below this line.
  //--- begin generated part --- Block start #Body_Includes#; do not delete this line and do not add application code in this code block!
  /* #ChannelStart# |CAN4| #BusStart# |ASDM4CANFD| */
  #include "..\CAPL\Vector-NM-Panel-Helper_CAN4.cin"
  #include "..\CAPL\Vector-NM-ASR-Helper_CAN4.cin"
  /* #ChannelEnd# |CAN4| #BusEnd# |ASDM4CANFD| */
  //--- end generated part --- Block end #Body_Includes#; do not delete this line! Add application code below this line.
}

variables
{
  // Define global variables for this CAPL file

  /*--- #GenHeader Begin# --- begin generated comment ---
  | Generated on Monday, July 28, 2025, 00:03:07
  | By ModelGenerator for Vector 1.5.4.10, ModelGeneratorVectorDLL 1.5.4.41
  | Package Vector 4.0.21
  | Target Bus: ASDM4CANFD; Channel: CAN4; DB Cluster: SPA8110_ConfigurationsSPA3d2_ASDM4CANFD_250522;
  | From Database: SPA8110_ConfigurationsSPA3d2_ASDM4CANFD_250522.dbc
  | CANoe Version 15.3.89.0
    --- #GenHeader End  # --- end generated comment --- */

  char gECU[256] = "PAS";
  //--- begin generated part --- Block start #Hdr_GlobalVariables#; do not delete this line and do not add application code in this code block!
  /* #ChannelStart# |CAN4| #BusStart# |ASDM4CANFD| */
  dword gILCAN4_BusContext = 0;
  /* #ChannelEnd# |CAN4| #BusEnd# |ASDM4CANFD| */
  //--- end generated part --- Block end #Hdr_GlobalVariables#; do not delete this line! Add application code below this line.
  //--- begin generated part --- Block start #Body_GlobalVariables#; do not delete this line and do not add application code in this code block!
  /* #ChannelStart# |CAN4| #BusStart# |ASDM4CANFD| */
  char gCAN4BusName[256] = "ASDM4CANFD";
  int gCAN4Channel = 4; //// The channel the bus is attached to
  int gCAN4TXEnable = 1; //// enable/disable TX of application messages

  long gCAN4DisturbanceMode;
  long gCAN4DisturbanceCount;
  long gCAN4DisturbanceValue;
  long gCAN4DisturbanceContinueMode;
  double gCAN4DisturbancePeriod;
  /* #ChannelEnd# |CAN4| #BusEnd# |ASDM4CANFD| */
  //--- end generated part --- Block end #Body_GlobalVariables#; do not delete this line! Add application code below this line.
}

on preStart
{
  // Initialize CAPL includes and node's modules/DLLs
  //--- begin generated part --- Block start #Hdr_OnInit#; do not delete this line and do not add application code in this code block!
  /* #ChannelStart# |CAN4| #BusStart# |ASDM4CANFD| */
  /* #ChannelEnd# |CAN4| #BusEnd# |ASDM4CANFD| */
  //--- end generated part --- Block end #Hdr_OnInit#; do not delete this line! Add application code below this line.
  //--- begin generated part --- Block start #Body_OnInit#; do not delete this line and do not add application code in this code block!
  /* #ChannelStart# |CAN4| #BusStart# |ASDM4CANFD| */
  gILCAN4_BusContext = GetBusNameContext(gCAN4BusName);
  if (gILCAN4_BusContext == 0)
  {
    write("[%.6f %NODE_NAME%] ERROR: cannot determine bus context of Ethernet bus '%s'!", TimeNowNS()/1e9, gCAN4BusName);
  }
  NMCAN4_OnInit();
  if (@sysvar::IL::Klemme15 == 0)
  {
    ILCAN4_StartStop(0);
  }
  /* #ChannelEnd# |CAN4| #BusEnd# |ASDM4CANFD| */
  //--- end generated part --- Block end #Body_OnInit#; do not delete this line! Add application code below this line.
}

on start
{
  // Start CAPL includes and node's modules/DLLs
  //--- begin generated part --- Block start #Hdr_OnStart#; do not delete this line and do not add application code in this code block!
  /* #ChannelStart# |CAN4| #BusStart# |ASDM4CANFD| */
  /* #ChannelEnd# |CAN4| #BusEnd# |ASDM4CANFD| */
  //--- end generated part --- Block end #Hdr_OnStart#; do not delete this line! Add application code below this line.
  //--- begin generated part --- Block start #Body_OnStart#; do not delete this line and do not add application code in this code block!
  /* #ChannelStart# |CAN4| #BusStart# |ASDM4CANFD| */
  NMCAN4_OnStart();
  if ((@sysvar::IL::Klemme15 != 0) && (@sysvar::IL::Klemme30 != 0))
  {
    ILCAN4_StartStop(1);
  }
  /* #ChannelEnd# |CAN4| #BusEnd# |ASDM4CANFD| */
  //--- end generated part --- Block end #Body_OnStart#; do not delete this line! Add application code below this line.
}

on preStop
{
  // Prepare stopping
  //--- begin generated part --- Block start #Hdr_OnStopping#; do not delete this line and do not add application code in this code block!
  /* #ChannelStart# |CAN4| #BusStart# |ASDM4CANFD| */
  /* #ChannelEnd# |CAN4| #BusEnd# |ASDM4CANFD| */
  //--- end generated part --- Block end #Hdr_OnStopping#; do not delete this line! Add application code below this line.
  //--- begin generated part --- Block start #Body_OnStopping#; do not delete this line and do not add application code in this code block!
  /* #ChannelStart# |CAN4| #BusStart# |ASDM4CANFD| */
  /* #ChannelEnd# |CAN4| #BusEnd# |ASDM4CANFD| */
  //--- end generated part --- Block end #Body_OnStopping#; do not delete this line! Add application code below this line.
}

on stopMeasurement
{
  // Stop actions
  //--- begin generated part --- Block start #Hdr_OnStop#; do not delete this line and do not add application code in this code block!
  /* #ChannelStart# |CAN4| #BusStart# |ASDM4CANFD| */
  /* #ChannelEnd# |CAN4| #BusEnd# |ASDM4CANFD| */
  //--- end generated part --- Block end #Hdr_OnStop#; do not delete this line! Add application code below this line.
  //--- begin generated part --- Block start #Body_OnStop#; do not delete this line and do not add application code in this code block!
  /* #ChannelStart# |CAN4| #BusStart# |ASDM4CANFD| */
  /* #ChannelEnd# |CAN4| #BusEnd# |ASDM4CANFD| */
  //--- end generated part --- Block end #Body_OnStop#; do not delete this line! Add application code below this line.
}

void StartSim(dword busContext, int busActive, int mode)
{
  // Called when ... due to ...
  //   mode == 1: ILControlResume
  //   mode == 2: ILControlStart
  //   mode == 3: ILControlSimulationOn
  //--- begin generated part --- Block start #Hdr_StartSim#; do not delete this line and do not add application code in this code block!
  /* #ChannelStart# |CAN4| #BusStart# |ASDM4CANFD| */
  /* #ChannelEnd# |CAN4| #BusEnd# |ASDM4CANFD| */
  //--- end generated part --- Block end #Hdr_StartSim#; do not delete this line! Add application code below this line.
  //write("[%.6f %NODE_NAME%] StartSim(0x%X, %d, %d)", TimeNowNS()/1e9, busContext, busActive, mode);
  //--- begin generated part --- Block start #Body_StartSim#; do not delete this line and do not add application code in this code block!
  /* #ChannelStart# |CAN4| #BusStart# |ASDM4CANFD| */
  /* #ChannelEnd# |CAN4| #BusEnd# |ASDM4CANFD| */
  //--- end generated part --- Block end #Body_StartSim#; do not delete this line! Add application code below this line.
}

void StopSim(dword busContext, int busActive, int mode)
{
  // Called when ... due to ...
  //   mode == 1: ILControlWait
  //   mode == 2: ILControlStop
  //   mode == 3: ILControlSimulationOff
  //--- begin generated part --- Block start #Hdr_StopSim#; do not delete this line and do not add application code in this code block!
  /* #ChannelStart# |CAN4| #BusStart# |ASDM4CANFD| */
  /* #ChannelEnd# |CAN4| #BusEnd# |ASDM4CANFD| */
  //--- end generated part --- Block end #Hdr_StopSim#; do not delete this line! Add application code below this line.
  //write("[%.6f %NODE_NAME%] StopSim(0x%X, %d, %d)", TimeNowNS()/1e9, busContext, busActive, mode);
  //--- begin generated part --- Block start #Body_StopSim#; do not delete this line and do not add application code in this code block!
  /* #ChannelStart# |CAN4| #BusStart# |ASDM4CANFD| */
  /* #ChannelEnd# |CAN4| #BusEnd# |ASDM4CANFD| */
  //--- end generated part --- Block end #Body_StopSim#; do not delete this line! Add application code below this line.
}

on sysvar_update sysvar::IL::Klemme15
{
  // Handle system state variable
  //--- begin generated part --- Block start #Hdr_KL15_Klemme15#; do not delete this line and do not add application code in this code block!
  /* #ChannelStart# |CAN4| #BusStart# |ASDM4CANFD| */
  /* #ChannelEnd# |CAN4| #BusEnd# |ASDM4CANFD| */
  //--- end generated part --- Block end #Hdr_KL15_Klemme15#; do not delete this line! Add application code below this line.
  //--- begin generated part --- Block start #Body_KL15_Klemme15#; do not delete this line and do not add application code in this code block!
  /* #ChannelStart# |CAN4| #BusStart# |ASDM4CANFD| */
  ILCAN4_OnEnvKlemme15(@this);
  /* #ChannelEnd# |CAN4| #BusEnd# |ASDM4CANFD| */
  //--- end generated part --- Block end #Body_KL15_Klemme15#; do not delete this line! Add application code below this line.
}

on sysvar_update sysvar::IL::Klemme30
{
  // Handle system state variable
  //--- begin generated part --- Block start #Hdr_KL30_Klemme30#; do not delete this line and do not add application code in this code block!
  /* #ChannelStart# |CAN4| #BusStart# |ASDM4CANFD| */
  /* #ChannelEnd# |CAN4| #BusEnd# |ASDM4CANFD| */
  //--- end generated part --- Block end #Hdr_KL30_Klemme30#; do not delete this line! Add application code below this line.
  //--- begin generated part --- Block start #Body_KL30_Klemme30#; do not delete this line and do not add application code in this code block!
  /* #ChannelStart# |CAN4| #BusStart# |ASDM4CANFD| */
  ILCAN4_OnEnvKlemme30(@this);
  /* #ChannelEnd# |CAN4| #BusEnd# |ASDM4CANFD| */
  //--- end generated part --- Block end #Body_KL30_Klemme30#; do not delete this line! Add application code below this line.
}

void Nm_NetworkStartInd()
{
  // Callback of CAN AUTOSAR NM DLL
  dword lBusContext;
  //--- begin generated part --- Block start #Hdr_Nm_NetworkStartInd#; do not delete this line and do not add application code in this code block!
  /* #ChannelStart# |CAN4| #BusStart# |ASDM4CANFD| */
  /* #ChannelEnd# |CAN4| #BusEnd# |ASDM4CANFD| */
  //--- end generated part --- Block end #Hdr_Nm_NetworkStartInd#; do not delete this line! Add application code below this line.
  lBusContext = GetBusContext();
  //--- begin generated part --- Block start #Body_Nm_NetworkStartInd#; do not delete this line and do not add application code in this code block!
  /* #ChannelStart# |CAN4| #BusStart# |ASDM4CANFD| */
  if (lBusContext == gNMCAN4_BusContext) NMCAN4_IndNetworkStart();
  /* #ChannelEnd# |CAN4| #BusEnd# |ASDM4CANFD| */
  //--- end generated part --- Block end #Body_Nm_NetworkStartInd#; do not delete this line! Add application code below this line.
  SetBusContext(lBusContext);
}

void Nm_NetworkModeInd()
{
  // Callback of CAN AUTOSAR NM DLL
  dword lBusContext;
  //--- begin generated part --- Block start #Hdr_Nm_NetworkModeInd#; do not delete this line and do not add application code in this code block!
  /* #ChannelStart# |CAN4| #BusStart# |ASDM4CANFD| */
  /* #ChannelEnd# |CAN4| #BusEnd# |ASDM4CANFD| */
  //--- end generated part --- Block end #Hdr_Nm_NetworkModeInd#; do not delete this line! Add application code below this line.
  lBusContext = GetBusContext();
  //--- begin generated part --- Block start #Body_Nm_NetworkModeInd#; do not delete this line and do not add application code in this code block!
  /* #ChannelStart# |CAN4| #BusStart# |ASDM4CANFD| */
  if (lBusContext == gNMCAN4_BusContext) NMCAN4_IndNetworkMode();
  /* #ChannelEnd# |CAN4| #BusEnd# |ASDM4CANFD| */
  //--- end generated part --- Block end #Body_Nm_NetworkModeInd#; do not delete this line! Add application code below this line.
  SetBusContext(lBusContext);
}

void Nm_NetworkTimeoutInd()
{
  // Callback of CAN AUTOSAR NM DLL
  dword lBusContext;
  //--- begin generated part --- Block start #Hdr_Nm_NetworkTimeoutInd#; do not delete this line and do not add application code in this code block!
  /* #ChannelStart# |CAN4| #BusStart# |ASDM4CANFD| */
  /* #ChannelEnd# |CAN4| #BusEnd# |ASDM4CANFD| */
  //--- end generated part --- Block end #Hdr_Nm_NetworkTimeoutInd#; do not delete this line! Add application code below this line.
  lBusContext = GetBusContext();
  //--- begin generated part --- Block start #Body_Nm_NetworkTimeoutInd#; do not delete this line and do not add application code in this code block!
  /* #ChannelStart# |CAN4| #BusStart# |ASDM4CANFD| */
  if (lBusContext == gNMCAN4_BusContext) NMCAN4_IndNetworkTimeout();
  /* #ChannelEnd# |CAN4| #BusEnd# |ASDM4CANFD| */
  //--- end generated part --- Block end #Body_Nm_NetworkTimeoutInd#; do not delete this line! Add application code below this line.
  SetBusContext(lBusContext);
}

void Nm_PrepareBusSleepModeInd()
{
  // Callback of CAN AUTOSAR NM DLL
  dword lBusContext;
  //--- begin generated part --- Block start #Hdr_Nm_PrepareBusSleepModeInd#; do not delete this line and do not add application code in this code block!
  /* #ChannelStart# |CAN4| #BusStart# |ASDM4CANFD| */
  /* #ChannelEnd# |CAN4| #BusEnd# |ASDM4CANFD| */
  //--- end generated part --- Block end #Hdr_Nm_PrepareBusSleepModeInd#; do not delete this line! Add application code below this line.
  lBusContext = GetBusContext();
  //--- begin generated part --- Block start #Body_Nm_PrepareBusSleepModeInd#; do not delete this line and do not add application code in this code block!
  /* #ChannelStart# |CAN4| #BusStart# |ASDM4CANFD| */
  if (lBusContext == gNMCAN4_BusContext) NMCAN4_IndPrepareBusSleepMode();
  /* #ChannelEnd# |CAN4| #BusEnd# |ASDM4CANFD| */
  //--- end generated part --- Block end #Body_Nm_PrepareBusSleepModeInd#; do not delete this line! Add application code below this line.
  SetBusContext(lBusContext);
}

void Nm_BusSleepModeInd()
{
  // Callback of CAN AUTOSAR NM DLL
  dword lBusContext;
  //--- begin generated part --- Block start #Hdr_Nm_BusSleepModeInd#; do not delete this line and do not add application code in this code block!
  /* #ChannelStart# |CAN4| #BusStart# |ASDM4CANFD| */
  /* #ChannelEnd# |CAN4| #BusEnd# |ASDM4CANFD| */
  //--- end generated part --- Block end #Hdr_Nm_BusSleepModeInd#; do not delete this line! Add application code below this line.
  lBusContext = GetBusContext();
  //--- begin generated part --- Block start #Body_Nm_BusSleepModeInd#; do not delete this line and do not add application code in this code block!
  /* #ChannelStart# |CAN4| #BusStart# |ASDM4CANFD| */
  if (lBusContext == gNMCAN4_BusContext) NMCAN4_IndBusSleepMode();
  /* #ChannelEnd# |CAN4| #BusEnd# |ASDM4CANFD| */
  //--- end generated part --- Block end #Body_Nm_BusSleepModeInd#; do not delete this line! Add application code below this line.
  SetBusContext(lBusContext);
}

void Nm_StateChangeNotification(long previousState, long currentState)
{
  // Callback of CAN AUTOSAR NM DLL
  dword lBusContext;
  //--- begin generated part --- Block start #Hdr_Nm_StateChangeNotification#; do not delete this line and do not add application code in this code block!
  /* #ChannelStart# |CAN4| #BusStart# |ASDM4CANFD| */
  /* #ChannelEnd# |CAN4| #BusEnd# |ASDM4CANFD| */
  //--- end generated part --- Block end #Hdr_Nm_StateChangeNotification#; do not delete this line! Add application code below this line.
  lBusContext = GetBusContext();
  //--- begin generated part --- Block start #Body_Nm_StateChangeNotification#; do not delete this line and do not add application code in this code block!
  /* #ChannelStart# |CAN4| #BusStart# |ASDM4CANFD| */
  if (lBusContext == gNMCAN4_BusContext) NMCAN4_IndStateChangeNotification(previousState, currentState);
  /* #ChannelEnd# |CAN4| #BusEnd# |ASDM4CANFD| */
  //--- end generated part --- Block end #Body_Nm_StateChangeNotification#; do not delete this line! Add application code below this line.
  SetBusContext(lBusContext);
}

//--- begin generated part --- Block start <#Helper_Functions#> do not delete this line and do not add application code in this code block!
/* #ChannelStart# |CAN4| #BusStart# |ASDM4CANFD| */
void ILCAN4_Enable(int enable)
{
  dword lBusContext;
  lBusContext = GetBusNameContext(gCAN4BusName);
  SetBusContext(lBusContext);
  gCAN4TXEnable = enable;
  if (enable == 0)
  {
    StopSim(lBusContext, 1, 3);
    CANOffline(1); // 1 = CAPL, 2 = DLL
  }
  if (enable != 0)
  {
    CANOnline(3); // 1 = CAPL, 2 = DLL
    StartSim(lBusContext, 1, 3);
  }
}

void ILCAN4_WaitResume(int enable)
{
  dword lBusContext;
  if (gCAN4TXEnable > 0)
  {
    lBusContext = GetBusNameContext(gCAN4BusName);
    SetBusContext(lBusContext);
    if (enable == 0)
    {
      StopSim(lBusContext, 1, 1);
      CANOffline(1); // 1 = CAPL, 2 = DLL
    }
    if (enable != 0)
    {
      CANOnline(3); // 1 = CAPL, 2 = DLL
      StartSim(lBusContext, 1, 1);
    }
  }
}

void ILCAN4_StartStop(int enable)
{
  dword lBusContext;
  if (gCAN4TXEnable > 0)
  {
    lBusContext = GetBusNameContext(gCAN4BusName);
    SetBusContext(lBusContext);
    if (enable == 0)
    {
      StopSim(lBusContext, 1, 2);
      CANOffline(1); // 1 = CAPL, 2 = DLL
    }
    if (enable != 0)
    {
      CANOnline(3); // 1 = CAPL, 2 = DLL
      StartSim(lBusContext, 1, 2);
    }
  }
}

void ILCAN4_OnEnvKlemme15(int enable)
{
  if (@sysvar::IL::Klemme30 > 0)
  {
    if(enable != 0)
    {
      NMCAN4_RequestBus(); // defined in the NM-Helper include file
    }
    else
    {
      NMCAN4_ReleaseBus(); // defined in the NM-Helper include file
    }
  }
}

void ILCAN4_OnEnvKlemme30(int enable)
{
  if(enable != 0)
  {
    NMCAN4_Enable(1); // defined in the NM-Helper include file
    ILCAN4_Enable(1);
    if (@sysvar::IL::Klemme15 > 0)
    {
      NMCAN4_RequestBus(); // defined in the NM-Helper include file
    }
  }
  else
  {
    NMCAN4_Enable(0); // defined in the NM-Helper include file
    ILCAN4_Enable(0);
  }
}

/* #ChannelEnd# |CAN4| #BusEnd# |ASDM4CANFD| */
//--- end generated part --- Block end <#Helper_Functions#> do not delete this line! Add application code below this line.

//--- begin generated part --- Block start <#SysVar_Handler#> do not delete this line and do not add application code in this code block!
/* #ChannelStart# |CAN4| #BusStart# |ASDM4CANFD| */
on sysvar_update sysvar::NM_CAN4::NODES::N_PAS::DeactivateNM
{
  if( @this == 1 || @sysvar::NM_CAN4::StateControl::DeactivateNM == 1)
  {
    NMCAN4_Enable(0);
  }
  else
  {
    NMCAN4_Enable(1);
  }
}

on sysvar_update sysvar::NM_CAN4::StateControl::DeactivateNM
{
  if( @this == 1 || @sysvar::NM_CAN4::NODES::N_PAS::DeactivateNM == 1)
  {
    NMCAN4_Enable(0);
  }
  else
  {
    NMCAN4_Enable(1);
  }
}

on sysvar_update sysvar::NM_CAN4::NODES::N_PAS::OpenNodePanel
{
  OpenNodePanel("ASDM4CANFD::PAS", 1);
}

on sysvar_update sysvar::NM_CAN4::StateControl::CloseNodePanels
{
  OpenNodePanel("ASDM4CANFD::PAS", 0);
}

/* #ChannelEnd# |CAN4| #BusEnd# |ASDM4CANFD| */
//--- end generated part --- Block end <#SysVar_Handler#> do not delete this line! Add application code below this line.

//--- begin generated part --- Block start <#MsgUpdateFcns#> do not delete this line and do not add application code in this code block!
/* #ChannelStart# |CAN4| #BusStart# |ASDM4CANFD| */
/* #ChannelEnd# |CAN4| #BusEnd# |ASDM4CANFD| */
//--- end generated part --- Block end <#MsgUpdateFcns#> do not delete this line! Add application code below this line.

