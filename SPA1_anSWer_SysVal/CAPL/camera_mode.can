/*@!Encoding:1252*/

variables
{
  msTimer tDiag;
  diagRequest ASDM_Diagnostics.* req;
  int request_time_ms = 1000;
}

on start
{  
  // UDS request: ReadDataByIdentifier(22) + DID A8D4
  byte camera_mode_did[3];
  
  // 22 A8 4D Camera Mode DID
  camera_mode_did[0] = 0x22; // SID
  camera_mode_did[1] = 0xA8; // DID high
  camera_mode_did[2] = 0xD4; // DID low

  diagResize(req, 3);
  diagSetPrimitiveData(req, camera_mode_did, 3);

  // Send first request
  diagSendRequest(req);

  // Set periodic timer (ms)
  setTimer(tDiag, request_time_ms);
  
  @anSWer_SysVal::Camera_Mode = 0;
}

on timer tDiag
{
  // Send UDS request periodically
  diagSendRequest(req);
  setTimer(tDiag, request_time_ms);
}

on diagResponse ASDM_Diagnostics.*
{
  byte buf[16];
  int value;

  // Read raw diagnostic response bytes
  diagGetPrimitiveData(this, buf, 16);

  // Convert buf[3] to int
  value = (int)buf[3];

  // Store in SysVar
  @anSWer_SysVal::Camera_Mode = value;
}

on preStop
{
  @anSWer_SysVal::Camera_Mode = 0;
}

on stopMeasurement
{
  @anSWer_SysVal::Camera_Mode = 0;
}