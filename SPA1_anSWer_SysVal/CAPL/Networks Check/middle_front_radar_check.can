/*@!Encoding:1252*/

includes
{
}

variables
{
  msTimer tRefresh;

  long lastMFR = -1;          // Last observed value of the CAN signal MFR
  int  radarState = 0;        // 0 = no data, 1 = updating, 2 = static but > 0
}

on start
{
  // Periodic check every 100 ms
  setTimerCyclic(tRefresh, 100);
}

on timer tRefresh
{
  long currentMFR;            // Local variable declaration

  // Read current value of the signal
  currentMFR = $zipy_serialized_data_0_MFR;

  // --- Determine status ---
  if (currentMFR != lastMFR)
  {
    // Value changed -> radar is updating
    radarState = 1;
    lastMFR = currentMFR;
  }
  else
  {
    // Value did not change -> check if it is > 0
    if (currentMFR > 0)
      radarState = 2;         // Signal static but valid
    else
      radarState = 0;         // No update and value is zero
  }

  // Write radar status sysvar
  @sysvar::anSWer_SysVal::Network_Status::Radars::Front_Middle = radarState;
}

on preStop
{
  // Reset before measurement stops
  @sysvar::anSWer_SysVal::Network_Status::Radars::Front_Middle = 0;
}

on stopMeasurement
{
  // Extra protection reset
  @sysvar::anSWer_SysVal::Network_Status::Radars::Front_Middle = 0;
}
