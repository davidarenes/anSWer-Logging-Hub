/*@!Encoding:1252*/

includes
{
}

variables
{
  msTimer tRefresh;

  // Last observed values
  long lastFL = -1;
  long lastFR = -1;

  // State values:
  // 0 = no data
  // 1 = updating (value changing)
  // 2 = static but > 0
  int stateFL = 0;
  int stateFR = 0;
}

on start
{
  // Periodic check every 100 ms
  setTimerCyclic(tRefresh, 100);
}

on timer tRefresh
{
  long currentFL;
  long currentFR;

  // Read current CAN signal values
  currentFL = $zipy_serialized_data_0_FL;
  currentFR = $zipy_serialized_data_0_FR;

  //
  // --- FRONT LEFT RADAR ---
  //
  if (currentFL != lastFL)
  {
    stateFL = 1;            // Signal is updating
    lastFL = currentFL;
  }
  else
  {
    if (currentFL > 0)
      stateFL = 2;          // Static but valid data
    else
      stateFL = 0;          // No data
  }

  @sysvar::anSWer_SysVal::Network_Status::Radars::Front_Left = stateFL;

  //
  // --- FRONT RIGHT RADAR ---
  //
  if (currentFR != lastFR)
  {
    stateFR = 1;            // Signal is updating
    lastFR = currentFR;
  }
  else
  {
    if (currentFR > 0)
      stateFR = 2;          // Static but valid data
    else
      stateFR = 0;          // No data
  }

  @sysvar::anSWer_SysVal::Network_Status::Radars::Front_Right = stateFR;
}

on preStop
{
  // Reset before measurement stops
  @sysvar::anSWer_SysVal::Network_Status::Radars::Front_Left  = 0;
  @sysvar::anSWer_SysVal::Network_Status::Radars::Front_Right = 0;
}

on stopMeasurement
{
  // Extra protection reset
  @sysvar::anSWer_SysVal::Network_Status::Radars::Front_Left  = 0;
  @sysvar::anSWer_SysVal::Network_Status::Radars::Front_Right = 0;
}
