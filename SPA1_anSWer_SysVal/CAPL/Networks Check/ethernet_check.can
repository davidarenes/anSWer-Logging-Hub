/*@!Encoding:1252*/

variables
{
  msTimer tRefresh;

  long lastCounter = -1;     // Last observed value of the sysvar counter
  int  isUpdating  = 0;      // 1 if the counter is changing, 0 if frozen
  int  wasUpdating = 0;      // Previous state (for edge detection)
}

on start
{
  // Reset drops counter at measurement start
  @sysvar::anSWer_SysVal::Network_Status::Ethernet_Drops = 0;

  // Periodic check every 100 ms
  setTimerCyclic(tRefresh, 100);
}

on timer tRefresh
{
  long current;

  // Read current counter value from sysvar
  current = @ZIPY_STREAM_P1::counter;

  // Detect real update (counter changed since last cycle)
  if (current != lastCounter)
  {
    isUpdating  = 1;
    lastCounter = current;
  }
  else
  {
    isUpdating = 0;
  }

  // Detect Ethernet drop (UP -> DOWN transition)
  if (wasUpdating == 1 && isUpdating == 0)
  {
    @sysvar::anSWer_SysVal::Network_Status::Ethernet_Drops =
      @sysvar::anSWer_SysVal::Network_Status::Ethernet_Drops + 1;
  }

  // Store current state for next cycle
  wasUpdating = isUpdating;

  // Write Ethernet network status
  @sysvar::anSWer_SysVal::Network_Status::Ethernet = isUpdating;
}

// Reset Ethernet status before measurement stops
on preStop
{
  @sysvar::anSWer_SysVal::Network_Status::Ethernet = 0;
}

// Additional safety: ensure value is reset after stop
on stopMeasurement
{
  @sysvar::anSWer_SysVal::Network_Status::Ethernet = 0;
}
