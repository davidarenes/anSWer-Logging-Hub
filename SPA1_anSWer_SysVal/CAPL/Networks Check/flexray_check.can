/*@!Encoding:1252*/

includes
{
}

variables
{
  msTimer tRefresh;

  long lastValue = -1;        // Last observed value of the FlexRay signal
  int  isUpdating = 0;        // 1 if the signal is changing, 0 if frozen
}

on start
{
  // Periodic check every 100 ms
  setTimerCyclic(tRefresh, 100);
  
  @sysvar::anSWer_SysVal::Network_Status::Flexray = 0;
}

on timer tRefresh
{
  long current;               // Local variable declaration

  // Read current value of the FlexRay signal
  current = $ASDM::SftyGainGroupSafeChks;

  // Detect real update (value changed since last cycle)
  if (current != lastValue)
  {
    isUpdating = 1;           // Signal is alive
    lastValue  = current;     // Store new value
  }
  else
  {
    isUpdating = 0;           // No update detected
  }

  // Write final FlexRay network status sysvar
  @sysvar::anSWer_SysVal::Network_Status::Flexray = isUpdating;
}

// Ensures FlexRay network status is reset to 0 before stopping measurement
on preStop
{
  @sysvar::anSWer_SysVal::Network_Status::Flexray = 0;
}

// Additional safety: ensure it is 0 after measurement is fully stopped
on stopMeasurement
{
  @sysvar::anSWer_SysVal::Network_Status::Flexray = 0;
}
