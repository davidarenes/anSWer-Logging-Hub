/*@!Encoding:1252*/

includes
{
}

variables
{
  msTimer tRefresh;

  long lastValue   = -1;      // Last observed value of the FlexRay signal
  int  isUpdating  = 0;       // 1 if signal is changing, 0 if frozen
  int  wasUpdating = 0;       // Previous state (for edge detection)
}

on start
{
  // Reset FlexRay status and drops counter at measurement start
  @sysvar::anSWer_SysVal::Network_Status::Flexray        = 0;
  @sysvar::anSWer_SysVal::Network_Status::Flexray_Drops = 0;

  // Periodic check every 100 ms
  setTimerCyclic(tRefresh, 100);
}

on timer tRefresh
{
  long current;

  // Read current value of the FlexRay signal
  current = $ASDM::SftyGainGroupSafeChks;

  // Detect real update (value changed since last cycle)
  if (current != lastValue)
  {
    isUpdating = 1;
    lastValue  = current;
  }
  else
  {
    isUpdating = 0;
  }

  // Detect FlexRay drop (UP -> DOWN transition)
  if (wasUpdating == 1 && isUpdating == 0)
  {
    @sysvar::anSWer_SysVal::Network_Status::Flexray_Drops =
      @sysvar::anSWer_SysVal::Network_Status::Flexray_Drops + 1;
  }

  // Store current state for next cycle
  wasUpdating = isUpdating;

  // Write FlexRay network status
  @sysvar::anSWer_SysVal::Network_Status::Flexray = isUpdating;
}

// Ensure FlexRay status is reset before stopping measurement
on preStop
{
  @sysvar::anSWer_SysVal::Network_Status::Flexray = 0;
}

// Additional safety after measurement is fully stopped
on stopMeasurement
{
  @sysvar::anSWer_SysVal::Network_Status::Flexray = 0;
}
