/*@!Encoding:1252*/
includes
{
  
}

variables
{
  
}

on start 
{
  
}

on key 'x'
{
  @XCP::R320_RX3::g_arbit::config::p_arbt_enable_func_actv_cond = 1;
  @XCP::R320_RX3::g_dasi_cfg::spa1_p1_cfg::cfg_arbt::p_arbt_enable_func_actv_cond = 1;
}

on key 't'
{
  @XCP::R320_RX3::g_arbit::config::p_arbt_enable_func_actv_cond = 0;
  @XCP::R320_RX3::g_dasi_cfg::spa1_p1_cfg::cfg_arbt::p_arbt_enable_func_actv_cond = 0;
}

